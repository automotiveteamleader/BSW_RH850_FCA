AUTOSAR XML (schema 4-2-1)
package /ActiveEcuC
  module config PduR: implementation-config-variant=VARIANT-PRE-COMPILE, module-description=PduR_Impl
    CanTp (PduRBswModules):
      PduRCancelReceive = false
      PduRCancelTransmit = false
      PduRChangeParameterRequestApi = false
      PduRCommunicationInterface = false
      PduRLowerModule = true
      PduRTransportProtocol = true
      PduRTriggertransmit = false
      PduRTxConfirmation = false
      PduRUpperModule = false
      PduRUseTag = false
      PduRBswModuleRef = CanTp
    Dcm (PduRBswModules):
      PduRCancelReceive = false
      PduRCancelTransmit = false
      PduRChangeParameterRequestApi = false
      PduRCommunicationInterface = false
      PduRLowerModule = false
      PduRTransportProtocol = true
      PduRTriggertransmit = false
      PduRTxConfirmation = false
      PduRUpperModule = true
      PduRUseTag = true
      PduRBswModuleRef = Dcm
    PduRGeneral:
      PduRVersionInfoApi = false
      PduRDevErrorDetect = false
      PduRMetaDataSupport = false
      PduRPduCallback = false
      PduRSwitching = false
      PduRSafeBswChecks = false
      PduREnableDeferredTransmission = false
      PduREnableDeferredReception = false
      PduRGeneration:
        PduROutOfBoundsWriteProtectionStrategy = NONE
        PduROutOfBoundsWriteSanitizer = false
        PduROutOfBoundsReadSanitizer = false
        PduRNumericalDataTypeMinimizationStrategy = WITH_CAST
        PduRReduceConstantData2Define = false
        PduRBoolDataInArrayOfStructStrategy = BITMASKING
        PduRDeduplicateIndirectedData = true
        PduRDataDeduplicationStrategy = WITH_CAST
        PduRReduceBoolDataByNegationThreshold = 2
        PduRReduceBoolDataByNumericalComparisonThreshold = 2
        PduRReduceBoolDataByNumericalRelationThreshold = 2
        PduRReduceBoolDataByNumericalOperandStrategy = WITH_ANY_VALUE
        PduRReduceNumericalDataByOffsetThreshold = 2
        PduRReduceNumericalDataByArraySubtractionThreshold = 2
        PduRReduceDataByStreaming = false
        PduRShortSymbols = false
        PduRInterfacesForDeactivatedData = false
        PduRReferringKeysInComments = false
    PduRRoutingTables: PduRConfigurationId=0
      PduRRoutingTable
        6 x PduRRoutingPath, all with PduRRoutingPathCommunicationType=TRANSPORT_PROTOCOL:
          Can_PT_Demo_0_CAN_FD_Request_eac1789b  # Demo_0_CAN_FD_Request_oDemoFBL_Fca_SLP5
            DST_Can_PT_Demo_0_CAN_FD_Request_eac1789b (PduRDestPdu):
              PduRDestPduHandleId = 1
              PduRDestPduDirection = RECEIVE
              PduRDestPduRoutingType = API_FORWARDING
              PduRDestPduDataProcessing = IMMEDIATE
              PduRPduLengthHandlingStrategy = UNUSED
              PduRDestPduRef = PT_Demo_0_CAN_FD_Request_PP_Demo_0_CAN_FD_Request_Rx_eac1789b_411010d2
              PduRDestPduPduRBswModulesRef = Dcm
            SRC_Can_PT_Demo_0_CAN_FD_Request_eac1789b (PduRSrcPdu):
              PduRSourcePduHandleId = 1
              PduRSrcPduDirection = RECEIVE
              PduRSrcPduRef = PT_Demo_0_CAN_FD_Request_PP_Demo_0_CAN_FD_Request_Rx_eac1789b_411010d2
              PduRSrcPduPduRBswModulesRef = CanTp
          Can_PT_Demo_0_CAN_20_Response_eac1789b  # Demo_0_CAN_20_Response_oDemoFBL_Fca_SLP5
            DST_Can_PT_Demo_0_CAN_20_Response_eac1789b (PduRDestPdu):
              PduRDestPduHandleId = 0
              PduRDestPduDirection = TRANSMIT
              PduRDestPduRoutingType = API_FORWARDING
              PduRDestPduDataProcessing = IMMEDIATE
              PduRPduLengthHandlingStrategy = UNUSED
              PduRDestPduRef = PT_Demo_0_CAN_20_Response_PP_Demo_0_CAN_20_Response_Tx_eac1789b_411010d2
              PduRDestPduPduRBswModulesRef = CanTp
            SRC_Can_PT_Demo_0_CAN_20_Response_eac1789b (PduRSrcPdu):
              PduRSourcePduHandleId = 0
              PduRSrcPduDirection = TRANSMIT
              PduRSrcPduRef = PT_Demo_0_CAN_20_Response_PP_Demo_0_CAN_20_Response_Tx_eac1789b_411010d2
              PduRSrcPduPduRBswModulesRef = Dcm
          Can_PT_Functional_CAN_FD_eac1789b  # Functional_CAN_FD_oDemoFBL_Fca_SLP5
            DST_Can_PT_Functional_CAN_FD_eac1789b (PduRDestPdu):
              PduRDestPduHandleId = 3
              PduRDestPduDirection = RECEIVE
              PduRDestPduRoutingType = API_FORWARDING
              PduRDestPduDataProcessing = IMMEDIATE
              PduRPduLengthHandlingStrategy = UNUSED
              PduRDestPduRef = PT_Functional_CAN_FD_PP_Functional_CAN_FD_Rx_eac1789b_411010d2
              PduRDestPduPduRBswModulesRef = Dcm
            SRC_Can_PT_Functional_CAN_FD_eac1789b (PduRSrcPdu):
              PduRSourcePduHandleId = 3
              PduRSrcPduDirection = RECEIVE
              PduRSrcPduRef = PT_Functional_CAN_FD_PP_Functional_CAN_FD_Rx_eac1789b_411010d2
              PduRSrcPduPduRBswModulesRef = CanTp
          Can_PT_Demo_0_CAN_20_Request_eac1789b  # Demo_0_CAN_20_Request_oDemoFBL_Fca_SLP5
            DST_Can_PT_Demo_0_CAN_20_Request_eac1789b (PduRDestPdu):
              PduRDestPduHandleId = 0
              PduRDestPduDirection = RECEIVE
              PduRDestPduRoutingType = API_FORWARDING
              PduRDestPduDataProcessing = IMMEDIATE
              PduRPduLengthHandlingStrategy = UNUSED
              PduRDestPduRef = PT_Demo_0_CAN_20_Request_PP_Demo_0_CAN_20_Request_Rx_eac1789b_411010d2
              PduRDestPduPduRBswModulesRef = Dcm
            SRC_Can_PT_Demo_0_CAN_20_Request_eac1789b (PduRSrcPdu):
              PduRSourcePduHandleId = 0
              PduRSrcPduDirection = RECEIVE
              PduRSrcPduRef = PT_Demo_0_CAN_20_Request_PP_Demo_0_CAN_20_Request_Rx_eac1789b_411010d2
              PduRSrcPduPduRBswModulesRef = CanTp
          Can_PT_Demo_0_CAN_FD_Response_eac1789b  # Demo_0_CAN_FD_Response_oDemoFBL_Fca_SLP5
            DST_Can_PT_Demo_0_CAN_FD_Response_eac1789b (PduRDestPdu):
              PduRDestPduHandleId = 1
              PduRDestPduDirection = TRANSMIT
              PduRDestPduRoutingType = API_FORWARDING
              PduRDestPduDataProcessing = IMMEDIATE
              PduRPduLengthHandlingStrategy = UNUSED
              PduRDestPduRef = PT_Demo_0_CAN_FD_Response_PP_Demo_0_CAN_FD_Response_Tx_eac1789b_411010d2
              PduRDestPduPduRBswModulesRef = CanTp
            SRC_Can_PT_Demo_0_CAN_FD_Response_eac1789b (PduRSrcPdu):
              PduRSourcePduHandleId = 1
              PduRSrcPduDirection = TRANSMIT
              PduRSrcPduRef = PT_Demo_0_CAN_FD_Response_PP_Demo_0_CAN_FD_Response_Tx_eac1789b_411010d2
              PduRSrcPduPduRBswModulesRef = Dcm
          Can_PT_Functional_CAN_20_eac1789b  # Functional_CAN_20_oDemoFBL_Fca_SLP5
            SRC_Can_PT_Functional_CAN_20_eac1789b (PduRSrcPdu):
              PduRSourcePduHandleId = 2
              PduRSrcPduDirection = RECEIVE
              PduRSrcPduRef = PT_Functional_CAN_20_PP_Functional_CAN_20_Rx_eac1789b_411010d2
              PduRSrcPduPduRBswModulesRef = CanTp
            DST_Can_PT_Functional_CAN_20_eac1789b (PduRDestPdu):
              PduRDestPduHandleId = 2
              PduRDestPduDirection = RECEIVE
              PduRDestPduRoutingType = API_FORWARDING
              PduRDestPduDataProcessing = IMMEDIATE
              PduRPduLengthHandlingStrategy = UNUSED
              PduRDestPduRef = PT_Functional_CAN_20_PP_Functional_CAN_20_Rx_eac1789b_411010d2
              PduRDestPduPduRBswModulesRef = Dcm
