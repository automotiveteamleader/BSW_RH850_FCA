AUTOSAR XML (schema 4-2-1)
package /ActiveEcuC
  module config Smh: implementation-config-variant=VARIANT-LINK-TIME, module-description=Smh_Impl
    SmhCryptographicKeys
      SmhKeyValue_RsaExp (SmhKeyValue): SmhDescription=Verification key exponent, SmhValue=9D85, SmhSuffix=
      SmhKeyValue_RsaMod (SmhKeyValue):
        SmhDescription = Verification key modulus
        SmhValue = F7242F3BB8697EE5C3ACAF800BA1C84E3C89EA373987073D971E91F83AD436F609BBBB8FBF250398860BB20C630BA124D9348BE0BA61F9436621205E0289AE238DDABD16EBB715EA85DDB988CC31D374D7C5800A74F6DA681106D0A63D50BA1FEA4FC202950F582E12E0BAF6FFE0F4C5E276A5AADAE7B8773476D09B0B883A83
        SmhSuffix = 
      SecM_RsaExp (SmhKey): SmhDescription=Public verification key exponent, SmhKeyValueRef=SmhKeyValue_RsaExp
      SecM_RsaMod (SmhKey): SmhDescription=Public verification key modulus, SmhKeyValueRef=SmhKeyValue_RsaMod
    SmhCrc: SmhOptimization=SPEED, SmhCRCType=CRC_32
    SmhGeneral:
      SmhWatchdogCycleCount = 1
      SmhOperationMode = PRODUCTION
      SmhCryptographicKeysLocatedInRAM = false
      SmhCryptographicWorkspaces = INTERNAL
      SmhRSAKeySize = RSA_1024
      SmhUserConfigFile = 
    SmhVerification:
      SmhHashAlgorithm = RIPEMD_160
      SmhSecurityClassCCC = true
      SmhChecksumTypeClassDDD = CRC
      SmhDiscreteHashCalculation = false
      SmhSignatureScheme = RSA_PKCS_1_V15
      SmhSecurityClassDDD = false
      SmhSecurityClassC = false
      SmhSecurityClassVendor = false
      SmhSizeOfVendorChecksum = 1
      SmhCryptographicVerificationKeys = INTERNAL
      SmhDefaultCryptographicKeyClassCPrefix = kSecM_SecretKeyClassC
      SmhDefaultCryptographicKeyClassCCCPrefix = SecM_Rsa
      SmhMonolithicVerification:
        SmhIncludeAddressAndLengthInSignature = true
        SmhSignatureOffset = 2
        SmhSecurityClass = CLASS_CCC
        SmhMemoryAccessMode = ADDRESS
        SmhReadBufferSize = 64
        SmhCRCTotal = false
        SmhCRCWritten = false
        SmhVendorChecksum = false
        SmhCRCOffset = 0
        SmhAssertReadCount = false
        SmhCheckAddressRangeOverflow = false
        SmhExportVerificationWrapper = false
        SmhOperationCountOfWrapper = 4
      SmhStreamVerification: SmhSecurityClass=CLASS_CCC, SmhUpdateLengthOfHashedData=false
    SmhSeedKey:
      SmhKeyConstant = 4294967295
      SmhKeyTimeout = 0
      SmhCallCycle = 10
      SmhAlgorithm = BASIC
      SmhCryptographicSeedKeyKeys = INTERNAL
      SmhDefaultCryptographicSeedKeyKeyPrefix = SecSeedKeyRsa
    SmhEncryption:
      SmhDecryption = false
      SmhEncryption = false
      SmhEncryptionAlgorithm = AES_256
      SmhCryptographicEncryptionKeys = INTERNAL
      SmhDefaultCryptographicEncryptionKeyPrefix = SecM_AES128key
