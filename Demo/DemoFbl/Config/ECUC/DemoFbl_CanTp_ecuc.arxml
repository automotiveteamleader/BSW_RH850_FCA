AUTOSAR XML (schema 4-2-1)
package /ActiveEcuC
  module config CanTp: implementation-config-variant=VARIANT-PRE-COMPILE, module-description=CanTp_Impl
    CanTpGeneral:
      CanTpVersionInfoApi = false
      CanTpHavePaddingByte = false
      CanTpPaddingByte = 0
      CanTpPaddingActive = true
      CanTpSupportExtendedAddressing = false
      CanTpSupportMixed11Addressing = false
      CanTpSupportStandardAddressing = true
      CanTpChangeParameterApi = false
      CanTpDevErrorDetect = false
      CanTpReadParameterApi = false
      CanTpNumRxChannels = 0
      CanTpNumTxChannels = 0
      CanTpEnableSplitMainFunction = false
      CanTpOnlyNotifyInformedAppl = true
      CanTpRc = false
      CanTpTc = false
      CanTpSafeBswChecks = false
      CanTpEnableSynchronousTransmit = true
      CanTpSupportLongFirstFrames = true
      CanTpFlexibleDataRateSupport = true
    CanTpConfig: CanTpMainFunctionPeriod=0.005
      4 x CanTpChannel, all with CanTpChannelMode=CANTP_MODE_FULL_DUPLEX:
        TPCH_d566c89d
          RxNSdu_d566c89d (CanTpRxNSdu):
            CanTpRxAddressingFormat = CANTP_STANDARD
            CanTpRxDl = 64
            CanTpRxTaType = CANTP_CANFD_PHYSICAL
            CanTpNbr = 0.1
            CanTpRxNSduId = 3
            CanTpRxPaddingActivation = CANTP_ON
            CanTpBs = 0
            CanTpNar = 0.1
            CanTpNcr = 0.5
            CanTpRxWftMax = 15
            CanTpSTmin = 0
            CanTpRxNSduRef = PT_Demo_0_CAN_FD_Request_PP_Demo_0_CAN_FD_Request_Rx_eac1789b_411010d2
            CanTpTxFcNPdu_9121fb27 (CanTpTxFcNPdu): CanTpTxFcNPduConfirmationPduId=1, CanTpTxFcNPduRef=PT_Demo_0_CAN_FD_Response_Tp_PP_Demo_0_CAN_FD_Response_Tp_Tx_eac1789b_411010d2
            CanTpRxNPdu_9121fb27 (CanTpRxNPdu): CanTpRxNPduId=1, CanTpRxNPduRef=PT_Demo_0_CAN_FD_Request_Tp_PP_Demo_0_CAN_FD_Request_Tp_Rx_eac1789b_411010d2
          TxNSdu_662a6d46 (CanTpTxNSdu):
            CanTpTxAddressingFormat = CANTP_STANDARD
            CanTpTxDl = 64
            CanTpTxTaType = CANTP_CANFD_PHYSICAL
            CanTpNas = 0.1
            CanTpNcs = 0.2
            CanTpTc = false
            CanTpTxNSduId = 1
            CanTpTxPaddingActivation = CANTP_ON
            CanTpNbs = 0.5
            CanTpTxNSduRef = PT_Demo_0_CAN_FD_Response_PP_Demo_0_CAN_FD_Response_Tx_eac1789b_411010d2
            CanTpRxFcNPdu_d3c985a1 (CanTpRxFcNPdu): CanTpRxFcNPduId=1, CanTpRxFcNPduRef=PT_Demo_0_CAN_FD_Request_Tp_PP_Demo_0_CAN_FD_Request_Tp_Rx_eac1789b_411010d2
            CanTpTxNPdu_d3c985a1 (CanTpTxNPdu): CanTpTxNPduConfirmationPduId=1, CanTpTxNPduRef=PT_Demo_0_CAN_FD_Response_Tp_PP_Demo_0_CAN_FD_Response_Tp_Tx_eac1789b_411010d2
        TPCH_702373df
          TxNSdu_92a41219 (CanTpTxNSdu):
            CanTpTxAddressingFormat = CANTP_STANDARD
            CanTpTxDl = 8
            CanTpTxTaType = CANTP_PHYSICAL
            CanTpNas = 0.1
            CanTpNcs = 0.2
            CanTpTc = false
            CanTpTxNSduId = 0
            CanTpTxPaddingActivation = CANTP_ON
            CanTpNbs = 0.5
            CanTpTxNSduRef = PT_Demo_0_CAN_20_Response_PP_Demo_0_CAN_20_Response_Tx_eac1789b_411010d2
            CanTpRxFcNPdu_595562da (CanTpRxFcNPdu): CanTpRxFcNPduId=0, CanTpRxFcNPduRef=PT_Demo_0_CAN_20_Request_Tp_PP_Demo_0_CAN_20_Request_Tp_Rx_eac1789b_411010d2
            CanTpTxNPdu_595562da (CanTpTxNPdu): CanTpTxNPduConfirmationPduId=0, CanTpTxNPduRef=PT_Demo_0_CAN_20_Response_Tp_PP_Demo_0_CAN_20_Response_Tp_Tx_eac1789b_411010d2
          RxNSdu_702373df (CanTpRxNSdu):
            CanTpRxAddressingFormat = CANTP_STANDARD
            CanTpRxDl = 8
            CanTpRxTaType = CANTP_PHYSICAL
            CanTpNbr = 0.1
            CanTpRxNSduId = 2
            CanTpRxPaddingActivation = CANTP_ON
            CanTpBs = 0
            CanTpNar = 0.1
            CanTpNcr = 0.5
            CanTpRxWftMax = 15
            CanTpSTmin = 0
            CanTpRxNSduRef = PT_Demo_0_CAN_20_Request_PP_Demo_0_CAN_20_Request_Rx_eac1789b_411010d2
            CanTpRxNPdu_17d55594 (CanTpRxNPdu): CanTpRxNPduId=0, CanTpRxNPduRef=PT_Demo_0_CAN_20_Request_Tp_PP_Demo_0_CAN_20_Request_Tp_Rx_eac1789b_411010d2
            CanTpTxFcNPdu_17d55594 (CanTpTxFcNPdu): CanTpTxFcNPduConfirmationPduId=0, CanTpTxFcNPduRef=PT_Demo_0_CAN_20_Response_Tp_PP_Demo_0_CAN_20_Response_Tp_Tx_eac1789b_411010d2
        TPCH_0c51c5f0
          RxNSdu_0c51c5f0 (CanTpRxNSdu):
            CanTpRxAddressingFormat = CANTP_STANDARD
            CanTpRxDl = 64
            CanTpRxTaType = CANTP_CANFD_FUNCTIONAL
            CanTpNbr = 0.1
            CanTpRxNSduId = 0
            CanTpRxPaddingActivation = CANTP_ON
            CanTpRxNSduRef = PT_Functional_CAN_FD_PP_Functional_CAN_FD_Rx_eac1789b_411010d2
            CanTpRxNPdu_271757d8 (CanTpRxNPdu): CanTpRxNPduId=3, CanTpRxNPduRef=PT_Functional_CAN_FD_Tp_PP_Functional_CAN_FD_Tp_Rx_eac1789b_411010d2
        TPCH_195dc61f
          RxNSdu_195dc61f (CanTpRxNSdu):
            CanTpRxAddressingFormat = CANTP_STANDARD
            CanTpRxDl = 8
            CanTpRxTaType = CANTP_FUNCTIONAL
            CanTpNbr = 0.1
            CanTpRxNSduId = 1
            CanTpRxPaddingActivation = CANTP_ON
            CanTpRxNSduRef = PT_Functional_CAN_20_PP_Functional_CAN_20_Rx_eac1789b_411010d2
            CanTpRxNPdu_0f47f63e (CanTpRxNPdu): CanTpRxNPduId=2, CanTpRxNPduRef=PT_Functional_CAN_20_Tp_PP_Functional_CAN_20_Tp_Rx_eac1789b_411010d2
