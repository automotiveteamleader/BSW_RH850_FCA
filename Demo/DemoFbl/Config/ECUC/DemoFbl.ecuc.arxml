AUTOSAR XML (schema 4-2-1)
package /ActiveEcuC
  ecuc value collection ActiveEcuC: ecuc-values=[Det, Mcu, CanIf, CanTp, Can, Dcm, EcuC, FblHal, Fbl, Os, PduR, Smh, NvM, Fls, Fee, Dem, MemIf, Crc]
