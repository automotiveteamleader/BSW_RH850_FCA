AUTOSAR XML (schema 4-2-1)
package /InitialEcuC
  ecuc value collection InitialEcuC: ecuc-values=[Can, CanIf, CanSM, CanTp, ComM, Dcm, EcuC, EcuM, PduR]
  module config Can
    CanConfigSet
      CT_DemoFBL_Fca_SLP5_7d368945 (CanController):
        CanControllerActivation = true
        CanControllerDefaultBaudrate = CanControllerBaudrateConfig
        CanControllerSystemRef = CT_DemoFBL_Fca_SLP5
        CanWakeupSourceRef = EcuMCommonConfiguration/CN_DemoFBL_Fca_SLP5_411010d2
        CanControllerBaudrateConfig
      CN_DemoFBL_Fca_SLP5_28de45c0_Rx (CanHardwareObject): CanHandleType=BASIC, CanIdType=EXTENDED, CanIdValue=0, CanObjectType=RECEIVE, CanControllerRef=CanConfigSet/CT_DemoFBL_Fca_SLP5_7d368945
      CN_DemoFBL_Fca_SLP5_411010d2_Tx (CanHardwareObject): CanHandleType=BASIC, CanIdValue=0, CanObjectType=TRANSMIT, CanControllerRef=CanConfigSet/CT_DemoFBL_Fca_SLP5_7d368945
    CanGeneral: CanIndex=0
  module config CanIf
    CanIfCtrlDrvCfg_7d254554 (CanIfCtrlDrvCfg): CanIfCtrlDrvInitHohConfigRef=CanIfInitHohCfg, CanIfCtrlDrvNameRef=CanGeneral
      CT_DemoFBL_Fca_SLP5_7d368945 (CanIfCtrlCfg): CanIfCtrlCanCtrlRef=CanConfigSet/CT_DemoFBL_Fca_SLP5_7d368945
    CanIfInitCfg
      CHNL_eac1789b (CanIfBufferCfg): CanIfBufferSize=0, CanIfBufferHthRef=CanIfInitHohCfg/CN_DemoFBL_Fca_SLP5_411010d2_Tx
      CanIfInitHohCfg: CanIfInitRefCfgSet=CanConfigSet
        CN_DemoFBL_Fca_SLP5_28de45c0_Rx (CanIfHrhCfg): CanIfHrhCanCtrlIdRef=CanIfCtrlDrvCfg_7d254554/CT_DemoFBL_Fca_SLP5_7d368945, CanIfHrhIdSymRef=CanConfigSet/CN_DemoFBL_Fca_SLP5_28de45c0_Rx
        CN_DemoFBL_Fca_SLP5_411010d2_Tx (CanIfHthCfg): CanIfHthCanCtrlIdRef=CanIfCtrlDrvCfg_7d254554/CT_DemoFBL_Fca_SLP5_7d368945, CanIfHthIdSymRef=CanConfigSet/CN_DemoFBL_Fca_SLP5_411010d2_Tx
      4 x CanIfRxPduCfg, all with CanIfRxPduUserRxIndicationName=CanTp_RxIndication, CanIfRxPduUserRxIndicationType=PDUID_PDUINFOPTR, CanIfRxPduUserRxIndicationUL=CAN_TP, CanIfRxPduHrhIdRef=CanIfInitHohCfg/CN_DemoFBL_Fca_SLP5_28de45c0_Rx:
        Demo_0_CAN_20_Request_Tp_oDemoFBL_Fca_SLP5_c5bb94c7_Rx: CanIfRxPduCanId=416991217, CanIfRxPduCanIdType=EXTENDED_NO_FD_CAN, CanIfRxPduDlc=8, CanIfRxPduRef=Demo_0_CAN_20_Request_Tp_oDemoFBL_Fca_SLP5_3c7378f4_Rx
        Demo_0_CAN_FD_Request_Tp_oDemoFBL_Fca_SLP5_68bd9369_Rx: CanIfRxPduCanId=416991218, CanIfRxPduCanIdType=EXTENDED_FD_CAN, CanIfRxPduDlc=64, CanIfRxPduRef=Demo_0_CAN_FD_Request_Tp_oDemoFBL_Fca_SLP5_480939e9_Rx
        Functional_CAN_20_Tp_oDemoFBL_Fca_SLP5_a7d6d1c2_Rx: CanIfRxPduCanId=417070833, CanIfRxPduCanIdType=EXTENDED_NO_FD_CAN, CanIfRxPduDlc=8, CanIfRxPduRef=Functional_CAN_20_Tp_oDemoFBL_Fca_SLP5_eb3d9211_Rx
        Functional_CAN_FD_Tp_oDemoFBL_Fca_SLP5_1bf053ab_Rx: CanIfRxPduCanId=417070834, CanIfRxPduCanIdType=EXTENDED_FD_CAN, CanIfRxPduDlc=64, CanIfRxPduRef=Functional_CAN_FD_Tp_oDemoFBL_Fca_SLP5_ea53ce90_Rx
      Demo_0_CAN_20_Response_Tp_oDemoFBL_Fca_SLP5_08376071_Tx (CanIfTxPduCfg):
        CanIfTxPduCanId = 417001927
        CanIfTxPduCanIdType = EXTENDED_CAN
        CanIfTxPduDlc = 8
        CanIfTxPduUserTxConfirmationName = CanTp_TxConfirmation
        CanIfTxPduUserTxConfirmationUL = CAN_TP
        CanIfTxPduBufferRef = CanIfInitCfg/CHNL_eac1789b
        CanIfTxPduRef = Demo_0_CAN_20_Response_Tp_oDemoFBL_Fca_SLP5_547823d6_Tx
      Demo_0_CAN_FD_Response_Tp_oDemoFBL_Fca_SLP5_7e3956da_Tx (CanIfTxPduCfg):
        CanIfTxPduCanId = 417002183
        CanIfTxPduCanIdType = EXTENDED_FD_CAN
        CanIfTxPduDlc = 64
        CanIfTxPduUserTxConfirmationName = CanTp_TxConfirmation
        CanIfTxPduUserTxConfirmationUL = CAN_TP
        CanIfTxPduBufferRef = CanIfInitCfg/CHNL_eac1789b
        CanIfTxPduRef = Demo_0_CAN_FD_Response_Tp_oDemoFBL_Fca_SLP5_370a354e_Tx
    CanIfPrivateCfg: CanIfPrivateSoftwareFilterType=LINEAR
    CanIfPublicCfg: CanIfPublicPnSupport=false
  module config CanSM
    CanSMConfiguration
      CHNL_eac1789b (CanSMManagerNetwork): CanSMComMNetworkHandleRef=ComMConfigSet/CN_DemoFBL_Fca_SLP5_411010d2
        CT_DemoFBL_Fca_SLP5_b9cc7459 (CanSMController): CanSMControllerId=CanIfCtrlDrvCfg_7d254554/CT_DemoFBL_Fca_SLP5_7d368945
  module config CanTp
    CanTpConfig: CanTpMainFunctionPeriod=0.005
      4 x CanTpChannel, all with CanTpChannelMode=CANTP_MODE_FULL_DUPLEX:
        TPCH_2cf8b8b0
          CanTpRxNSdu_7ae70fe5 (CanTpRxNSdu):
            CanTpRxAddressingFormat = CANTP_STANDARD
            CanTpRxDl = 64
            CanTpRxTaType = CANTP_CANFD_FUNCTIONAL
            CanTpRxNSduRef = EcucPduCollection/Functional_CAN_FD_oDemoFBL_Fca_SLP5_a6dc7e27_Rx
            CanTpRxNPdu_d1898b63 (CanTpRxNPdu): CanTpRxNPduRef=Functional_CAN_FD_Tp_oDemoFBL_Fca_SLP5_ea53ce90_Rx
        TPCH_46f8a582
          CanTpRxNSdu_7952283d (CanTpRxNSdu):
            CanTpRxAddressingFormat = CANTP_STANDARD
            CanTpRxDl = 8
            CanTpRxTaType = CANTP_PHYSICAL
            CanTpRxNSduRef = EcucPduCollection/Demo_0_CAN_20_Request_oDemoFBL_Fca_SLP5_b0deeb0c_Rx
            CanTpRxNPdu_115c0373 (CanTpRxNPdu): CanTpRxNPduRef=Demo_0_CAN_20_Request_Tp_oDemoFBL_Fca_SLP5_3c7378f4_Rx
            CanTpTxFcNPdu_115c0373 (CanTpTxFcNPdu): CanTpTxFcNPduRef=Demo_0_CAN_20_Response_Tp_oDemoFBL_Fca_SLP5_547823d6_Tx
          CanTpTxNSdu_7952283d (CanTpTxNSdu):
            CanTpTxAddressingFormat = CANTP_STANDARD
            CanTpTxDl = 8
            CanTpTxTaType = CANTP_PHYSICAL
            CanTpTxNSduRef = EcucPduCollection/Demo_0_CAN_20_Response_oDemoFBL_Fca_SLP5_a79390eb_Tx
            CanTpRxFcNPdu_33a6d781 (CanTpRxFcNPdu): CanTpRxFcNPduRef=Demo_0_CAN_20_Request_Tp_oDemoFBL_Fca_SLP5_3c7378f4_Rx
            CanTpTxNPdu_33a6d781 (CanTpTxNPdu): CanTpTxNPduRef=Demo_0_CAN_20_Response_Tp_oDemoFBL_Fca_SLP5_547823d6_Tx
        TPCH_e6e4d627
          CanTpRxNSdu_1ca716a4 (CanTpRxNSdu):
            CanTpRxAddressingFormat = CANTP_STANDARD
            CanTpRxDl = 64
            CanTpRxTaType = CANTP_CANFD_PHYSICAL
            CanTpRxNSduRef = EcucPduCollection/Demo_0_CAN_FD_Request_oDemoFBL_Fca_SLP5_e6d1155f_Rx
            CanTpRxNPdu_0b7d7ddf (CanTpRxNPdu): CanTpRxNPduRef=Demo_0_CAN_FD_Request_Tp_oDemoFBL_Fca_SLP5_480939e9_Rx
            CanTpTxFcNPdu_0b7d7ddf (CanTpTxFcNPdu): CanTpTxFcNPduRef=Demo_0_CAN_FD_Response_Tp_oDemoFBL_Fca_SLP5_370a354e_Tx
          CanTpTxNSdu_1ca716a4 (CanTpTxNSdu):
            CanTpTxAddressingFormat = CANTP_STANDARD
            CanTpTxDl = 64
            CanTpTxTaType = CANTP_CANFD_PHYSICAL
            CanTpTxNSduRef = EcucPduCollection/Demo_0_CAN_FD_Response_oDemoFBL_Fca_SLP5_55a79f5b_Tx
            CanTpRxFcNPdu_2987a92d (CanTpRxFcNPdu): CanTpRxFcNPduRef=Demo_0_CAN_FD_Request_Tp_oDemoFBL_Fca_SLP5_480939e9_Rx
            CanTpTxNPdu_2987a92d (CanTpTxNPdu): CanTpTxNPduRef=Demo_0_CAN_FD_Response_Tp_oDemoFBL_Fca_SLP5_370a354e_Tx
        TPCH_e7dbd7aa
          CanTpRxNSdu_d48364bf (CanTpRxNSdu):
            CanTpRxAddressingFormat = CANTP_STANDARD
            CanTpRxDl = 8
            CanTpRxTaType = CANTP_FUNCTIONAL
            CanTpRxNSduRef = EcucPduCollection/Functional_CAN_20_oDemoFBL_Fca_SLP5_8c55b93d_Rx
            CanTpRxNPdu_c28cd0a1 (CanTpRxNPdu): CanTpRxNPduRef=Functional_CAN_20_Tp_oDemoFBL_Fca_SLP5_eb3d9211_Rx
  module config ComM
    ComMConfigSet: ComMPncEnabled=false
      CN_DemoFBL_Fca_SLP5_411010d2 (ComMChannel): ComMBusType=COMM_BUS_TYPE_CAN, ComMChannelId=0
        ComMNetworkManagement: ComMNmVariant=NONE
        CN_DemoFBL_Fca_SLP5_2ed0d503 (ComMUserPerChannel): ComMUserChannel=CN_DemoFBL_Fca_SLP5_6c72588f
      CN_DemoFBL_Fca_SLP5_6c72588f (ComMUser): ComMUserIdentifier=0
    ComMGeneral: ComMPncSupport=false
  module config Dcm
    DcmConfigSet
      DcmDsl
        DcmDslProtocol
          DcmDslProtocolRow_29812fbf (DcmDslProtocolRow)
            DcmDslConnection_75643283 (DcmDslConnection)
              DcmDslMainConnection
                Demo_0_CAN_20_Request_oDemoFBL_Fca_SLP5_efbaf492_Rx_56faa4be (DcmDslProtocolRx):
                  DcmDslProtocolRxAddrType = DCM_PHYSICAL_TYPE
                  DcmDslProtocolRxPduId = 1
                  DcmDslProtocolRxComMChannelRef = ComMConfigSet/CN_DemoFBL_Fca_SLP5_411010d2
                  DcmDslProtocolRxPduRef = Demo_0_CAN_20_Request_oDemoFBL_Fca_SLP5_efbaf492_Rx
                Functional_CAN_20_oDemoFBL_Fca_SLP5_a47e1555_Rx_953e507a (DcmDslProtocolRx):
                  DcmDslProtocolRxAddrType = DCM_FUNCTIONAL_TYPE
                  DcmDslProtocolRxPduId = 2
                  DcmDslProtocolRxComMChannelRef = ComMConfigSet/CN_DemoFBL_Fca_SLP5_411010d2
                  DcmDslProtocolRxPduRef = Functional_CAN_20_oDemoFBL_Fca_SLP5_a47e1555_Rx
                Demo_0_CAN_20_Response_oDemoFBL_Fca_SLP5_0ba2acef_Tx_0999f686 (DcmDslProtocolTx): DcmDslTxConfirmationPduId=0, DcmDslProtocolTxPduRef=EcucPduCollection/Demo_0_CAN_20_Response_oDemoFBL_Fca_SLP5_0ba2acef_Tx
            DcmDslConnection_ee2e78f1 (DcmDslConnection)
              DcmDslMainConnection
                Demo_0_CAN_FD_Request_oDemoFBL_Fca_SLP5_888d0879_Rx_ba94451d (DcmDslProtocolRx):
                  DcmDslProtocolRxAddrType = DCM_PHYSICAL_TYPE
                  DcmDslProtocolRxPduId = 4
                  DcmDslProtocolRxComMChannelRef = ComMConfigSet/CN_DemoFBL_Fca_SLP5_411010d2
                  DcmDslProtocolRxPduRef = Demo_0_CAN_FD_Request_oDemoFBL_Fca_SLP5_888d0879_Rx
                Functional_CAN_FD_oDemoFBL_Fca_SLP5_b4f709e0_Rx_5eff7b81 (DcmDslProtocolRx):
                  DcmDslProtocolRxAddrType = DCM_FUNCTIONAL_TYPE
                  DcmDslProtocolRxPduId = 5
                  DcmDslProtocolRxComMChannelRef = ComMConfigSet/CN_DemoFBL_Fca_SLP5_411010d2
                  DcmDslProtocolRxPduRef = Functional_CAN_FD_oDemoFBL_Fca_SLP5_b4f709e0_Rx
                Demo_0_CAN_FD_Response_oDemoFBL_Fca_SLP5_3c1da0e3_Tx_d2d667ae (DcmDslProtocolTx): DcmDslTxConfirmationPduId=3, DcmDslProtocolTxPduRef=EcucPduCollection/Demo_0_CAN_FD_Response_oDemoFBL_Fca_SLP5_3c1da0e3_Tx
  module config EcuC
    EcucPduCollection: PduIdTypeEnum=UINT8, PduLengthTypeEnum=UINT8
      18 x Pdu:
        Demo_0_CAN_20_Request_Tp_oDemoFBL_Fca_SLP5_3c7378f4_Rx: PduLength=8, SysTPduToFrameMappingRef=Demo_0_CAN_20_Request_Tp
        Demo_0_CAN_20_Request_oDemoFBL_Fca_SLP5_b0deeb0c_Rx: PduLength=8
        Demo_0_CAN_20_Request_oDemoFBL_Fca_SLP5_efbaf492_Rx: PduLength=8
        Demo_0_CAN_20_Response_Tp_oDemoFBL_Fca_SLP5_547823d6_Tx: PduLength=8, SysTPduToFrameMappingRef=Demo_0_CAN_20_Response_Tp
        Demo_0_CAN_20_Response_oDemoFBL_Fca_SLP5_0ba2acef_Tx: PduLength=8
        Demo_0_CAN_20_Response_oDemoFBL_Fca_SLP5_a79390eb_Tx: PduLength=8
        Demo_0_CAN_FD_Request_Tp_oDemoFBL_Fca_SLP5_480939e9_Rx: PduLength=64, SysTPduToFrameMappingRef=Demo_0_CAN_FD_Request_Tp
        Demo_0_CAN_FD_Request_oDemoFBL_Fca_SLP5_888d0879_Rx: PduLength=64
        Demo_0_CAN_FD_Request_oDemoFBL_Fca_SLP5_e6d1155f_Rx: PduLength=64
        Demo_0_CAN_FD_Response_Tp_oDemoFBL_Fca_SLP5_370a354e_Tx: PduLength=64, SysTPduToFrameMappingRef=Demo_0_CAN_FD_Response_Tp
        Demo_0_CAN_FD_Response_oDemoFBL_Fca_SLP5_3c1da0e3_Tx: PduLength=64
        Demo_0_CAN_FD_Response_oDemoFBL_Fca_SLP5_55a79f5b_Tx: PduLength=64
        Functional_CAN_20_Tp_oDemoFBL_Fca_SLP5_eb3d9211_Rx: PduLength=8, SysTPduToFrameMappingRef=Functional_CAN_20_Tp
        Functional_CAN_20_oDemoFBL_Fca_SLP5_8c55b93d_Rx: PduLength=7
        Functional_CAN_20_oDemoFBL_Fca_SLP5_a47e1555_Rx: PduLength=7
        Functional_CAN_FD_Tp_oDemoFBL_Fca_SLP5_ea53ce90_Rx: PduLength=64, SysTPduToFrameMappingRef=Functional_CAN_FD_Tp
        Functional_CAN_FD_oDemoFBL_Fca_SLP5_a6dc7e27_Rx: PduLength=62
        Functional_CAN_FD_oDemoFBL_Fca_SLP5_b4f709e0_Rx: PduLength=62
  module config EcuM
    EcuMConfiguration
      EcuMCommonConfiguration
        EcuMDriverInitListOne
        EcuMDriverRestartList
        CN_DemoFBL_Fca_SLP5_411010d2 (EcuMWakeupSource): EcuMWakeupSourceId=5, EcuMComMChannelRef=ComMConfigSet/CN_DemoFBL_Fca_SLP5_411010d2
      EcuMFlexConfiguration: EcuMFlexModuleConfigurationRef=CanConfigSet
  module config PduR
    PduRGeneral
    PduRRoutingTables
      PduRRoutingTable
        6 x PduRRoutingPath:
          Demo_0_CAN_20_Request_oDemoFBL_Fca_SLP5_b0deeb0c_Rx
            Demo_0_CAN_20_Request_oDemoFBL_Fca_SLP5_b0deeb0c_Rx_a6c6d027_Rx (PduRDestPdu): PduRDestPduRef=Demo_0_CAN_20_Request_oDemoFBL_Fca_SLP5_efbaf492_Rx
            PduRSrcPdu_a6c6d027 (PduRSrcPdu): PduRSrcPduRef=EcucPduCollection/Demo_0_CAN_20_Request_oDemoFBL_Fca_SLP5_b0deeb0c_Rx
          Demo_0_CAN_20_Response_oDemoFBL_Fca_SLP5_0ba2acef_Tx
            Demo_0_CAN_20_Response_oDemoFBL_Fca_SLP5_a79390eb_Tx (PduRDestPdu): PduRDestPduRef=EcucPduCollection/Demo_0_CAN_20_Response_oDemoFBL_Fca_SLP5_a79390eb_Tx
            PduRSrcPdu_d82d526c (PduRSrcPdu): PduRSrcPduRef=EcucPduCollection/Demo_0_CAN_20_Response_oDemoFBL_Fca_SLP5_0ba2acef_Tx
          Demo_0_CAN_FD_Request_oDemoFBL_Fca_SLP5_e6d1155f_Rx
            Demo_0_CAN_FD_Request_oDemoFBL_Fca_SLP5_e6d1155f_Rx_6253e517_Rx (PduRDestPdu): PduRDestPduRef=Demo_0_CAN_FD_Request_oDemoFBL_Fca_SLP5_888d0879_Rx
            PduRSrcPdu_6253e517 (PduRSrcPdu): PduRSrcPduRef=EcucPduCollection/Demo_0_CAN_FD_Request_oDemoFBL_Fca_SLP5_e6d1155f_Rx
          Demo_0_CAN_FD_Response_oDemoFBL_Fca_SLP5_3c1da0e3_Tx
            Demo_0_CAN_FD_Response_oDemoFBL_Fca_SLP5_55a79f5b_Tx (PduRDestPdu): PduRDestPduRef=EcucPduCollection/Demo_0_CAN_FD_Response_oDemoFBL_Fca_SLP5_55a79f5b_Tx
            PduRSrcPdu_0362c344 (PduRSrcPdu): PduRSrcPduRef=EcucPduCollection/Demo_0_CAN_FD_Response_oDemoFBL_Fca_SLP5_3c1da0e3_Tx
          Functional_CAN_20_oDemoFBL_Fca_SLP5_8c55b93d_Rx
            Functional_CAN_20_oDemoFBL_Fca_SLP5_8c55b93d_Rx_7c700306_Rx (PduRDestPdu): PduRDestPduRef=Functional_CAN_20_oDemoFBL_Fca_SLP5_a47e1555_Rx
            PduRSrcPdu_7c700306 (PduRSrcPdu): PduRSrcPduRef=EcucPduCollection/Functional_CAN_20_oDemoFBL_Fca_SLP5_8c55b93d_Rx
          Functional_CAN_FD_oDemoFBL_Fca_SLP5_a6dc7e27_Rx
            Functional_CAN_FD_oDemoFBL_Fca_SLP5_a6dc7e27_Rx_c6d69dfd_Rx (PduRDestPdu): PduRDestPduRef=Functional_CAN_FD_oDemoFBL_Fca_SLP5_b4f709e0_Rx
            PduRSrcPdu_c6d69dfd (PduRSrcPdu): PduRSrcPduRef=EcucPduCollection/Functional_CAN_FD_oDemoFBL_Fca_SLP5_a6dc7e27_Rx
