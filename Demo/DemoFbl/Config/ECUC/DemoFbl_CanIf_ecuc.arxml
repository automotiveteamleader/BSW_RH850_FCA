AUTOSAR XML (schema 4-2-1)
package /ActiveEcuC
  module config CanIf: implementation-config-variant=VARIANT-PRE-COMPILE, module-description=CanIf_Impl
    CanIfDispatchCfg:
      CanIfDispatchUserCtrlBusOffName = FblCw_ControllerBusOff
      CanIfDispatchUserCtrlBusOffUL = CDD
      CanIfDispatchUserCtrlModeIndicationName = FblCw_ControllerModeIndication
      CanIfDispatchUserCtrlModeIndicationUL = CDD
    Can (CanIfCtrlDrvCfg): CanIfCtrlDrvTxCancellation=false, CanIfCtrlDrvInitHohConfigRef=CanIfInitHohCfg, CanIfCtrlDrvNameRef=CanGeneral
      CT_DemoFBL_Fca_SLP5_01db1962 (CanIfCtrlCfg): CanIfCtrlId=0, CanIfCtrlWakeupSupport=false, CanIfCtrlJ1939DynAddrSupport=DISABLED, CanIfCtrlCanCtrlRef=CT_DemoFBL_Fca_SLP5_01db1962
    CanIfInitCfg
      Demo_0_CAN_FD_Request_Tp_oDemoFBL_Fca_SLP5_Rx_3abd61be (CanIfRxPduCfg):
        CanIfRxPduCanId = 416991218
        CanIfRxPduCanIdType = EXTENDED_FD_CAN
        CanIfRxPduDlc = 8
        CanIfRxPduUserRxIndicationName = CanTp_RxIndication
        CanIfRxPduUserRxIndicationType = PDUID_PDUINFOPTR
        CanIfRxPduUserRxIndicationUL = CAN_TP
        CanIfRxPduId = 2
        CanIfRxPduReadData = false
        CanIfRxPduReadNotifyStatus = false
        CanIfRxPduDlcCheck = true
        CanIfRxPduHrhIdRef = CN_DemoFBL_Fca_SLP5_01db1962_Rx_Ext
        CanIfRxPduRef = PT_Demo_0_CAN_FD_Request_Tp_PP_Demo_0_CAN_FD_Request_Tp_Rx_eac1789b_411010d2
      CanIfBufferCfg_eac1789b (CanIfBufferCfg):  # CHNL
        CanIfBufferSize = 2
        CanIfTxBufferHandlingType = PRIO_BY_CANID
        CanIfTxBufferMappedTxPdus = 2
        CanIfTxBufferMaxPduLength = 64
        CanIfBufferHthRef = CN_DemoFBL_Fca_SLP5_01db1962_Tx
      CanIfInitHohCfg: CanIfInitRefCfgSet=CanConfigSet
        CN_DemoFBL_Fca_SLP5_01db1962_Rx_Ext (CanIfHrhCfg): CanIfHrhSoftwareFilter=true, CanIfHrhCanCtrlIdRef=CT_DemoFBL_Fca_SLP5_01db1962, CanIfHrhIdSymRef=CN_DemoFBL_Fca_SLP5_01db1962_Rx_Ext
        CN_DemoFBL_Fca_SLP5_01db1962_Tx (CanIfHthCfg): CanIfHthCanCtrlIdRef=CT_DemoFBL_Fca_SLP5_01db1962, CanIfHthIdSymRef=CN_DemoFBL_Fca_SLP5_01db1962_Tx
      Functional_CAN_20_Tp_oDemoFBL_Fca_SLP5_Rx_3abd61be (CanIfRxPduCfg):
        CanIfRxPduCanId = 417070833
        CanIfRxPduCanIdType = EXTENDED_NO_FD_CAN
        CanIfRxPduDlc = 8
        CanIfRxPduUserRxIndicationName = CanTp_RxIndication
        CanIfRxPduUserRxIndicationType = PDUID_PDUINFOPTR
        CanIfRxPduUserRxIndicationUL = CAN_TP
        CanIfRxPduId = 1
        CanIfRxPduReadData = false
        CanIfRxPduReadNotifyStatus = false
        CanIfRxPduDlcCheck = true
        CanIfRxPduHrhIdRef = CN_DemoFBL_Fca_SLP5_01db1962_Rx_Ext
        CanIfRxPduRef = PT_Functional_CAN_20_Tp_PP_Functional_CAN_20_Tp_Rx_eac1789b_411010d2
      Demo_0_CAN_FD_Response_Tp_oDemoFBL_Fca_SLP5_Tx_3abd61be (CanIfTxPduCfg):
        CanIfTxPduCanId = 417002183
        CanIfTxPduCanIdType = EXTENDED_FD_CAN
        CanIfTxPduDlc = 64
        CanIfTxPduUserTxConfirmationName = CanTp_TxConfirmation
        CanIfTxPduUserTxConfirmationUL = CAN_TP
        CanIfTxPduId = 0
        CanIfTxPduReadNotifyStatus = false
        CanIfTxPduType = STATIC
        CanIfTxPduBufferRef = CanIfBufferCfg_eac1789b
        CanIfTxPduRef = PT_Demo_0_CAN_FD_Response_Tp_PP_Demo_0_CAN_FD_Response_Tp_Tx_eac1789b_411010d2
      Demo_0_CAN_20_Request_Tp_oDemoFBL_Fca_SLP5_Rx_3abd61be (CanIfRxPduCfg):
        CanIfRxPduCanId = 416991217
        CanIfRxPduCanIdType = EXTENDED_NO_FD_CAN
        CanIfRxPduDlc = 8
        CanIfRxPduUserRxIndicationName = CanTp_RxIndication
        CanIfRxPduUserRxIndicationType = PDUID_PDUINFOPTR
        CanIfRxPduUserRxIndicationUL = CAN_TP
        CanIfRxPduId = 3
        CanIfRxPduReadData = false
        CanIfRxPduReadNotifyStatus = false
        CanIfRxPduDlcCheck = true
        CanIfRxPduHrhIdRef = CN_DemoFBL_Fca_SLP5_01db1962_Rx_Ext
        CanIfRxPduRef = PT_Demo_0_CAN_20_Request_Tp_PP_Demo_0_CAN_20_Request_Tp_Rx_eac1789b_411010d2
      Demo_0_CAN_20_Response_Tp_oDemoFBL_Fca_SLP5_Tx_3abd61be (CanIfTxPduCfg):
        CanIfTxPduCanId = 417001927
        CanIfTxPduCanIdType = EXTENDED_CAN
        CanIfTxPduDlc = 8
        CanIfTxPduUserTxConfirmationName = CanTp_TxConfirmation
        CanIfTxPduUserTxConfirmationUL = CAN_TP
        CanIfTxPduId = 1
        CanIfTxPduReadNotifyStatus = false
        CanIfTxPduType = STATIC
        CanIfTxPduBufferRef = CanIfBufferCfg_eac1789b
        CanIfTxPduRef = PT_Demo_0_CAN_20_Response_Tp_PP_Demo_0_CAN_20_Response_Tp_Tx_eac1789b_411010d2
      Functional_CAN_FD_Tp_oDemoFBL_Fca_SLP5_Rx_3abd61be (CanIfRxPduCfg):
        CanIfRxPduCanId = 417070834
        CanIfRxPduCanIdType = EXTENDED_FD_CAN
        CanIfRxPduDlc = 8
        CanIfRxPduUserRxIndicationName = CanTp_RxIndication
        CanIfRxPduUserRxIndicationType = PDUID_PDUINFOPTR
        CanIfRxPduUserRxIndicationUL = CAN_TP
        CanIfRxPduId = 0
        CanIfRxPduReadData = false
        CanIfRxPduReadNotifyStatus = false
        CanIfRxPduDlcCheck = true
        CanIfRxPduHrhIdRef = CN_DemoFBL_Fca_SLP5_01db1962_Rx_Ext
        CanIfRxPduRef = PT_Functional_CAN_FD_Tp_PP_Functional_CAN_FD_Tp_Rx_eac1789b_411010d2
    CanIfPrivateCfg:
      CanIfPrivateSoftwareFilterType = LINEAR
      CanIfSupportNmOsek = false
      CanIfWakeupSupport = false
      CanIfPrivateDlcCheck = true
      CanIfSupportTTCAN = false
      CanIfTransceiverMapping = false
      CanIfTransceiverHandling = false
      CanIfSupportExtendedIds = true
      CanIfTxBufferType = BYTE_QUEUE
      CanIfOptimizeOneController = true
      CanIfStaticFdTxBufferSupport = true
      CanIfRxSearchConsiderMsgType = true
      CanIfMultipleBasicCANTxObjects = false
      CanIfTxBufferFifoSupport = false
      CanIfSetPduReceptionModeSupport = false
      CanIfDataChecksumRxSupport = false
      CanIfDataChecksumTxSupport = false
    CanIfPublicCfg:
      CanIfPublicPnSupport = false
      CanIfPublicCddHeaderFile = CanIf_Cdd.h
      CanIfPublicCancelTransmitSupport = false
      CanIfPublicDevErrorDetect = false
      CanIfPublicHandleTypeEnum = UINT8
      CanIfPublicMultipleDrvSupport = false
      CanIfPublicNumberOfCanHwUnits = 1
      CanIfPublicReadRxPduDataApi = false
      CanIfPublicReadRxPduNotifyStatusApi = false
      CanIfPublicReadTxPduNotifyStatusApi = false
      CanIfPublicSetDynamicTxIdApi = false
      CanIfPublicTxBuffering = true
      CanIfPublicTxConfirmPollingSupport = false
      CanIfPublicVersionInfoApi = false
      CanIfPublicWakeupCheckValidSupport = false
      CanIfPnWakeupTxPduFilterSupport = false
      CanIfPnTrcvHandlingSupport = false
      CanIfJ1939DynAddrSupport = DISABLED
      CanIfSafeBswChecks = false
      CanIfSetBaudrateApi = false
