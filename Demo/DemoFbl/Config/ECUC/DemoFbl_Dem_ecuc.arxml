AUTOSAR XML (schema 4-2-1)
package /ActiveEcuC
  module config Dem: implementation-config-variant=VARIANT-PRE-COMPILE
    DemConfigSet
      11 x DemEventParameter, all with DemEventKind=DEM_EVENT_KIND_SWC:
        DemEventParameter: DemEventAvailable=false, DemEventId=1
          DemEventClass: DemAgingAllowed=false, DemConsiderPtoStatus=false, DemEventPriority=2, DemFFPrestorageSupported=false, DemOperationCycleRef=DemOperationCycle
            DemDebounceAlgorithmClass
              DemDebounceCounterBased:
                DemDebounceBehavior = DEM_DEBOUNCE_FREEZE
                DemDebounceCounterDecrementStepSize = 1
                DemDebounceCounterFailedThreshold = 127
                DemDebounceCounterIncrementStepSize = 1
                DemDebounceCounterJumpDown = true
                DemDebounceCounterJumpDownValue = 0
                DemDebounceCounterJumpUp = true
                DemDebounceCounterJumpUpValue = 0
                DemDebounceCounterPassedThreshold = -128
                DemDebounceCounterStorage = false
        FLS_E_COMPARE_FAILED: DemEventAvailable=true, DemEventId=5
          DemEventClass: DemAgingAllowed=false, DemConsiderPtoStatus=false, DemEventPriority=2, DemFFPrestorageSupported=false, DemOperationCycleRef=DemOperationCycle
            DemDebounceAlgorithmClass
              DemDebounceMonitorInternal
        FLS_E_ECC_FAILED: DemEventAvailable=true, DemEventId=11
          DemEventClass: DemAgingAllowed=false, DemConsiderPtoStatus=false, DemEventPriority=2, DemFFPrestorageSupported=false, DemOperationCycleRef=DemOperationCycle
            DemDebounceAlgorithmClass
              DemDebounceMonitorInternal
        FLS_E_ERASE_FAILED: DemEventAvailable=false, DemEventId=6
          DemEventClass: DemAgingAllowed=false, DemConsiderPtoStatus=false, DemEventPriority=2, DemFFPrestorageSupported=false, DemOperationCycleRef=DemOperationCycle
            DemDebounceAlgorithmClass
              DemDebounceMonitorInternal
        FLS_E_HW_FAIL: DemEventAvailable=true, DemEventId=7
          DemEventClass: DemAgingAllowed=false, DemConsiderPtoStatus=false, DemEventPriority=2, DemFFPrestorageSupported=false, DemOperationCycleRef=DemOperationCycle
            DemDebounceAlgorithmClass
              DemDebounceMonitorInternal
        MCU_E_POWERDOWN_MODE_FAILURE: DemEventAvailable=true, DemEventId=3
          DemEventClass: DemAgingAllowed=false, DemConsiderPtoStatus=false, DemEventPriority=2, DemFFPrestorageSupported=false, DemOperationCycleRef=DemOperationCycle
            DemDebounceAlgorithmClass
              DemDebounceMonitorInternal
        MCU_E_CLOCK_FAILURE: DemEventAvailable=false, DemEventId=2
          DemEventClass: DemAgingAllowed=false, DemConsiderPtoStatus=false, DemEventPriority=2, DemFFPrestorageSupported=false, DemOperationCycleRef=DemOperationCycle
            DemDebounceAlgorithmClass
              DemDebounceMonitorInternal
        FLS_E_WRITE_FAILED: DemEventAvailable=true, DemEventId=10
          DemEventClass: DemAgingAllowed=false, DemConsiderPtoStatus=false, DemEventPriority=2, DemFFPrestorageSupported=false, DemOperationCycleRef=DemOperationCycle
            DemDebounceAlgorithmClass
              DemDebounceMonitorInternal
        FLS_E_READ_FAILED_DED: DemEventAvailable=true, DemEventId=8
          DemEventClass: DemAgingAllowed=false, DemConsiderPtoStatus=false, DemEventPriority=2, DemFFPrestorageSupported=false, DemOperationCycleRef=DemOperationCycle
            DemDebounceAlgorithmClass
              DemDebounceMonitorInternal
        FLS_E_READ_FAILED: DemEventAvailable=false, DemEventId=9
          DemEventClass: DemAgingAllowed=false, DemConsiderPtoStatus=false, DemEventPriority=2, DemFFPrestorageSupported=false, DemOperationCycleRef=DemOperationCycle
            DemDebounceAlgorithmClass
              DemDebounceMonitorInternal
        MCU_E_WRITE_TIMEOUT_FAILURE: DemEventAvailable=false, DemEventId=4
          DemEventClass: DemAgingAllowed=false, DemConsiderPtoStatus=false, DemEventPriority=2, DemFFPrestorageSupported=false, DemOperationCycleRef=DemOperationCycle
            DemDebounceAlgorithmClass
              DemDebounceMonitorInternal
    DemGeneral:
      DemAgingCycleCounterProcessing = DEM_PROCESS_AGINGCTR_EXTERN
      DemAgingRequieresTestedCycle = false
      DemAvailabilitySupport = DEM_NO_AVAILABILITY
      DemBswErrorBufferSize = 0
      DemClearDTCBehavior = DEM_CLRRESP_VOLATILE
      DemClearDTCLimitation = DEM_ALL_SUPPORTED_DTCS
      DemDataElementDefaultEndianness = LITTLE_ENDIAN
      DemDebounceCounterBasedSupport = true
      DemDebounceTimeBasedSupport = false
      DemDevErrorDetect = false
      DemDtcStatusAvailabilityMask = 255
      DemEnableConditionSupport = false
      DemEventCombinationSupport = DEM_EVCOMB_DISABLED
      DemEventDisplacementStrategy = DEM_DISPLACEMENT_PRIO_OCC
      DemEventMemoryEntryStorageTrigger = DEM_STORAGE_ON_TEST_FAILED
      DemGeneralInterfaceSupport = false
      DemMaxNumberEventEntryMirror = 0
      DemMaxNumberEventEntryPermanent = 0
      DemMaxNumberEventEntryPrimary = 8
      DemMaxNumberEventEntrySecondary = 0
      DemMaxNumberPrestoredFF = 0
      DemOBDSupport = DEM_OBD_NO_OBD_SUPPORT
      DemOccurrenceCounterProcessing = DEM_PROCESS_OCCCTR_TF
      DemOperationCycleStatusStorage = false
      DemPTOSupport = false
      DemResetConfirmedBitOnOverflow = true
      DemStatusBitHandlingTestFailedSinceLastClear = DEM_STATUS_BIT_NORMAL
      DemStatusBitStorageTestFailed = false
      DemStorageConditionSupport = false
      DemSuppressionSupport = DEM_NO_SUPPRESSION
      DemTaskTime = 0.1
      DemTriggerDcmReports = false
      DemTriggerDltReports = false
      DemTriggerFiMReports = false
      DemTriggerMonitorInitBeforeClearOk = false
      DemTypeOfDTCSupported = DEM_DTC_TRANSLATION_ISO15031_6
      DemTypeOfFreezeFrameRecordNumeration = DEM_FF_RECNUM_CALCULATED
      DemVersionInfoApi = false
      DemOperationCycleProcessing = DEM_PROCESS_OPCYC_STATE
      DemOperationCycle: DemOperationCycleAutomaticEnd=false, DemOperationCycleAutostart=false, DemOperationCycleType=DEM_OPCYC_TIME
