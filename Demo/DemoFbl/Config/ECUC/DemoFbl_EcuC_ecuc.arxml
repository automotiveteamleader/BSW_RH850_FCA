AUTOSAR XML (schema 4-2-1)
package /ActiveEcuC
  module config EcuC: implementation-config-variant=VARIANT-PRE-COMPILE, module-description=EcuC_Impl
    EcucPduCollection: PduIdTypeEnum=UINT8, PduLengthTypeEnum=UINT16
      12 x Pdu, all with J1939Requestable=false:
        PT_Functional_CAN_FD_Tp_PP_Functional_CAN_FD_Tp_Rx_eac1789b_411010d2: PduLength=64, SysTPduToFrameMappingRef=Functional_CAN_FD_Tp  # Functional_CAN_FD_Tp_oDemoFBL_Fca_SLP5
        PT_Demo_0_CAN_FD_Request_Tp_PP_Demo_0_CAN_FD_Request_Tp_Rx_eac1789b_411010d2: PduLength=64, SysTPduToFrameMappingRef=Demo_0_CAN_FD_Request_Tp  # Demo_0_CAN_FD_Request_Tp_oDemoFBL_Fca_SLP5
        PT_Functional_CAN_20_Tp_PP_Functional_CAN_20_Tp_Rx_eac1789b_411010d2: PduLength=8, SysTPduToFrameMappingRef=Functional_CAN_20_Tp  # Functional_CAN_20_Tp_oDemoFBL_Fca_SLP5
        PT_Demo_0_CAN_FD_Response_Tp_PP_Demo_0_CAN_FD_Response_Tp_Tx_eac1789b_411010d2: PduLength=64, SysTPduToFrameMappingRef=Demo_0_CAN_FD_Response_Tp  # Demo_0_CAN_FD_Response_Tp_oDemoFBL_Fca_SLP5
        PT_Demo_0_CAN_FD_Response_PP_Demo_0_CAN_FD_Response_Tx_eac1789b_411010d2: PduLength=64  # Demo_0_CAN_FD_Response_oDemoFBL_Fca_SLP5
        PT_Functional_CAN_20_PP_Functional_CAN_20_Rx_eac1789b_411010d2: PduLength=7  # Functional_CAN_20_oDemoFBL_Fca_SLP5
        PT_Demo_0_CAN_20_Response_Tp_PP_Demo_0_CAN_20_Response_Tp_Tx_eac1789b_411010d2: PduLength=8, SysTPduToFrameMappingRef=Demo_0_CAN_20_Response_Tp  # Demo_0_CAN_20_Response_Tp_oDemoFBL_Fca_SLP5
        PT_Demo_0_CAN_20_Request_Tp_PP_Demo_0_CAN_20_Request_Tp_Rx_eac1789b_411010d2: PduLength=8, SysTPduToFrameMappingRef=Demo_0_CAN_20_Request_Tp  # Demo_0_CAN_20_Request_Tp_oDemoFBL_Fca_SLP5
        PT_Demo_0_CAN_FD_Request_PP_Demo_0_CAN_FD_Request_Rx_eac1789b_411010d2: PduLength=64  # Demo_0_CAN_FD_Request_oDemoFBL_Fca_SLP5
        PT_Demo_0_CAN_20_Request_PP_Demo_0_CAN_20_Request_Rx_eac1789b_411010d2: PduLength=8  # Demo_0_CAN_20_Request_oDemoFBL_Fca_SLP5
        PT_Functional_CAN_FD_PP_Functional_CAN_FD_Rx_eac1789b_411010d2: PduLength=62  # Functional_CAN_FD_oDemoFBL_Fca_SLP5
        PT_Demo_0_CAN_20_Response_PP_Demo_0_CAN_20_Response_Tx_eac1789b_411010d2: PduLength=8  # Demo_0_CAN_20_Response_oDemoFBL_Fca_SLP5
    EcucGeneral:
      AtomicVariableAccess = Atomic32BitAccess
      CPUType = CPU32Bit
      SizeOfInt = Size32Bit
      ByteOrder = LITTLE_ENDIAN
      BitOrder = LSB_to_MSB
      AtomicBitAccessInBitfield = false
      SizeOfEnum = Size32Bit
      SizeOfROMPointer = Size32Bit
      SizeOfRAMPointer = Size32Bit
      BitFieldDataType = INT
      StructAlignment = Auto
      ArrayAlignment = Auto
      StructInArrayAlignment = Auto
      DummyFunction = false
      EcuCSafeBswChecks = false
      DummyStatement = true
      DummyStatementKind = SelfAssignment
      ConditionalGenerating = true
      EcucBswImplementationCodeType = EcuCSourceCode
      EcuCUseStdReturnTypeForRte = false
      BswInitialization
        14 x InitFunction:
          Can_InitMemory: Header=Can.h, InitPhase=INIT_MEMORY, ModuleRef=Can
          CanIf_InitMemory: Header=CanIf.h, InitPhase=INIT_MEMORY, ModuleRef=CanIf
          CanTp_Init: Header=CanTp.h, InitPhase=INIT_TWO_TP, ConfigType=CanTp_ConfigType, ConfigPtrName=CanTp_Config_Ptr, ConfigPtrClass=CANTP_INIT_DATA, ModuleRef=CanTp
          Det_InitMemory: Header=Det.h, InitPhase=INIT_MEMORY, ModuleRef=Det
          PduR_Init: Header=PduR.h, InitPhase=INIT_TWO_COM, ConfigType=PduR_PBConfigType, ConfigPtrName=PduR_Config_Ptr, ConfigPtrClass=PDUR_INIT_DATA, ModuleRef=PduR
          Det_Init: Header=Det.h, InitPhase=INIT_ZERO, ConfigType=Det_ConfigType, ConfigPtrName=Det_Config_Ptr, ConfigPtrClass=DET_INIT_DATA, ModuleRef=Det
          CanIf_Init: Header=CanIf.h, InitPhase=INIT_TWO_IF, ConfigType=CanIf_ConfigType, ConfigPtrName=CanIf_Config_Ptr, ConfigPtrClass=CANIF_INIT_DATA, ModuleRef=CanIf
          FblCw_Init: Header=FblCw.h, InitPhase=INIT_TWO_COM, ConfigType=FblCw_ConfigType, ConfigPtrName=FblCw_Config_Ptr, ConfigPtrClass=FBLCW_INIT_DATA, ModuleRef=Dcm
          FblCw_InitMemory: Header=FblCw.h, InitPhase=INIT_MEMORY, ModuleRef=Dcm
          Can_Init: Header=Can.h, InitPhase=INIT_TWO_DRV, ConfigType=Can_ConfigType, ConfigPtrName=Can_Config_Ptr, ConfigPtrClass=CAN_INIT_DATA, ModuleRef=Can
          CanTp_InitMemory: Header=CanTp.h, InitPhase=INIT_MEMORY, ModuleRef=CanTp
          PduR_InitMemory: Header=PduR.h, InitPhase=INIT_MEMORY, ModuleRef=PduR
          Fee_30_SmallSector_Init: Header=Fee_30_SmallSector.h, InitPhase=INIT_TWO_IF, ModuleRef=Fee
          NvM_Init: Header=NvM.h, InitPhase=INIT_TWO_SYS, ModuleRef=NvM
