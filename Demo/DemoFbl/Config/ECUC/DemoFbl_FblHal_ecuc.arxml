AUTOSAR XML (schema 4-2-1)
package /ActiveEcuC
  module config FblHal: implementation-config-variant=VARIANT-LINK-TIME, module-description=FblHal_Impl
    FblHalGeneral:
      FblHalECCSafeRead = false
      FblHalFlashCodeBufferSize = 6700
      FblHalDerivativeSpecificDefines = #define V_COMP_GHS
      FblHalDerivativeSpecificDefines = #define V_COMP_GHS_RH850
      FblHalDerivativeSpecificDefines = #define C_COMP_GHS_RH850_MCAN
      FblHalDerivativeSpecificDefines = #define V_CPU_RH850
      FblHalDerivativeSpecificDefines = #define C_CPUTYPE_32BIT
      FblHalDerivativeSpecificDefines = #define C_CPUTYPE_LITTLEENDIAN
      FblHalDerivativeSpecificDefines = #define V_SUPPRESS_EXTENDED_VERSION_CHECK
      FblHalDerivativeSpecificDefines = #define VGEN_ENABLE_CANFBL
      FblHalDerivativeSpecificDefines = #define V_ENABLE_CAN_ASR_ABSTRACTION
      FblHalDerivativeSpecificDefines = #define C_PROCESSOR_P1M_C
      FblHalDerivativeSpecificDefines = #define V_PROCESSOR_P1M_C
      FblHalTimerClockRef = McuClockReferencePointTimer
    FblHalRh850: FblHalInternalSystemClockRef=McuClockReferencePointFlash
