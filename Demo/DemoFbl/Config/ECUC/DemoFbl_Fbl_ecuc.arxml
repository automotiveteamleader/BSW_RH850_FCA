AUTOSAR XML (schema 4-2-1)
package /ActiveEcuC
  module config Fbl: implementation-config-variant=VARIANT-LINK-TIME, module-description=Fbl_Impl
    FblGeneral:
      FblCommonData = true
      FblDiagnosticBufferSize = 4095
      FblGapFilling = false
      FblInternalMemoryCopy = true
      FblMaximumNumberOfSegments = 10
      FblP2Server = 50
      FblP2StarServer = 5000
      FblProjectState = INTEGRATION
      FblUserConfigFile = $(DpaProjectFolder)\Config\user_config.cfg
      FblVerificationSegmentation = 64
      FblWriteSegmentation = 256
      FblWatchdogService = true
      FblWatchdogTriggerCycle = 1
      FblUnalignedDataTransfer = true
      FblResponseAfterReset = true
      FblOutputVerification = true
      FblSleepMode = false
      FblSleepTime = 300000
      FblStartFunction = true
      FblUserService = true
      FblS3ServerProgrammingSession = 5000
      FblAdaptiveDataTransferRcrrp = false
      FblGatewaySupport = false
      FblInputVerification = false
      FblSuspendDriverOperation = false
      FblVerificationFunction = false
      FblUserRoutine = false
      FblStayInBoot = false
      FblApplicationTimerTask = true
      FblHeaderAddress = 6144
      FblS3ServerExtendedSession = 5000
      FblFillCode = 255
      FblPresencePattern = false
      FblUserSubfunction = false
      FblEncryptionMode = false
      FblCompressionMode = false
      FblDataProcessingBufferSize = 256
      FblProcessedVerification = false
      FblPipelinedVerification = false
      FblPipelinedProgramming = false
      FblFlashDriverUsage = USE_FLASH_DRIVER_FROM_ROM
      FblApplicationStateTask = false
    FblFca: FblAccessDelayTime=1000, FblCheckProgrammingPreconditionsService=true, FblApplicationValidityFlag=true
    FblFlashBlockTable
      30 x FblFlashBlock:
        FblFlashBlock_0: FblFbStartAddress=0, FblFbEndAddress=8191, FblFbDescription=Flash Bank A Block0 (8KB)
        FblFlashBlock_1: FblFbStartAddress=8192, FblFbEndAddress=16383, FblFbDescription=Flash Bank A Block1 (8KB)
        FblFlashBlock_2: FblFbStartAddress=16384, FblFbEndAddress=24575, FblFbDescription=Flash Bank A Block2 (8KB)
        FblFlashBlock_3: FblFbStartAddress=24576, FblFbEndAddress=32767, FblFbDescription=Flash Bank A Block3 (8KB)
        FblFlashBlock_4: FblFbStartAddress=32768, FblFbEndAddress=40959, FblFbDescription=Flash Bank A Block4 (8KB)
        FblFlashBlock_5: FblFbStartAddress=40960, FblFbEndAddress=49151, FblFbDescription=Flash Bank A Block5 (8KB)
        FblFlashBlock_6: FblFbStartAddress=49152, FblFbEndAddress=57343, FblFbDescription=Flash Bank A Block6 (8KB)
        FblFlashBlock_7: FblFbStartAddress=57344, FblFbEndAddress=65535, FblFbDescription=Flash Bank A Block7 (8KB)
        FblFlashBlock_8: FblFbStartAddress=65536, FblFbEndAddress=98303, FblFbDescription=Flash Bank A Block8 (32KB), FblFbMemoryDeviceRef=Flash
        FblFlashBlock_9: FblFbStartAddress=98304, FblFbEndAddress=131071, FblFbDescription=Flash Bank A Block9 (32KB), FblFbMemoryDeviceRef=Flash
        FblFlashBlock_10: FblFbStartAddress=131072, FblFbEndAddress=163839, FblFbDescription=Flash Bank A Block10 (32KB), FblFbMemoryDeviceRef=Flash, FblFbLogicalBlockRef=DemoAppl
        FblFlashBlock_11: FblFbStartAddress=163840, FblFbEndAddress=196607, FblFbDescription=Flash Bank A Block11 (32KB), FblFbMemoryDeviceRef=Flash, FblFbLogicalBlockRef=DemoAppl
        FblFlashBlock_12: FblFbStartAddress=196608, FblFbEndAddress=229375, FblFbDescription=Flash Bank A Block12 (32KB), FblFbMemoryDeviceRef=Flash, FblFbLogicalBlockRef=DemoAppl
        FblFlashBlock_13: FblFbStartAddress=229376, FblFbEndAddress=262143, FblFbDescription=Flash Bank A Block13 (32KB), FblFbMemoryDeviceRef=Flash, FblFbLogicalBlockRef=DemoAppl
        FblFlashBlock_14: FblFbStartAddress=262144, FblFbEndAddress=294911, FblFbDescription=Flash Bank A Block14 (32KB), FblFbMemoryDeviceRef=Flash, FblFbLogicalBlockRef=DemoAppl
        FblFlashBlock_15: FblFbStartAddress=294912, FblFbEndAddress=327679, FblFbDescription=Flash Bank A Block15 (32KB), FblFbMemoryDeviceRef=Flash, FblFbLogicalBlockRef=DemoAppl
        FblFlashBlock_16: FblFbStartAddress=327680, FblFbEndAddress=393215, FblFbDescription=Flash Bank A Block16-17 (64KB), FblFbMemoryDeviceRef=Flash
        FblFlashBlock_17: FblFbStartAddress=393216, FblFbEndAddress=458751, FblFbDescription=Flash Bank A Block18-19 (64KB), FblFbMemoryDeviceRef=Flash
        FblFlashBlock_18: FblFbStartAddress=458752, FblFbEndAddress=524287, FblFbDescription=Flash Bank A Block20-21 (64KB), FblFbMemoryDeviceRef=Flash
        FblFlashBlock_19: FblFbStartAddress=524288, FblFbEndAddress=589823, FblFbDescription=Flash Bank A Block22-23 (64KB), FblFbMemoryDeviceRef=Flash
        FblFlashBlock_20: FblFbStartAddress=589824, FblFbEndAddress=655359, FblFbDescription=Flash Bank A Block24-25 (64KB), FblFbMemoryDeviceRef=Flash
        FblFlashBlock_21: FblFbStartAddress=655360, FblFbEndAddress=720895, FblFbDescription=Flash Bank A Block26-27 (64KB), FblFbMemoryDeviceRef=Flash
        FblFlashBlock_22: FblFbStartAddress=720896, FblFbEndAddress=786431, FblFbDescription=Flash Bank A Block28-29 (64KB), FblFbMemoryDeviceRef=Flash
        FblFlashBlock_23: FblFbStartAddress=786432, FblFbEndAddress=851967, FblFbDescription=Flash Bank A Block30-31 (64KB), FblFbMemoryDeviceRef=Flash
        FblFlashBlock_24: FblFbStartAddress=851968, FblFbEndAddress=917503, FblFbDescription=Flash Bank A Block32-33 (64KB), FblFbMemoryDeviceRef=Flash
        FblFlashBlock_25: FblFbStartAddress=917504, FblFbEndAddress=983039, FblFbDescription=Flash Bank A Block34-35 (64KB), FblFbMemoryDeviceRef=Flash
        FblFlashBlock_26: FblFbStartAddress=983040, FblFbEndAddress=1048575, FblFbDescription=Flash Bank A Block36-37 (64KB), FblFbMemoryDeviceRef=Flash
        FblFlashBlock_63: FblFbStartAddress=16777216, FblFbEndAddress=16809983, FblFbDescription=Extended User Area (32KB), FblFbMemoryDeviceRef=Flash
        FblFlashBlock_64: FblFbStartAddress=4280287232, FblFbEndAddress=4280303615, FblFbDescription=Data Flash Area Block0-255 (16KB)
        FblFlashBlock_65: FblFbStartAddress=4280303616, FblFbEndAddress=4280319999, FblFbDescription=Data Flash Area Block256-511 (16KB)
    FblMemoryDeviceTable
      Flash (FblMemoryDevice): FblMdErasedValue=255, FblMdSegmentSize=256
    FblLogicalBlockTable
      DemoAppl (FblLogicalBlock):
        FblLbBlockIndex = 0
        FblLbBlockType = CODE
        FblLbDisposability = MANDATORY
        FblLbStartAddress = 131072
        FblLbEndAddress = 327679
        FblLbMaxReprogAttempts = 0
        FblLbInputVerification = SecM_VerifySignature
        FblLbProcessedVerification = SecM_VerifySignature
        FblLbPipelinedVerification = SecM_VerifySignature
        FblLbOutputVerification = SecM_Verification
        FblLbDescription = 
