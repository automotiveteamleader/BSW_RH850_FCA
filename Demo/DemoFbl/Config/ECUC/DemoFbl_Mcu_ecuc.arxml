AUTOSAR XML (schema 4-2-1)
package /ActiveEcuC
  module config Mcu: implementation-config-variant=VARIANT-POST-BUILD, module-description=Mcu_Impl
    McuGeneralConfiguration:
      McuVersionCheckExternalModules = false
      McuDevErrorDetect = false
      McuGetRamStateApi = false
      McuInitClock = true
      McuNoPll = true
      McuPerformResetApi = false
      McuVersionInfoApi = false
      McuCriticalSectionProtection = true
      McuSwResetCallApi = false
      McuEcmDelayTimerOverflowValue = 65535
      McuEcmErrorOutputMode = NON_DYNAMIC_MODE
      McuClm0Operation = false
      McuClm0MonitoringClockAccuracy = 0
      McuClm0SamplingClockAccuracy = 6
      McuClm1Operation = false
      McuClm1MonitoringClockAccuracy = 9
      McuClm1SamplingClockAccuracy = 9
      McuClm2Operation = false
      McuClm2MonitoringClockAccuracy = 9
      McuClm2SamplingClockAccuracy = 9
      McuClm3Operation = false
      McuClm3MonitoringClockAccuracy = 9
      McuClm3SamplingClockAccuracy = 9
      McuClm4Operation = false
      McuClm4MonitoringClockAccuracy = 9
      McuClm4SamplingClockAccuracy = 9
      McuClma{0..4}SelfDiagnosticTest = false
      McuLoopCount = 28
      McuEcmRstConfigure = APPLICATION_RESET
      McuRamSectorSetting = false
      McuDeviceName = R7F701372
      McuGTMConfigurationSupport = false
      McuInterruptConsistencyCheck = false
      McuWriteVerify = WV_DISABLE
      McuUseWriteVerifyErrorInterface = false
      McuCvmSelfDiagnosticTest = false
      McuEcmSelfDiagnosticTest = false
      McuLockStepSelfDiagnosticTest = false
    McuPublishedInformation
      McuRstRsnConfSwApplRst: McuResetReason=67
      McuRstRsnConfEthRamEccSedRst: McuResetReason=40
      McuRstRsnConfSafetyMechCompRst: McuResetReason=8
      McuRstRsnConfTempSensorRst: McuResetReason=9
      McuRstRsnConfGRamAddrOvfRst: McuResetReason=28
      McuRstRsnConfLRamEccSedRst: McuResetReason=34
      McuRstRsnConfFlsFaciRst: McuResetReason=58
      McuRstRsnConfRstUnknown: McuResetReason=70
      McuRstRsnConfCanRamEccDedRst: McuResetReason=21
      McuRstRsnConfSlaveGuardRst: McuResetReason=46
      McuRstRsnConfPBusUnmapAccessRst: McuResetReason=50
      McuRstRsnConfUnintenDeactUserRst: McuResetReason=61
      McuRstRsnConfLockStepCoreRst: McuResetReason=5
      McuRstRsnConfPEGuardRst: McuResetReason=43
      McuRstRsnConfGtmRamEccDedRst: McuResetReason=24
      McuRstRsnConfBusBridgeErrorRst: McuResetReason=7
      McuRstRsnConfClma0Rst: McuResetReason=10
      McuRstRsnConfGramFlsGvciUnmapAccessRst: McuResetReason=53
      McuRstRsnConfCsihRamEccDedRst: McuResetReason=20
      McuRstRsnConfEthRamDedRst: McuResetReason=22
      McuRstRsnConfBistRst: McuResetReason=68
      McuRstRsnConfBusEccSedRst: McuResetReason=26
      McuRstRsnConfClma1Rst: McuResetReason=14
      McuRstRsnConfGramGuardRst: McuResetReason=44
      McuRstRsnConfCodeFlsAddrOvfRst: McuResetReason=29
      McuRstRsnConfEcmCompRst: McuResetReason=65
      McuRstRsnConfDmaUnmappedRst: McuResetReason=56
      McuRstRsnConfFlsSequenceRst: McuResetReason=57
      McuRstRsnConfCacheRamEdcRst: McuResetReason=17
      McuRstRsnConfLRamAddrOvfRst: McuResetReason=27
      McuRstRsnConfClma4Rst: McuResetReason=13
      McuRstRsnConfGramPEUnmapAccessRst: McuResetReason=48
      McuRstRsnConfRstUndefined: McuResetReason=69
      McuRstRsnConfWdtRst: McuResetReason=4
      McuRstRsnConfDtsRamEccSedRst: McuResetReason=33
      McuRstRsnConfFrRamEccSedRst: McuResetReason=41
      McuRstRsnConfCanRamEccSedRst: McuResetReason=39
      McuRstRsnConfClma2Rst: McuResetReason=11
      McuRstRsnConfFrRamEccDedRst: McuResetReason=23
      McuRstRsnConfDataFlsEccDedRst: McuResetReason=19
      McuRstRsnConfGtmRamEccSedRst: McuResetReason=42
      McuRstRsnConfDataFlsAddrOvfRst: McuResetReason=30
      McuRstRsnConfDtsRamEccDedRst: McuResetReason=32
      McuRstRsnConfUnintenActTestModeRst: McuResetReason=64
      McuRstRsnConfAdcParityRst: McuResetReason=59
      McuRstRsnConfDmaTransferRst: McuResetReason=55
      McuRstRsnConfCodeFlsGvciUnmapAccessRst: McuResetReason=52
      McuRstRsnConfCodeFlsEccDedRst: McuResetReason=18
      McuRstRsnConfDataFlsEccSedRst: McuResetReason=37
      McuRstRsnConfUnintenDebugEnableDetectRst: McuResetReason=63
      McuRstRsnConfDebuggerRst: McuResetReason=66
      McuRstRsnConfCodeFlsPEUnmapAccessRst: McuResetReason=47
      McuRstRsnConfPeriRamEccAddrOvfRst: McuResetReason=31
      McuRstRsnConfTerminalRst: McuResetReason=1
      McuRstRsnConfLRamEccDedRst: McuResetReason=15
      McuRstRsnConfResHbusUnmapAccessRst: McuResetReason=54
      McuRstRsnConfClma3Rst: McuResetReason=12
      McuRstRsnConfGRamEccDedRst: McuResetReason=16
      McuRstRsnConfBusEccDedRst: McuResetReason=25
      McuRstRsnConfCsihRamEccSedRst: McuResetReason=38
      McuRstRsnConfMemcGuardRst: McuResetReason=45
      McuRstRsnConfCodeFlsEccSedRst: McuResetReason=36
      McuRstRsnConfPbusFssRst: McuResetReason=6
      McuRstRsnConfCvmRst: McuResetReason=2
      McuRstRsnConfPowOnRst: McuResetReason=0
      McuRstRsnConfUnintenActCfpModeRst: McuResetReason=62
      McuRstRsnConfSwSysRst: McuResetReason=3
      McuRstRsnConfHBusUnmapAccessRst: McuResetReason=51
      McuRstRsnConfPEUnintenEnableDisableRst: McuResetReason=60
      McuRstRsnConfGRamEccSedRst: McuResetReason=35
      McuRstRsnConfLpbPEUnmapAccessRst: McuResetReason=49
      McuResetReasonConf: McuResetReason=0
    McuModuleConfiguration:
      McuClockSrcFailureNotification = DISABLED
      McuNumberOfMcuModes = 1
      McuRamSectors = 1
      McuCvmOutMaskFbist = false
      McuCvmOutMaskDiag = false
      McuCvmOutputFilter = false
      McuCvmDiagLockBit = true
      McuCvmResetEnable = false
      McuSwResetTrigger = NO_RESET
      McuClockSettingConfig: McuClockSettingId=0, McuMainOsciFrequency=FREQ_16000000, McuCpuMainSysClk=240000000, McuUnitName=CLK_CPUM
        McuInternalOscillatorClk: McuPeripheralClock=16000000
        McuExternalClkOutSetting:
          McuExternalClk0SourceSel = MCU_BACKUP_CLOCK
          McuExternalClk0DividerSel = 1
          McuExternalClock0 = 4000000
          McuExternalClk1SourceSel = MCU_BACKUP_CLOCK
          McuExternalClk1DividerSel = 1
          McuExternalClock1 = 4000000
        McuPLLClkSetting: McuSystemSourceSel=MCU_PLL, McuPLLClk0DividerSel=1, McuPLLClock0=480000000, McuPLLClk1DividerSel=1, McuOPBT1Sel=3221211608
        McuSAWdtCounterClk: McuSAWdtCounterDivider=DIVBY_ID_8, McuUnitName=WDTCLKI, McuPeripheralClock=2000
        3 x McuClockReferencePoint:
          McuClockReferencePointCAN: McuClockReferencePointFrequency=20000000
          McuClockReferencePointTimer: McuClockReferencePointFrequency=20000000
          McuClockReferencePointFlash: McuClockReferencePointFrequency=80000000
      McuGTMClockSettingsConfig: McuGTMCMUGCLKNumerator=1, McuGTMCMUGCLKDenominator=1
        McuGTMClockSettings: McuGTMClockSelection=CMU_CLK0, McuGTMChannelClkSrcDivider=1
      McuEcmErrorSourcesCfg
        McuEcmErrorSource0:
          McuEcmErrorMaskableInterrupt = false
          McuEcmErrorNonMaskableInterrupt = false
          McuEcmErrorInternalReset = false
          McuEcmErrorNMIDelayTimer = false
          McuEcmErrorMIDelayTimer = false
          McuEcmErrorOutputMask = true
        McuEcmErrorSource1:
          McuEcmErrorMaskableInterrupt = false
          McuEcmErrorNonMaskableInterrupt = false
          McuEcmErrorInternalReset = false
          McuEcmErrorNMIDelayTimer = false
          McuEcmErrorMIDelayTimer = false
          McuEcmErrorOutputMask = true
        McuEcmErrorSource2:
          McuEcmErrorMaskableInterrupt = false
          McuEcmErrorNonMaskableInterrupt = false
          McuEcmErrorInternalReset = false
          McuEcmErrorNMIDelayTimer = false
          McuEcmErrorMIDelayTimer = false
          McuEcmErrorOutputMask = true
        McuEcmErrorSource3:
          McuEcmErrorMaskableInterrupt = false
          McuEcmErrorNonMaskableInterrupt = false
          McuEcmErrorInternalReset = false
          McuEcmErrorNMIDelayTimer = false
          McuEcmErrorMIDelayTimer = false
          McuEcmErrorOutputMask = true
        McuEcmErrorSource4:
          McuEcmErrorMaskableInterrupt = false
          McuEcmErrorNonMaskableInterrupt = false
          McuEcmErrorInternalReset = false
          McuEcmErrorNMIDelayTimer = false
          McuEcmErrorMIDelayTimer = false
          McuEcmErrorOutputMask = true
        McuEcmErrorSource6:
          McuEcmErrorMaskableInterrupt = false
          McuEcmErrorNonMaskableInterrupt = false
          McuEcmErrorInternalReset = false
          McuEcmErrorNMIDelayTimer = false
          McuEcmErrorMIDelayTimer = false
          McuEcmErrorOutputMask = true
        McuEcmErrorSource8:
          McuEcmErrorMaskableInterrupt = false
          McuEcmErrorNonMaskableInterrupt = false
          McuEcmErrorInternalReset = false
          McuEcmErrorNMIDelayTimer = false
          McuEcmErrorMIDelayTimer = false
          McuEcmErrorOutputMask = true
        McuEcmErrorSource9:
          McuEcmErrorMaskableInterrupt = false
          McuEcmErrorNonMaskableInterrupt = false
          McuEcmErrorInternalReset = false
          McuEcmErrorNMIDelayTimer = false
          McuEcmErrorMIDelayTimer = false
          McuEcmErrorOutputMask = true
        McuEcmErrorSource10:
          McuEcmErrorMaskableInterrupt = false
          McuEcmErrorNonMaskableInterrupt = false
          McuEcmErrorInternalReset = false
          McuEcmErrorNMIDelayTimer = false
          McuEcmErrorMIDelayTimer = false
          McuEcmErrorOutputMask = true
        McuEcmErrorSource12:
          McuEcmErrorMaskableInterrupt = false
          McuEcmErrorNonMaskableInterrupt = false
          McuEcmErrorInternalReset = false
          McuEcmErrorNMIDelayTimer = false
          McuEcmErrorMIDelayTimer = false
          McuEcmErrorOutputMask = true
        McuEcmErrorSource16:
          McuEcmErrorMaskableInterrupt = false
          McuEcmErrorNonMaskableInterrupt = false
          McuEcmErrorInternalReset = false
          McuEcmErrorNMIDelayTimer = false
          McuEcmErrorMIDelayTimer = false
          McuEcmErrorOutputMask = true
        McuEcmErrorSource17:
          McuEcmErrorMaskableInterrupt = false
          McuEcmErrorNonMaskableInterrupt = false
          McuEcmErrorInternalReset = false
          McuEcmErrorNMIDelayTimer = false
          McuEcmErrorMIDelayTimer = false
          McuEcmErrorOutputMask = true
        McuEcmErrorSource18:
          McuEcmErrorMaskableInterrupt = false
          McuEcmErrorNonMaskableInterrupt = false
          McuEcmErrorInternalReset = false
          McuEcmErrorNMIDelayTimer = false
          McuEcmErrorMIDelayTimer = false
          McuEcmErrorOutputMask = true
        McuEcmErrorSource19:
          McuEcmErrorMaskableInterrupt = false
          McuEcmErrorNonMaskableInterrupt = false
          McuEcmErrorInternalReset = false
          McuEcmErrorNMIDelayTimer = false
          McuEcmErrorMIDelayTimer = false
          McuEcmErrorOutputMask = true
        McuEcmErrorSource20:
          McuEcmErrorMaskableInterrupt = false
          McuEcmErrorNonMaskableInterrupt = false
          McuEcmErrorInternalReset = false
          McuEcmErrorNMIDelayTimer = false
          McuEcmErrorMIDelayTimer = false
          McuEcmErrorOutputMask = true
        McuEcmErrorSource21:
          McuEcmErrorMaskableInterrupt = false
          McuEcmErrorNonMaskableInterrupt = false
          McuEcmErrorInternalReset = false
          McuEcmErrorNMIDelayTimer = false
          McuEcmErrorMIDelayTimer = false
          McuEcmErrorOutputMask = true
        McuEcmErrorSource22:
          McuEcmErrorMaskableInterrupt = false
          McuEcmErrorNonMaskableInterrupt = false
          McuEcmErrorInternalReset = false
          McuEcmErrorNMIDelayTimer = false
          McuEcmErrorMIDelayTimer = false
          McuEcmErrorOutputMask = true
        McuEcmErrorSource23:
          McuEcmErrorMaskableInterrupt = false
          McuEcmErrorNonMaskableInterrupt = false
          McuEcmErrorInternalReset = false
          McuEcmErrorNMIDelayTimer = false
          McuEcmErrorMIDelayTimer = false
          McuEcmErrorOutputMask = true
        McuEcmErrorSource24:
          McuEcmErrorMaskableInterrupt = false
          McuEcmErrorNonMaskableInterrupt = false
          McuEcmErrorInternalReset = false
          McuEcmErrorNMIDelayTimer = false
          McuEcmErrorMIDelayTimer = false
          McuEcmErrorOutputMask = true
        McuEcmErrorSource25:
          McuEcmErrorMaskableInterrupt = false
          McuEcmErrorNonMaskableInterrupt = false
          McuEcmErrorInternalReset = false
          McuEcmErrorNMIDelayTimer = false
          McuEcmErrorMIDelayTimer = false
          McuEcmErrorOutputMask = true
        McuEcmErrorSource28:
          McuEcmErrorMaskableInterrupt = false
          McuEcmErrorNonMaskableInterrupt = false
          McuEcmErrorInternalReset = false
          McuEcmErrorNMIDelayTimer = false
          McuEcmErrorMIDelayTimer = false
          McuEcmErrorOutputMask = true
        McuEcmErrorSource29:
          McuEcmErrorMaskableInterrupt = false
          McuEcmErrorNonMaskableInterrupt = false
          McuEcmErrorInternalReset = false
          McuEcmErrorNMIDelayTimer = false
          McuEcmErrorMIDelayTimer = false
          McuEcmErrorOutputMask = true
        McuEcmErrorSource32:
          McuEcmErrorMaskableInterrupt = false
          McuEcmErrorNonMaskableInterrupt = false
          McuEcmErrorInternalReset = false
          McuEcmErrorNMIDelayTimer = false
          McuEcmErrorMIDelayTimer = false
          McuEcmErrorOutputMask = true
        McuEcmErrorSource33:
          McuEcmErrorMaskableInterrupt = false
          McuEcmErrorNonMaskableInterrupt = false
          McuEcmErrorInternalReset = false
          McuEcmErrorNMIDelayTimer = false
          McuEcmErrorMIDelayTimer = false
          McuEcmErrorOutputMask = true
        McuEcmErrorSource35:
          McuEcmErrorMaskableInterrupt = false
          McuEcmErrorNonMaskableInterrupt = false
          McuEcmErrorInternalReset = false
          McuEcmErrorNMIDelayTimer = false
          McuEcmErrorMIDelayTimer = false
          McuEcmErrorOutputMask = true
        McuEcmErrorSource36:
          McuEcmErrorMaskableInterrupt = false
          McuEcmErrorNonMaskableInterrupt = false
          McuEcmErrorInternalReset = false
          McuEcmErrorNMIDelayTimer = false
          McuEcmErrorMIDelayTimer = false
          McuEcmErrorOutputMask = true
        McuEcmErrorSource37:
          McuEcmErrorMaskableInterrupt = false
          McuEcmErrorNonMaskableInterrupt = false
          McuEcmErrorInternalReset = false
          McuEcmErrorNMIDelayTimer = false
          McuEcmErrorMIDelayTimer = false
          McuEcmErrorOutputMask = true
        McuEcmErrorSource40:
          McuEcmErrorMaskableInterrupt = false
          McuEcmErrorNonMaskableInterrupt = false
          McuEcmErrorInternalReset = false
          McuEcmErrorNMIDelayTimer = false
          McuEcmErrorMIDelayTimer = false
          McuEcmErrorOutputMask = true
        McuEcmErrorSource41:
          McuEcmErrorMaskableInterrupt = false
          McuEcmErrorNonMaskableInterrupt = false
          McuEcmErrorInternalReset = false
          McuEcmErrorNMIDelayTimer = false
          McuEcmErrorMIDelayTimer = false
          McuEcmErrorOutputMask = true
        McuEcmErrorSource48:
          McuEcmErrorMaskableInterrupt = false
          McuEcmErrorNonMaskableInterrupt = false
          McuEcmErrorInternalReset = false
          McuEcmErrorNMIDelayTimer = false
          McuEcmErrorMIDelayTimer = false
          McuEcmErrorOutputMask = true
        McuEcmErrorSource49:
          McuEcmErrorMaskableInterrupt = false
          McuEcmErrorNonMaskableInterrupt = false
          McuEcmErrorInternalReset = false
          McuEcmErrorNMIDelayTimer = false
          McuEcmErrorMIDelayTimer = false
          McuEcmErrorOutputMask = true
        McuEcmErrorSource51:
          McuEcmErrorMaskableInterrupt = false
          McuEcmErrorNonMaskableInterrupt = false
          McuEcmErrorInternalReset = false
          McuEcmErrorNMIDelayTimer = false
          McuEcmErrorMIDelayTimer = false
          McuEcmErrorOutputMask = true
        McuEcmErrorSource52:
          McuEcmErrorMaskableInterrupt = false
          McuEcmErrorNonMaskableInterrupt = false
          McuEcmErrorInternalReset = false
          McuEcmErrorNMIDelayTimer = false
          McuEcmErrorMIDelayTimer = false
          McuEcmErrorOutputMask = true
        McuEcmErrorSource53:
          McuEcmErrorMaskableInterrupt = false
          McuEcmErrorNonMaskableInterrupt = false
          McuEcmErrorInternalReset = false
          McuEcmErrorNMIDelayTimer = false
          McuEcmErrorMIDelayTimer = false
          McuEcmErrorOutputMask = true
        McuEcmErrorSource54:
          McuEcmErrorMaskableInterrupt = false
          McuEcmErrorNonMaskableInterrupt = false
          McuEcmErrorInternalReset = false
          McuEcmErrorNMIDelayTimer = false
          McuEcmErrorMIDelayTimer = false
          McuEcmErrorOutputMask = true
        McuEcmErrorSource55:
          McuEcmErrorMaskableInterrupt = false
          McuEcmErrorNonMaskableInterrupt = false
          McuEcmErrorInternalReset = false
          McuEcmErrorNMIDelayTimer = false
          McuEcmErrorMIDelayTimer = false
          McuEcmErrorOutputMask = true
        McuEcmErrorSource56:
          McuEcmErrorMaskableInterrupt = false
          McuEcmErrorNonMaskableInterrupt = false
          McuEcmErrorInternalReset = false
          McuEcmErrorNMIDelayTimer = false
          McuEcmErrorMIDelayTimer = false
          McuEcmErrorOutputMask = true
        McuEcmErrorSource57:
          McuEcmErrorMaskableInterrupt = false
          McuEcmErrorNonMaskableInterrupt = false
          McuEcmErrorInternalReset = false
          McuEcmErrorNMIDelayTimer = false
          McuEcmErrorMIDelayTimer = false
          McuEcmErrorOutputMask = true
        McuEcmErrorSource64:
          McuEcmErrorMaskableInterrupt = false
          McuEcmErrorNonMaskableInterrupt = false
          McuEcmErrorInternalReset = false
          McuEcmErrorNMIDelayTimer = false
          McuEcmErrorMIDelayTimer = false
          McuEcmErrorOutputMask = true
        McuEcmErrorSource65:
          McuEcmErrorMaskableInterrupt = false
          McuEcmErrorNonMaskableInterrupt = false
          McuEcmErrorInternalReset = false
          McuEcmErrorNMIDelayTimer = false
          McuEcmErrorMIDelayTimer = false
          McuEcmErrorOutputMask = true
        McuEcmErrorSource66:
          McuEcmErrorMaskableInterrupt = false
          McuEcmErrorNonMaskableInterrupt = false
          McuEcmErrorInternalReset = false
          McuEcmErrorNMIDelayTimer = false
          McuEcmErrorMIDelayTimer = false
          McuEcmErrorOutputMask = true
        McuEcmErrorSource67:
          McuEcmErrorMaskableInterrupt = false
          McuEcmErrorNonMaskableInterrupt = false
          McuEcmErrorInternalReset = false
          McuEcmErrorNMIDelayTimer = false
          McuEcmErrorMIDelayTimer = false
          McuEcmErrorOutputMask = true
        McuEcmErrorSource72:
          McuEcmErrorMaskableInterrupt = false
          McuEcmErrorNonMaskableInterrupt = false
          McuEcmErrorInternalReset = false
          McuEcmErrorNMIDelayTimer = false
          McuEcmErrorMIDelayTimer = false
          McuEcmErrorOutputMask = true
        McuEcmErrorSource73:
          McuEcmErrorMaskableInterrupt = false
          McuEcmErrorNonMaskableInterrupt = false
          McuEcmErrorInternalReset = false
          McuEcmErrorNMIDelayTimer = false
          McuEcmErrorMIDelayTimer = false
          McuEcmErrorOutputMask = true
        McuEcmErrorSource74:
          McuEcmErrorMaskableInterrupt = false
          McuEcmErrorNonMaskableInterrupt = false
          McuEcmErrorInternalReset = false
          McuEcmErrorNMIDelayTimer = false
          McuEcmErrorMIDelayTimer = false
          McuEcmErrorOutputMask = true
        McuEcmErrorSource75:
          McuEcmErrorMaskableInterrupt = false
          McuEcmErrorNonMaskableInterrupt = false
          McuEcmErrorInternalReset = false
          McuEcmErrorNMIDelayTimer = false
          McuEcmErrorMIDelayTimer = false
          McuEcmErrorOutputMask = true
        McuEcmErrorSource76:
          McuEcmErrorMaskableInterrupt = false
          McuEcmErrorNonMaskableInterrupt = false
          McuEcmErrorInternalReset = false
          McuEcmErrorNMIDelayTimer = false
          McuEcmErrorMIDelayTimer = false
          McuEcmErrorOutputMask = true
        McuEcmErrorSource77:
          McuEcmErrorMaskableInterrupt = false
          McuEcmErrorNonMaskableInterrupt = false
          McuEcmErrorInternalReset = false
          McuEcmErrorNMIDelayTimer = false
          McuEcmErrorMIDelayTimer = false
          McuEcmErrorOutputMask = true
        McuEcmErrorSource78:
          McuEcmErrorMaskableInterrupt = false
          McuEcmErrorNonMaskableInterrupt = false
          McuEcmErrorInternalReset = false
          McuEcmErrorNMIDelayTimer = false
          McuEcmErrorMIDelayTimer = false
          McuEcmErrorOutputMask = true
        McuEcmErrorSource79:
          McuEcmErrorMaskableInterrupt = false
          McuEcmErrorNonMaskableInterrupt = false
          McuEcmErrorInternalReset = false
          McuEcmErrorNMIDelayTimer = false
          McuEcmErrorMIDelayTimer = false
          McuEcmErrorOutputMask = true
        McuEcmErrorSource80:
          McuEcmErrorMaskableInterrupt = false
          McuEcmErrorNonMaskableInterrupt = false
          McuEcmErrorInternalReset = false
          McuEcmErrorNMIDelayTimer = false
          McuEcmErrorMIDelayTimer = false
          McuEcmErrorOutputMask = true
        McuEcmErrorSource81:
          McuEcmErrorMaskableInterrupt = false
          McuEcmErrorNonMaskableInterrupt = false
          McuEcmErrorInternalReset = false
          McuEcmErrorNMIDelayTimer = false
          McuEcmErrorMIDelayTimer = false
          McuEcmErrorOutputMask = true
        McuEcmErrorSource82:
          McuEcmErrorMaskableInterrupt = false
          McuEcmErrorNonMaskableInterrupt = false
          McuEcmErrorInternalReset = false
          McuEcmErrorNMIDelayTimer = false
          McuEcmErrorMIDelayTimer = false
          McuEcmErrorOutputMask = true
        McuEcmErrorSource83:
          McuEcmErrorMaskableInterrupt = false
          McuEcmErrorNonMaskableInterrupt = false
          McuEcmErrorInternalReset = false
          McuEcmErrorNMIDelayTimer = false
          McuEcmErrorMIDelayTimer = false
          McuEcmErrorOutputMask = true
        McuEcmErrorSource84:
          McuEcmErrorMaskableInterrupt = false
          McuEcmErrorNonMaskableInterrupt = false
          McuEcmErrorInternalReset = false
          McuEcmErrorNMIDelayTimer = false
          McuEcmErrorMIDelayTimer = false
          McuEcmErrorOutputMask = true
        McuEcmErrorSource87:
          McuEcmErrorMaskableInterrupt = false
          McuEcmErrorNonMaskableInterrupt = false
          McuEcmErrorInternalReset = false
          McuEcmErrorNMIDelayTimer = false
          McuEcmErrorMIDelayTimer = false
          McuEcmErrorOutputMask = true
        McuEcmErrorSource88:
          McuEcmErrorMaskableInterrupt = false
          McuEcmErrorNonMaskableInterrupt = false
          McuEcmErrorInternalReset = false
          McuEcmErrorNMIDelayTimer = false
          McuEcmErrorMIDelayTimer = false
          McuEcmErrorOutputMask = true
        McuEcmErrorSource89:
          McuEcmErrorMaskableInterrupt = false
          McuEcmErrorNonMaskableInterrupt = false
          McuEcmErrorInternalReset = false
          McuEcmErrorNMIDelayTimer = false
          McuEcmErrorMIDelayTimer = false
          McuEcmErrorOutputMask = true
        McuEcmErrorSource90:
          McuEcmErrorMaskableInterrupt = false
          McuEcmErrorNonMaskableInterrupt = false
          McuEcmErrorInternalReset = false
          McuEcmErrorNMIDelayTimer = false
          McuEcmErrorMIDelayTimer = false
          McuEcmErrorOutputMask = true
        McuEcmErrorSource91:
          McuEcmErrorMaskableInterrupt = false
          McuEcmErrorNonMaskableInterrupt = false
          McuEcmErrorInternalReset = false
          McuEcmErrorNMIDelayTimer = false
          McuEcmErrorMIDelayTimer = false
          McuEcmErrorOutputMask = true
        McuEcmErrorSource92:
          McuEcmErrorMaskableInterrupt = false
          McuEcmErrorNonMaskableInterrupt = false
          McuEcmErrorInternalReset = false
          McuEcmErrorNMIDelayTimer = false
          McuEcmErrorMIDelayTimer = false
          McuEcmErrorOutputMask = true
        McuEcmErrorSource93: McuEcmErrorInternalReset=false, McuEcmErrorOutputMask=true
      McuDemEventParameterRefs: MCU_E_CLOCK_FAILURE=DemEventParameter, MCU_E_WRITE_TIMEOUT_FAILURE=DemEventParameter, MCU_E_POWERDOWN_MODE_FAILURE=DemEventParameter
      McuModeSettingConf:
        McuMode = 1
        McuModeType = MCU_HALT_MODE
        McuMcanStopTrigger = false
        McuFlexrayStopTrigger = false
        McuGtmStopTrigger = false
        McuEthernetStopTrigger = false
        McuRsentStopTrigger = false
        McuHsUsrtStopTrigger = false
        McuCsihStopTrigger = false
        McuRlin3StopTrigger = false
        McuAdcStopTrigger = false
        McuMcanWakeUpTrigger = false
        McuFlexrayWakeupTrigger = false
        McuGtmWakeupTrigger = false
        McuEthernetWakeupTrigger = false
        McuRsentWakeupTrigger = false
        McuHsUsrtWakeupTrigger = false
        McuCsihWakeupTrigger = false
        McuRlin3WakeupTrigger = false
        McuAdcWakeupTrigger = false
        McuWakeUpFactorDetails: McuWakeUpFactorName=INTECMMI
      McuRamSectorSettingConf: McuRamDefaultValue=255, McuRamSectionBaseAddress=4275961856, McuRamSectionSize=256
