AUTOSAR XML (schema 4-2-1)
package /ActiveEcuC
  module config Fls: implementation-config-variant=VARIANT-POST-BUILD-LOADABLE, module-description=Fls_Impl
    FlsGeneral:
      FlsVersionCheckExternalModules = false
      FlsDevErrorDetect = true
      FlsAcLoadOnJobStart = false
      FlsCancelApi = true
      FlsCompareApi = true
      FlsDriverIndex = 0
      FlsGetJobResultApi = true
      FlsBlankCheckApi = false
      FlsReadImmediateApi = false
      FlsGetStatusApi = true
      FlsSetModeApi = false
      FlsUseInterrupts = false
      FlsVersionInfoApi = false
      FlsCriticalSectionProtection = true
      FlsFaciEccCheck = false
      FlsWriteVerify = WV_DISABLE
      FlsUseWVErrorInterface = false
      FlsLoopCount = 32
      FlsVirtualBoundaryAddress = 64832
      FlsDeviceName = R7F701374
      FlsBaseAddress = 0
      FlsTotalSize = 64
      FlsTimeoutMonitoring = false
      FlsDataFlash:
        FlsDFBaseAddress = 4280287936
        FlsDFBlockSize = 64
        FlsDFTotalBlocks = 1013
        FlsDataFlashSize = 64832
        FlsSuspendApi = false
        FlsResumeApi = false
        FlsEccSedNotification = 
        FlsEccDedNotification = 
        FlsCpuFrequency = McuClockSettingConfig
    FlsPublishedInformation:
      FlsAcLocationErase = 0
      FlsAcLocationWrite = 0
      FlsAcSizeErase = 0
      FlsAcSizeWrite = 0
      FlsEraseTime = 0.004
      FlsErasedValue = 4294967295
      FlsExpectedHwId = NULL
      FlsSpecifiedEraseCycles = 125000
      FlsWriteTime = 0.00053
      FlsBlankCheckTime = 0.000213
      FlsSuspendTime = 0.0003
      FlsCancelTime = 0.00005
    FlsConfigSet:
      FlsAcErase = 0
      FlsAcWrite = 0
      FlsCallCycle = 0.01
      FlsDefaultMode = MEMIF_MODE_SLOW
      FlsMaxReadFastMode = 512
      FlsMaxReadNormalMode = 256
      FlsMaxWriteFastMode = 0
      FlsMaxWriteNormalMode = 4
      FlsMaxEraseNormalMode = 64
      FlsProtection = 0
      FlsJobErrorNotification = Fee_30_SmallSector_JobErrorNotification
      FlsJobEndNotification = Fee_30_SmallSector_JobEndNotification
      FlsDemEventParameterRefs:
        FLS_E_COMPARE_FAILED = FLS_E_COMPARE_FAILED
        FLS_E_ERASE_FAILED = FLS_E_ERASE_FAILED
        FLS_E_READ_FAILED = FLS_E_READ_FAILED
        FLS_E_WRITE_FAILED = FLS_E_WRITE_FAILED
        FLS_E_READ_FAILED_DED = FLS_E_READ_FAILED_DED
        FLS_E_HW_FAILURE = FLS_E_HW_FAIL
        FLS_E_ECC_FAILED = FLS_E_ECC_FAILED
      FlsSectorList
        FlsSector: FlsSectorIndex=0, FlsNumberOfSectors=1013, FlsPageSize=4, FlsSectorSize=64, FlsSectorStartaddress=0
