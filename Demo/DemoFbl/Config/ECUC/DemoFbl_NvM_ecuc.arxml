AUTOSAR XML (schema 4-2-1)
package /ActiveEcuC
  module config NvM: implementation-config-variant=VARIANT-PRE-COMPILE, module-description=NvM_Impl
    NvMCommon:
      NvMSafeBswChecks = true
      NvMApiConfigClass = NVM_API_CONFIG_CLASS_3
      NvMBswMMultiBlockJobStatusInformation = false
      NvMCompiledConfigId = 1
      NvMCrcNumOfBytes = 64
      NvMDatasetSelectionBits = 4
      NvMDevErrorDetect = true
      NvMDrvModeSwitch = true
      NvMDynamicConfiguration = false
      NvMJobPrioritization = false
      NvMPollingMode = true
      NvMSetRamBlockStatusApi = true
      NvMSizeStandardJobQueue = 1
      NvMVersionInfoApi = false
      NvMMaxNoOfWriteRetries = 1
      NvMMainFunctionPeriod = 0.01
      NvMUseBlockIdCheck = false
      NvMRepairRedundantBlocksApi = false
    NvMConfigBlock (NvMBlockDescriptor):
      NvMBlockCrcType = NVM_CRC16
      NvMNvramBlockIdentifier = 1
      NvMBlockManagementType = NVM_BLOCK_REDUNDANT
      NvMNvBlockNum = 2
      NvMBlockUseCrc = true
      NvMNvBlockLength = 2
      NvMSelectBlockForReadAll = true
      NvMResistantToChangedSw = true
      NvMUseInitCallback = false
      NvMSelectBlockForWriteAll = true
      NvMCalcRamBlockCrc = false
      NvMRomBlockDataAddress = NULL_PTR
      NvMBlockJobPriority = 127
      NvMBlockUseSyncMechanism = false
      NvMBlockWriteProt = false
      NvMBswMBlockStatusInformation = false
      NvMWriteBlockOnce = false
      NvMUseServicePorts = false
      NvMUseJobendCallback = false
      NvMBlockUseCRCCompMechanism = false
      NvMSingleBlockCallback = NULL_PTR
      NvMTargetBlockReference
        NvMFeeRef: NvMNameOfFeeBlock=FeeConfigBlock
    NvMCommonVendorParams: NvMMultiblockId=MultiBlockRequest, NvMCrcIntBuffer=true, NvMKillWriteAllApi=true
