AUTOSAR XML (schema 4-2-1)
package /ActiveEcuC
  module config Dcm: implementation-config-variant=VARIANT-PRE-COMPILE, module-description=Dcm_Impl
    DcmConfigSet
      DcmGeneral:
        DcmRespondAllRequest = true
        DcmVersionInfoApi = false
        DcmQueuedRequest = false
        DcmBaudrateSwitch = false
        DcmKeySlotMode = false
        DcmNwStatusRxBufferSize = 0
        DcmTaskTime = 5
        DcmCanHardwareLoopTimeout = 100
        DcmTaskCycle = 5
        DcmDevErrorDetect = false
        DcmBswInitializationFilter = Dcm
        DcmBswInitializationFilter = Fee
        DcmBswInitializationFilter = Fls
        DcmBswInitializationFilter = Mcu
      DcmDsp
        DcmDspSession
          DcmDspSessionRow: DcmDspSessionLevel=0, DcmDspSessionP2ServerMax=50, DcmDspSessionP2StarServerMax=5000
      DcmDsl
        DcmDslBuffer: DcmDslBufferSize=8
        DcmDslDiagResp: DcmDslDiagRespOnSecondDeclinedRequest=false, DcmDslDiagRespMaxNumOfDeclinedRequests=3
        DcmDslProtocol
          DcmDslProtocolRow: DcmDslProtocolID=DCM_UDS_ON_CAN
            TN_Tester_FD_TN_Demo_0_CAN29_FD_Ch0_DemoFBL_Fca_SLP5_CAN (DcmDslConnection)
              DcmDslMainConnection: DcmDslProtocolRxTesterSourceAddr=0, DcmDslPayloadLimit=4095
                PT_Demo_0_CAN_FD_Response_PP_Demo_0_CAN_FD_Response_Tx_eac1789b_411010d2 (DcmDslProtocolTx): DcmDslTxConfirmationPduId=0, DcmDslProtocolTxPduRef=PT_Demo_0_CAN_FD_Response_PP_Demo_0_CAN_FD_Response_Tx_eac1789b_411010d2
                PT_Demo_0_CAN_FD_Request_PP_Demo_0_CAN_FD_Request_Rx_eac1789b_411010d2 (DcmDslProtocolRx):
                  DcmDslProtocolRxAddrType = DCM_PHYSICAL_TYPE
                  DcmDslProtocolRxPduId = 0
                  DcmDslProtocolRxComMChannelRef = DemoFBL_Fca_SLP5_f26020e5
                  DcmDslProtocolRxPduRef = PT_Demo_0_CAN_FD_Request_PP_Demo_0_CAN_FD_Request_Rx_eac1789b_411010d2
                PT_Functional_CAN_FD_PP_Functional_CAN_FD_Rx_eac1789b_411010d2 (DcmDslProtocolRx):
                  DcmDslProtocolRxAddrType = DCM_FUNCTIONAL_TYPE
                  DcmDslProtocolRxPduId = 1
                  DcmDslProtocolRxComMChannelRef = DemoFBL_Fca_SLP5_f26020e5
                  DcmDslProtocolRxPduRef = PT_Functional_CAN_FD_PP_Functional_CAN_FD_Rx_eac1789b_411010d2
            TN_Tester_TN_Demo_0_CAN29_Ch0_DemoFBL_Fca_SLP5_CAN (DcmDslConnection)
              DcmDslMainConnection: DcmDslProtocolRxTesterSourceAddr=1, DcmDslPayloadLimit=4095
                PT_Functional_CAN_20_PP_Functional_CAN_20_Rx_eac1789b_411010d2 (DcmDslProtocolRx):
                  DcmDslProtocolRxAddrType = DCM_FUNCTIONAL_TYPE
                  DcmDslProtocolRxPduId = 3
                  DcmDslProtocolRxComMChannelRef = DemoFBL_Fca_SLP5_f26020e5
                  DcmDslProtocolRxPduRef = PT_Functional_CAN_20_PP_Functional_CAN_20_Rx_eac1789b_411010d2
                PT_Demo_0_CAN_20_Response_PP_Demo_0_CAN_20_Response_Tx_eac1789b_411010d2 (DcmDslProtocolTx): DcmDslTxConfirmationPduId=1, DcmDslProtocolTxPduRef=PT_Demo_0_CAN_20_Response_PP_Demo_0_CAN_20_Response_Tx_eac1789b_411010d2
                PT_Demo_0_CAN_20_Request_PP_Demo_0_CAN_20_Request_Rx_eac1789b_411010d2 (DcmDslProtocolRx):
                  DcmDslProtocolRxAddrType = DCM_PHYSICAL_TYPE
                  DcmDslProtocolRxPduId = 2
                  DcmDslProtocolRxComMChannelRef = DemoFBL_Fca_SLP5_f26020e5
                  DcmDslProtocolRxPduRef = PT_Demo_0_CAN_20_Request_PP_Demo_0_CAN_20_Request_Rx_eac1789b_411010d2
      DcmGeneration:
        DcmInterfacesForDeactivatedData = false
        DcmReduceConstantData2Define = false
        DcmReduceNumericalDataByOffsetThreshold = 2
        DcmReferringKeysInComments = false
        DcmShortSymbols = false
