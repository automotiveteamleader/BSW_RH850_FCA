AUTOSAR XML (schema 4-2-1)
package /ActiveEcuC
  module config Can: implementation-config-variant=VARIANT-PRE-COMPILE, module-description=Can_Impl
    CanGeneral:
      CanIndex = 0
      CanChangeBaudrateApi = false
      CanDevErrorDetection = true
      CanHardwareCancellation = false
      CanIdenticalIdCancellation = false
      CanMainFunctionBusoffPeriod = 0.01
      CanMainFunctionModePeriod = 0.01
      CanMainFunctionWakeupPeriod = 0.01
      CanMultiplexedTransmission = false
      CanSetBaudrateApi = false
      CanTimeoutDuration = 0.01
      CanVersionInfoApi = false
      CanGenericPrecopy = false
      CanHardwareLoopCheck = true
      CanSecureTempBuffer = false
      CanRxFullCANSupport = false
      CanTxFullCANSupport = false
      CanRxBasicCANSupport = true
      CanUseNestedCANInterrupts = false
      CanHardwareCancelByAppl = true
      CanIndividualProcessing = false
      CanGenericConfirmation = false
      CanRxQueue = false
      CanSupportMixedID = false
      CanRxQueueSize = 10
      CanMultipleBasicCANObjects = false
      CanMultipleBasicCANTxObjects = false
      CanHardwareHandleType = UINT8
      CanOptimizeOneController = true
      CanInterruptCategory = VOIDFUNCVOID
      CanGetStatus = false
      CanInterruptLock = DRIVER
      CanWakeupSupport = false
      CanRamCheck = None
      CanOverrunNotification = DET
      CanReinitStart = false
      CanGenericPreTransmit = false
      CanFdSupport = FULL
      CanRuntimeMeasurementSupport = false
      CanMaxRxDataLen = 64
      CanMaxTxDataLen = 64
      CanUsePeripheralAccessApi = false
      CanMirrorModeSupport = false
      CanUseOsInterruptControl = false
      CanMcanRevision = M_CAN_REV_315
      CanFdNISO = ISO_11898
      CanSafeBswChecks = false
      CanSilentModeSupport = false
      CanCounterRef = OsCounter
      CanMainFunctionRWPeriods: CanMainFunctionReadPeriod=0.01, CanMainFunctionWritePeriod=0.01
    CanConfigSet
      CN_DemoFBL_Fca_SLP5_01db1962_Tx (CanHardwareObject):
        CanHandleType = BASIC
        CanIdValue = 0
        CanObjectType = TRANSMIT
        CanIdType = EXTENDED
        CanObjectId = 0
        CanHwProcessing = true
        CanObjectHwSize = 1
        CanObjectHwHandle = 0
        CanMaxDataLen = 64
        CanFdPaddingValue = 0
        CanObjectMultiplexedTransmission = false
        CanControllerRef = CT_DemoFBL_Fca_SLP5_01db1962
      CN_DemoFBL_Fca_SLP5_01db1962_Rx_Ext (CanHardwareObject):
        CanHandleType = BASIC
        CanIdType = EXTENDED
        CanIdValue = 0
        CanObjectType = RECEIVE
        CanObjectId = 1
        CanHwProcessing = true
        CanObjectHwSize = 6
        CanObjectHwHandle = 96
        CanMaxDataLen = 64
        CanFdPaddingValue = 0
        CanObjectMultiplexedTransmission = false
        CanControllerRef = CT_DemoFBL_Fca_SLP5_01db1962
        CanFilterMaskRef = CanFilterMask
      CT_DemoFBL_Fca_SLP5_01db1962 (CanController):
        CanControllerActivation = true
        CanBusoffProcessing = POLLING
        CanControllerBaseAddress = 4293853184
        CanControllerId = 0
        CanRxProcessing = POLLING
        CanTxProcessing = POLLING
        CanWakeupProcessing = POLLING
        CanWakeupSupport = false
        CanWakeupSourceId = 0
        CanBasisAddressEnum = M_CAN0
        CanTxBufferElementSize = ES_64
        CanTxEfBufferElementSize = ES_8
        CanRxBufferElementSize = ES_64
        CanRxFifo0ElementSize = ES_64
        CanRxFifo1ElementSize = ES_8
        CanMaxNrOfRxFifo0Elements = 64
        CanMaxNrOfRxFifo1Elements = 64
        CanMaxNrOfRxBuffers = 64
        CanMaxNrOfTxBuffers = 32
        CanMaxNrOfTxEventFifoBuffers = 0
        CanIsTTCAN = false
        CanControllerDefaultBaudrate = CanControllerBaudrateConfig
        CanCpuClockRef = McuClockReferencePointCAN
        CanFilterMask: CanFilterMaskValue=2147483648, CanFilterCodeValue=0, IsLocked=false
        CanControllerBaudrateConfig:
          CanControllerBaudRate = 500
          CanControllerBaudRateConfigID = 0
          CanControllerPropSeg = 1
          CanControllerSeg1 = 1
          CanControllerSeg2 = 1
          CanControllerSyncJumpWidth = 1
          CanBaudrateClock = 20000
          CanBaudratePrescaler = 10
          CanControllerFdBaudrateConfig:
            CanControllerFdBaudRate = 1000
            CanControllerPropSeg = 1
            CanControllerSeg1 = 1
            CanControllerSeg2 = 1
            CanControllerSyncJumpWidth = 1
            CanControllerTxBitRateSwitch = true
            CanBaudratePrescaler = 5
