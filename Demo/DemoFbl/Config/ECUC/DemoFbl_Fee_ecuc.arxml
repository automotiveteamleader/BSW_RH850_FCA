AUTOSAR XML (schema 4-2-1)
package /ActiveEcuC
  module config Fee: implementation-config-variant=VARIANT-PRE-COMPILE, module-description=Fee_Impl
    FeeGeneral:
      FeeSafeBswChecks = true
      FeeDevErrorDetect = true
      FeeIndex = 0
      FeeNvmJobEndNotification = NvM_JobEndNotification
      FeeNvmJobErrorNotification = NvM_JobErrorNotification
      FeePollingMode = false
      FeeSetModeSupported = true
      FeeVersionInfoApi = false
      FeeVirtualPageSize = 8
      FeeMainFunctionPeriod = 0.005
      FeeMainFunctionTriggering = FixedCycleTime
      FeeCorrectSingleBitFlips = false
      FeeFlsApi:
        FeeFlsIncludeFile = Fls.h
        FeeFlsSetMode = Fls_SetMode
        FeeFlsRead = Fls_Read
        FeeFlsWrite = Fls_Write
        FeeFlsCancel = Fls_Cancel
        FeeFlsGetStatus = Fls_GetStatus
        FeeFlsGetJobResult = Fls_GetJobResult
        FeeFlsErase = Fls_Erase
        FeeFlsCompare = Fls_Compare
        FeeFlsBlankCheck = Fls_BlankCheck
        FeeFlsDeviceIndex = FlsGeneral
    FeeConfigBlock (FeeBlockConfiguration):
      FeeBlockNumber = 16
      FeeBlockSize = 4
      FeeImmediateData = false
      FeeNumberOfWriteCycles = 10000
      FeeNumberOfDatasets = 2
      FeeNumberOfInstances = 1
      FeeVerifyWrittenData = false
      FeeBlockId = 0
      FeeDeviceIndex = FlsGeneral
      FeePartition = FeePartitionConfiguration
    FeePublishedInformation: FeeBlockOverhead=2, FeeMaximumBlockingTime=1, FeePageOverhead=0
    FeePartitionConfiguration:
      FeePartitionStartAddress = 0
      FeePartitionSize = 512
      FeePartitionAddressAlignment = 64
      FeePartitionWriteAlignment = 4
      FeePartitionReadAlignment = 1
      FeeFlsBlankCheckApi = false
      FeePartitionDevice = FlsConfigSet
    3 x FeeBlockConfiguration, all with FeeImmediateData=false, FeeNumberOfWriteCycles=10000, FeeNumberOfDatasets=1, FeeNumberOfInstances=1, FeeVerifyWrittenData=false, FeeDeviceIndex=FlsGeneral, FeePartition=FeePartitionConfiguration:
      FblGeneral: FeeBlockNumber=32, FeeBlockSize=13, FeeBlockId=1
      FblDid: FeeBlockNumber=48, FeeBlockSize=38, FeeBlockId=2
      FblMetaData: FeeBlockNumber=64, FeeBlockSize=45, FeeBlockId=3
