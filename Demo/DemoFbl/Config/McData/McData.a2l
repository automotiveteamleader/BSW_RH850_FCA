/*********************************************************************************************************************
* COPYRIGHT *
* Copyright (c) 2013 - 2018 by Vector Informatik GmbH. All rights reserved. *
* This software is copyright protected and proprietary to Vector Informatik GmbH. *
* Vector Informatik GmbH grants to you only those rights as set out in the license conditions. *
* All other rights remain with Vector Informatik GmbH. *
* FILE DESCRIPTION *
* File: McData.a2l *
* Description: MICROSAR A2L file *
* Generated at: 2018-07-26 12:56:52 *
* Generator: MICROSAR McDataConverter, Version 1.0.12.0 *
* CUSTOMER INFORMATION *
* Customer: Nexteer Automotive Corporation *
* Serial Number: CBD1800284 *
* Delivery Number: 0 *
* Expiry Date: *
*********************************************************************************************************************/
/*****************************************************************************
* RECORD_LAYOUT *
*****************************************************************************/
/begin RECORD_LAYOUT VECTOR_RL_BOOLEAN FNC_VALUES 1 UBYTE ROW_DIR DIRECT /end RECORD_LAYOUT
/begin RECORD_LAYOUT VECTOR_RL_UBYTE FNC_VALUES 1 UBYTE ROW_DIR DIRECT /end RECORD_LAYOUT
/begin RECORD_LAYOUT VECTOR_RL_UWORD FNC_VALUES 1 UWORD ROW_DIR DIRECT /end RECORD_LAYOUT
/begin RECORD_LAYOUT VECTOR_RL_ULONG FNC_VALUES 1 ULONG ROW_DIR DIRECT /end RECORD_LAYOUT
/begin RECORD_LAYOUT VECTOR_RL_SBYTE FNC_VALUES 1 SBYTE ROW_DIR DIRECT /end RECORD_LAYOUT
/begin RECORD_LAYOUT VECTOR_RL_SWORD FNC_VALUES 1 SWORD ROW_DIR DIRECT /end RECORD_LAYOUT
/begin RECORD_LAYOUT VECTOR_RL_SLONG FNC_VALUES 1 SLONG ROW_DIR DIRECT /end RECORD_LAYOUT
/begin RECORD_LAYOUT VECTOR_RL_FLOAT32_IEEE FNC_VALUES 1 FLOAT32_IEEE ROW_DIR DIRECT /end RECORD_LAYOUT
/begin RECORD_LAYOUT VECTOR_RL_FLOAT64_IEEE FNC_VALUES 1 FLOAT64_IEEE ROW_DIR DIRECT /end RECORD_LAYOUT
/*****************************************************************************
* CHARACTERISTIC *
*****************************************************************************/
/*****************************************************************************
* MEASUREMENT *
*****************************************************************************/
/*****************************************************************************
* COMPU_METHOD *
*****************************************************************************/
/*****************************************************************************
* COMPU_VTAB_RANGE *
*****************************************************************************/
/*****************************************************************************
* GROUP *
*****************************************************************************/
/begin GROUP CanIf "" /begin REF_CHARACTERISTIC /end REF_CHARACTERISTIC /begin REF_MEASUREMENT /end REF_MEASUREMENT /end GROUP
/begin GROUP CanTp "" /begin REF_CHARACTERISTIC /end REF_CHARACTERISTIC /begin REF_MEASUREMENT /end REF_MEASUREMENT /end GROUP
/begin GROUP NvM "" /begin REF_CHARACTERISTIC /end REF_CHARACTERISTIC /begin REF_MEASUREMENT /end REF_MEASUREMENT /end GROUP
/begin GROUP PduR "" /begin REF_CHARACTERISTIC /end REF_CHARACTERISTIC /begin REF_MEASUREMENT /end REF_MEASUREMENT /end GROUP
/begin GROUP Dcm "" /begin REF_CHARACTERISTIC /end REF_CHARACTERISTIC /begin REF_MEASUREMENT /end REF_MEASUREMENT /end GROUP
