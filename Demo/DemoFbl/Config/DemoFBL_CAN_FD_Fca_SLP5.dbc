VERSION ""

NS_ :

BS_:

BU_: Demo_1_CAN29 Demo_0_CAN29 Tester

BO_ 2564485663 Demo_1_CAN_FD_Response: 64 Demo_1_CAN29
 SG_ Demo_1_CAN_FD_Response : 0|64@1+ (1,0) [0|0] ""  Tester

BO_ 2564485407 Demo_1_CAN_20_Response: 8 Demo_1_CAN29
 SG_ Demo_1_CAN_20_Response : 0|64@1+ (1,0) [0|0] ""  Tester

BO_ 2564485831 Demo_0_CAN_FD_Response: 64 Demo_0_CAN29
 SG_ Demo_0_CAN_FD_Response : 0|64@1+ (1,0) [0|0] ""  Tester

BO_ 2564485575 Demo_0_CAN_20_Response: 8 Demo_0_CAN29
 SG_ Demo_0_CAN_20_Response : 0|64@1+ (1,0) [0|0] ""  Tester

BO_ 2564431858 Demo_1_CAN_FD_Request: 64 Tester
 SG_ Demo_1_CAN_FD_Request : 0|64@1+ (1,0) [0|0] ""  Demo_1_CAN29

BO_ 2564474866 Demo_0_CAN_FD_Request: 64 Tester
 SG_ Demo_0_CAN_FD_Request : 0|64@1+ (1,0) [0|0] ""  Demo_0_CAN29

BO_ 2564431857 Demo_1_CAN_20_Request: 8 Tester
 SG_ Demo_1_CAN_20_Request : 0|64@1+ (1,0) [0|0] ""  Demo_1_CAN29

BO_ 2564474865 Demo_0_CAN_20_Request: 8 Tester
 SG_ Demo_0_CAN_20_Request : 0|64@1+ (1,0) [0|0] ""  Demo_0_CAN29

BO_ 2564554482 Functional_CAN_FD: 64 Tester
 SG_ Functional_CAN_FD : 0|64@1+ (1,0) [0|0] ""  Demo_1_CAN29,Demo_0_CAN29

BO_ 2564554481 Functional_CAN_20: 8 Tester
 SG_ Functional_CAN_20 : 0|64@1+ (1,0) [0|0] ""  Demo_1_CAN29,Demo_0_CAN29

CM_ BU_ Demo_1_CAN29 "Classic CAN, physical 29 Bit identifiers, functional 11 Bit identifier";
CM_ BU_ Demo_0_CAN29 "Classic CAN, 11 Bit identifiers";
CM_ BU_ Tester "Classic CAN";
CM_ BO_ 2564485663 "Physical CAN FD response message (29 Bit ID)";
CM_ BO_ 2564485407 "Physical CAN response message (29 Bit ID)";
CM_ BO_ 2564485831 "Physical CAN FD response message (11 Bit ID)";
CM_ BO_ 2564485575 "Physical CAN response message (11 Bit ID)";
CM_ BO_ 2564431858 "Physical CAN FD request message (29 Bit ID)";
CM_ BO_ 2564474866 "Physical CAN FD request message (11 Bit ID)";
CM_ BO_ 2564431857 "Physical CAN request message (29 Bit ID)";
CM_ BO_ 2564474865 "Physical CAN request message (11 Bit ID)";
CM_ BO_ 2564554482 "Functional CAN FD message (11 Bit ID)";
CM_ BO_ 2564554481 "Functional CAN message (11 Bit ID)";
BA_DEF_ BO_  "DiagFdOnly" ENUM  "no","yes";
BA_DEF_  "Manufacturer" STRING ;
BA_DEF_ BO_  "DiagState" ENUM  "no","yes";
BA_DEF_ BO_  "DiagResponse" ENUM  "no","yes";
BA_DEF_ BO_  "DiagRequest" ENUM  "no","yes";
BA_DEF_ BO_  "CANFD_BRS" ENUM  "0","1";
BA_DEF_  "DBName" STRING ;
BA_DEF_  "BusType" STRING ;
BA_DEF_ BO_  "VFrameFormat" ENUM  "StandardCAN","ExtendedCAN","reserved","reserved","reserved","reserved","reserved","reserved","reserved","reserved","reserved","reserved","reserved","reserved","StandardCAN_FD","ExtendedCAN_FD";
BA_DEF_DEF_  "DiagFdOnly" "yes";
BA_DEF_DEF_  "Manufacturer" "Vector";
BA_DEF_DEF_  "DiagState" "no";
BA_DEF_DEF_  "DiagResponse" "no";
BA_DEF_DEF_  "DiagRequest" "no";
BA_DEF_DEF_  "CANFD_BRS" "1";
BA_DEF_DEF_  "DBName" "";
BA_DEF_DEF_  "BusType" "";
BA_DEF_DEF_  "VFrameFormat" "StandardCAN";
BA_ "Manufacturer" "Fca";
BA_ "BusType" "CAN FD";
BA_ "DBName" "DemoFBL_Fca_SLP5";
BA_ "DiagResponse" BO_ 2564485663 1;
BA_ "VFrameFormat" BO_ 2564485663 15;
BA_ "VFrameFormat" BO_ 2564485407 1;
BA_ "DiagResponse" BO_ 2564485407 1;
BA_ "CANFD_BRS" BO_ 2564485407 0;
BA_ "DiagResponse" BO_ 2564485831 1;
BA_ "VFrameFormat" BO_ 2564485831 15;
BA_ "VFrameFormat" BO_ 2564485575 1;
BA_ "CANFD_BRS" BO_ 2564485575 0;
BA_ "DiagResponse" BO_ 2564485575 1;
BA_ "DiagRequest" BO_ 2564431858 1;
BA_ "VFrameFormat" BO_ 2564431858 15;
BA_ "DiagRequest" BO_ 2564474866 1;
BA_ "VFrameFormat" BO_ 2564474866 15;
BA_ "CANFD_BRS" BO_ 2564431857 0;
BA_ "VFrameFormat" BO_ 2564431857 1;
BA_ "DiagRequest" BO_ 2564431857 1;
BA_ "VFrameFormat" BO_ 2564474865 1;
BA_ "CANFD_BRS" BO_ 2564474865 0;
BA_ "DiagRequest" BO_ 2564474865 1;
BA_ "DiagState" BO_ 2564554482 1;
BA_ "VFrameFormat" BO_ 2564554482 15;
BA_ "DiagFdOnly" BO_ 2564554481 0;
BA_ "VFrameFormat" BO_ 2564554481 1;
BA_ "CANFD_BRS" BO_ 2564554481 0;
BA_ "DiagState" BO_ 2564554481 1;
