AUTOSAR XML (schema 4-2-1)
package /VehicleProject
  system System
package /TP
  can tp config DemoFBL_Fca_SLP5_CAN: communication-cluster=DemoFBL_Fca_SLP5, can-tp-ecu{cycle-time-main-function=0.005, ecu-instance=Demo_0_CAN29}
    can tp channel TPCH: channel-id=0, channel-mode=FULL-DUPLEX-MODE
    can-tp-connection addressing-format=STANDARD, can-tp-channel=TPCH, data-pdu=Functional_CAN_20_Tp_oDemoFBL_Fca_SLP5, receiver=TN_Demo_0_CAN29, ta-type=FUNCTIONAL, tp-sdu=Functional_CAN_20_oDemoFBL_Fca_SLP5, transmitter=TN_Tester:
      ident Functional_CAN_20_oTN_Tester
    can-tp-connection addressing-format=STANDARD, can-tp-channel=TPCH, data-pdu=Functional_CAN_FD_Tp_oDemoFBL_Fca_SLP5, receiver=TN_Demo_0_CAN29_FD, ta-type=FUNCTIONAL-CAN-FD, tp-sdu=Functional_CAN_FD_oDemoFBL_Fca_SLP5, transmitter=TN_Tester_FD:
      ident Functional_CAN_FD_FD_oTN_Tester_FD
    can-tp-connection addressing-format=STANDARD, can-tp-channel=TPCH, data-pdu=Demo_0_CAN_20_Request_Tp_oDemoFBL_Fca_SLP5, flow-control-pdu=Demo_0_CAN_20_Response_Tp_oDemoFBL_Fca_SLP5, receiver=TN_Demo_0_CAN29, ta-type=PHYSICAL, tp-sdu=Demo_0_CAN_20_Request_oDemoFBL_Fca_SLP5, transmitter=TN_Tester:
      ident Demo_0_CAN_20_Request_oTN_Demo_0_CAN29
    can-tp-connection addressing-format=STANDARD, can-tp-channel=TPCH, data-pdu=Demo_0_CAN_20_Response_Tp_oDemoFBL_Fca_SLP5, flow-control-pdu=Demo_0_CAN_20_Request_Tp_oDemoFBL_Fca_SLP5, receiver=TN_Tester, ta-type=PHYSICAL, tp-sdu=Demo_0_CAN_20_Response_oDemoFBL_Fca_SLP5, transmitter=TN_Demo_0_CAN29:
      ident Demo_0_CAN_20_Response_oTN_Demo_0_CAN29
    can-tp-connection addressing-format=STANDARD, can-tp-channel=TPCH, data-pdu=Demo_0_CAN_FD_Request_Tp_oDemoFBL_Fca_SLP5, flow-control-pdu=Demo_0_CAN_FD_Response_Tp_oDemoFBL_Fca_SLP5, receiver=TN_Demo_0_CAN29_FD, ta-type=PHYSICAL-CAN-FD, tp-sdu=Demo_0_CAN_FD_Request_oDemoFBL_Fca_SLP5, transmitter=TN_Tester_FD:
      ident Demo_0_CAN_FD_Request_oTN_Demo_0_CAN29_FD
    can-tp-connection addressing-format=STANDARD, can-tp-channel=TPCH, data-pdu=Demo_0_CAN_FD_Response_Tp_oDemoFBL_Fca_SLP5, flow-control-pdu=Demo_0_CAN_FD_Request_Tp_oDemoFBL_Fca_SLP5, receiver=TN_Tester_FD, ta-type=PHYSICAL-CAN-FD, tp-sdu=Demo_0_CAN_FD_Response_oDemoFBL_Fca_SLP5, transmitter=TN_Demo_0_CAN29_FD:
      ident Demo_0_CAN_FD_Response_oTN_Demo_0_CAN29_FD
    4 x can tp node:
      TN_Demo_0_CAN29: connector=CN_DemoFBL_Fca_SLP5
      TN_Demo_0_CAN29_FD: connector=CN_DemoFBL_Fca_SLP5
      TN_Tester
      TN_Tester_FD
package /Cluster
  can cluster DemoFBL_Fca_SLP5: protocol-name=CAN  # DemoFBL_CAN_FD_Fca_SLP5
    can physical channel CHNL: comm-connectors=CN_DemoFBL_Fca_SLP5
      frame Demo_0_CAN_20_Request_oDemoFBL_Fca_SLP5: id 0x18DAC7F1, to Demo_0_CAN29, frame-length=8, can-addressing-mode=EXTENDED, can-frame-rx-behavior=CAN-20, can-frame-tx-behavior=CAN-20  # Physical CAN request message (11 Bit ID)
        n pdu Demo_0_CAN_20_Request_Tp_oDemoFBL_Fca_SLP5: length=8
      frame Demo_0_CAN_20_Response_oDemoFBL_Fca_SLP5: id 0x18DAF1C7, from Demo_0_CAN29, frame-length=8, can-addressing-mode=EXTENDED, can-frame-rx-behavior=CAN-20, can-frame-tx-behavior=CAN-20  # Physical CAN response message (11 Bit ID)
        n pdu Demo_0_CAN_20_Response_Tp_oDemoFBL_Fca_SLP5: length=8
      frame Demo_0_CAN_FD_Request_oDemoFBL_Fca_SLP5: id 0x18DAC7F2, to Demo_0_CAN29, frame-length=64, can-addressing-mode=EXTENDED, can-frame-rx-behavior=CAN-FD, can-frame-tx-behavior=CAN-FD  # Physical CAN FD request message (11 Bit ID)
        n pdu Demo_0_CAN_FD_Request_Tp_oDemoFBL_Fca_SLP5: length=64
      frame Demo_0_CAN_FD_Response_oDemoFBL_Fca_SLP5: id 0x18DAF2C7, from Demo_0_CAN29, frame-length=64, can-addressing-mode=EXTENDED, can-frame-rx-behavior=CAN-FD, can-frame-tx-behavior=CAN-FD  # Physical CAN FD response message (11 Bit ID)
        n pdu Demo_0_CAN_FD_Response_Tp_oDemoFBL_Fca_SLP5: length=64
      frame Functional_CAN_20_oDemoFBL_Fca_SLP5: id 0x18DBFEF1, to Demo_0_CAN29, frame-length=8, can-addressing-mode=EXTENDED, can-frame-rx-behavior=CAN-20, can-frame-tx-behavior=CAN-20  # Functional CAN message (11 Bit ID)
        n pdu Functional_CAN_20_Tp_oDemoFBL_Fca_SLP5: length=8
      frame Functional_CAN_FD_oDemoFBL_Fca_SLP5: id 0x18DBFEF2, to Demo_0_CAN29, frame-length=64, can-addressing-mode=EXTENDED, can-frame-rx-behavior=CAN-FD, can-frame-tx-behavior=CAN-FD  # Functional CAN FD message (11 Bit ID)
        n pdu Functional_CAN_FD_Tp_oDemoFBL_Fca_SLP5: length=64
      pdu triggering PT_Demo_0_CAN_20_Request: pdu=Demo_0_CAN_20_Request_oDemoFBL_Fca_SLP5, to Demo_0_CAN29
      pdu triggering PT_Demo_0_CAN_20_Response: pdu=Demo_0_CAN_20_Response_oDemoFBL_Fca_SLP5, from Demo_0_CAN29
      pdu triggering PT_Demo_0_CAN_FD_Request: pdu=Demo_0_CAN_FD_Request_oDemoFBL_Fca_SLP5, to Demo_0_CAN29
      pdu triggering PT_Demo_0_CAN_FD_Response: pdu=Demo_0_CAN_FD_Response_oDemoFBL_Fca_SLP5, from Demo_0_CAN29
      pdu triggering PT_Functional_CAN_20: pdu=Functional_CAN_20_oDemoFBL_Fca_SLP5, to Demo_0_CAN29
      pdu triggering PT_Functional_CAN_FD: pdu=Functional_CAN_FD_oDemoFBL_Fca_SLP5, to Demo_0_CAN29
package /ECU
  ecu instance Demo_0_CAN29  # Classic CAN, 11 Bit identifiers
    can communication controller CT_DemoFBL_Fca_SLP5
    can communication connector CN_DemoFBL_Fca_SLP5: comm-controller=CT_DemoFBL_Fca_SLP5
package /PDU
  dcm i pdu Demo_0_CAN_20_Request_oDemoFBL_Fca_SLP5: length=8, diag-pdu-type=DIAG-REQUEST
  dcm i pdu Demo_0_CAN_20_Response_oDemoFBL_Fca_SLP5: length=8, diag-pdu-type=DIAG-RESPONSE
  dcm i pdu Demo_0_CAN_FD_Request_oDemoFBL_Fca_SLP5: length=64, diag-pdu-type=DIAG-REQUEST
  dcm i pdu Demo_0_CAN_FD_Response_oDemoFBL_Fca_SLP5: length=64, diag-pdu-type=DIAG-RESPONSE
  dcm i pdu Functional_CAN_20_oDemoFBL_Fca_SLP5: length=7, diag-pdu-type=DIAG-REQUEST
  dcm i pdu Functional_CAN_FD_oDemoFBL_Fca_SLP5: length=62, diag-pdu-type=DIAG-REQUEST
