AUTOSAR XML (schema 4-3-0)
package /ActiveEcuC
  module config Os: implementation-config-variant=VARIANT-PRE-COMPILE
    OSDEFAULTAPPMODE (OsAppMode)
    OsOS: OsStackMonitoring=false, OsStatus=EXTENDED, OsUseGetServiceId=false, OsUseParameterAccess=false, OsUseResScheduler=true, OsScalabilityClass=SC1
      OsHooks: OsErrorHook=false, OsPostTaskHook=false, OsPreTaskHook=false, OsShutdownHook=false, OsStartupHook=false
    Default_Init_Task (OsTask): OsTaskActivation=1, OsTaskPriority=50, OsTaskSchedule=NON
      OsTaskAutostart: OsTaskAppModeRef=OSDEFAULTAPPMODE
    Default_BSW_Async_Task (OsTask): OsTaskActivation=1, OsTaskPriority=30, OsTaskSchedule=NON, OsTaskResourceRef=OsResource
    OsResource: OsResourceProperty=STANDARD
    Rte_Al_TE2_Default_BSW_Async_Task_0_10ms (OsAlarm): OsAlarmCounterRef=OsCounter
      OsAlarmAction
        OsAlarmActivateTask: OsAlarmActivateTaskRef=Default_BSW_Async_Task
    OsCounter: OsCounterMaxAllowedValue=1000, OsCounterMinCycle=1, OsCounterTicksPerBase=1000, OsCounterType=HARDWARE, OsSecondsPerTick=0.001
