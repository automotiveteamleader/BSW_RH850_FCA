AUTOSAR XML (schema 4-0-3)
# COPYRIGHT
# Copyright (c) 2018 by Vector Informatik GmbH. All rights reserved.
# This software is copyright protected and proprietary to Vector Informatik GmbH.
# Vector Informatik GmbH grants to you only those rights as set out in the license conditions.
package /MICROSAR
  module config EcuC_Pre: definition=EcuC
    EcucGeneral: AtomicVariableAccess=Atomic32BitAccess
  module config EcuC_Rec: definition=EcuC
    EcucGeneral: AtomicBitAccessInBitfield=0
