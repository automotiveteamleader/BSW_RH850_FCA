AUTOSAR XML (schema 4-0-3)
package /MICROSAR
  module config PduR_Pre: definition=PduR
    PduRGeneral: PduRVersionInfoApi=0
  module config PduR_Rec: definition=PduR
    PduRGeneral: PduRDevErrorDetect=0
