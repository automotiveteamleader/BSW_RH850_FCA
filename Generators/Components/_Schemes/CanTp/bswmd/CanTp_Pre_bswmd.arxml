AUTOSAR XML (schema 4-0-3)
# COPYRIGHT
# Copyright (c) 2017 by Vector Informatik GmbH. All rights reserved.
# This software is copyright protected and proprietary to Vector Informatik GmbH.
# Vector Informatik GmbH grants to you only those rights as set out in the license conditions.
package /MICROSAR
  module config CanTp_Pre: definition=CanTp
    CanTpGeneral:
      CanTpVersionInfoApi = 0
      CanTpHavePaddingByte = 0
      CanTpPaddingByte = 0
      CanTpPaddingActive = 1
      CanTpSupportExtendedAddressing = 0
      CanTpSupportMixed11Addressing = 0
      CanTpSupportStandardAddressing = 1
  module config CanTp_Rec: definition=CanTp
    CanTpGeneral: CanTpDevErrorDetect=0, CanTpEnableSynchronousTransmit=1
    CanTpConfig: CanTpMainFunctionPeriod=5
      CanTpChannel
  module config CanTp_Rec_Class1: definition=CanTp
    CanTpConfig
      CanTpChannel
        CanTpRxNSdu: CanTpBs=0, CanTpSTmin=0
