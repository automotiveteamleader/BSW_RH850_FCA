AUTOSAR XML (schema 4-0-3)
# COPYRIGHT
# Copyright (c) 2017 by Vector Informatik GmbH. All rights reserved.
# This software is copyright protected and proprietary to Vector Informatik GmbH.
# Vector Informatik GmbH grants to you only those rights as set out in the license conditions.
package /MICROSAR
  module config CanIf_Pre: definition=CanIf
    CanIfDispatchCfg:
      CanIfDispatchUserCtrlBusOffName = FblCw_ControllerBusOff
      CanIfDispatchUserCtrlBusOffUL = CDD
      CanIfDispatchUserCtrlModeIndicationName = FblCw_ControllerModeIndication
      CanIfDispatchUserCtrlModeIndicationUL = CDD
    CanIfPrivateCfg: CanIfSupportNmOsek=0, CanIfWakeupSupport=0
    CanIfPublicCfg: CanIfPublicCddHeaderFile=CanIf_Cdd.h
  module config CanIf_Rec: definition=CanIf
    CanIfDispatchCfg
    CanIfPublicCfg: CanIfPublicDevErrorDetect=0
    CanIfPrivateCfg: CanIfPrivateDlcCheck=0
