AUTOSAR XML (schema 4-0-3)
package /MICROSAR/Fee_30_SmallSector
  module definition Fee [0..1]: category=VENDOR_SPECIFIC_MODULE_DEFINITION, refined-module-def=Fee, variants pre-compile  # Configuration of the Fee (Flash EEPROM Emulation) module.
    container FeeBlockConfiguration [1..*]  # Block Configuration | This container includes the configuration of block specific parameters for the FEE module.
      integer FeeBlockNumber: 1..65534, set at pre-compile, symbolic-name-value=true, default-value=2  # Block Number | This value specifies the block identifier (handle). | 0x0000 and 0xFFFF shall not be used for block numbers (see FEE006). Range: min = 2^NVM_DATASET_SELECTION_BITS max = 0xFFFF -2^NVM_DATASET_SELECTION_BITS Note: Depending on the number of bits set aside for dataset selection several other block numbers shall also be left out to ease implementation.
      integer FeeBlockSize: 1..65535, set at pre-compile, default-value=1  # Block Size | This value specifies the size of a logical block.
      boolean FeeImmediateData: set at pre-compile, default-value=false  # Immediate Data | This parameter defines if this block has high priority data. | true: Block contains immediate data. false: Block does not contain immediate data.
      integer FeeNumberOfWriteCycles: 0..10000000, set at pre-compile, default-value=10000  # Number Of Write Cycles | This value specifies the number of write cycles required for this block.
      integer FeeNumberOfDatasets: 1..255, set at pre-compile, origin=Vector Informatik, default-value=1  # Number Of Datasets | This value specifies the number of datasets/clones. This is the value how often an individual block exists. Additional information related to the block configuration in the NvM : Native block in the NvM means 1 Dataset is configured. Redundant block in the NvM means 2 Datasets are configured. Dataset block in the NvM means N Datasets can be configured. Maximum value depends on parameter NvMDatasetSelectionBits.
      integer FeeNumberOfInstances: 1..255, set at pre-compile, origin=Vector Informatik, default-value=1  # Number Of Instances | This value specifies the number of instances needed for one dataset/clone. The value depends on the number of write cycles the Flash supports and the number of write cycles of the specific dataset/clone.
      boolean FeeVerifyWrittenData: set at pre-compile, origin=Vector Informatik, default-value=false  # Verify Written Data | This parameter defines if the written data shall be verified for consistency.
      integer FeeBlockId: 0..65535, set at pre-compile, origin=Vector Informatik, default-value=65535  # Block Id | This value specifies the BlockID which indicates the base (aka: "tag") of a Block within its associated partition. The Block can be uniquely identified using partition. The ID must be unique within block's partition; blocks within different partitions may share the same value.
      symbolic name reference FeeDeviceIndex: set at pre-compile, destination=FlsGeneral  # Device Index | Not used! Reference to Fls driver. | Range: 0 .. 254 (0xFF reserved for broadcast call to GetStatus function).
      reference FeePartition: set at pre-compile, origin=Vector Informatik, destination=FeePartitionConfiguration  # Partition | Reference to the partition within the FEE configuration.
    container FeeGeneral  # Container for general parameters. These parameters are not specific to a block.
      boolean FeeDevErrorDetect: set at pre-compile, default-value=true  # Development Error Detection | This parameter switches the Development Error Detection and Notification ON or OFF. true: Development error detection is enabled. false: Development error detection is disabled. Note: In general, the development error detection is recommended during pre-test phase. It is not recommended to enable the development error detection in production code due to increased runtime and ROM needs. | true: Development error detection enabled. false: Development error detection disabled.
      integer FeeIndex: 0..254, set at pre-compile, default-value=0  # Not used! This value specifies the InstanceId of this module instance. If only one instance is present it shall have the Id 0.
      function name FeeNvmJobEndNotification: set at pre-compile, default-value=NvM_JobEndNotification, max-length=64, min-length=1  # NvM Job End Notification | This parameter defines the job end notification routine provided by the upper layer module (normally NvM_JobEndNotification).
      function name FeeNvmJobErrorNotification: set at pre-compile, default-value=NvM_JobErrorNotification, max-length=64, min-length=1  # NvM Job Error Notification | This parameter defines the job error notification routine provided by the upper layer module (normally NvM_JobErrorNotification).
      boolean FeePollingMode: set at pre-compile, default-value=true  # Polling Mode | This parameter defines if the polling mode for this module is enabled. | true: Polling mode enabled, callback functions (provided to FLS module) disabled. false: Polling mode disabled, callback functions (provided to FLS module) enabled.
      boolean FeeSetModeSupported: set at pre-compile, default-value=true  # Provide Fee_SetMode API | Not used! This parameter defines if the 'SetMode' functionality of the FEE module is available. Fee always provides SetMode API, it is an important control feature. | TRUE: SetMode functionality supported / code present, FALSE: SetMode functionality not supported / code not present. Note: This configuration setting has to be consistent with that of all underlying flash device drivers (configuration parameter FlsSetModeApi).
      boolean FeeVersionInfoApi: set at pre-compile, default-value=false  # Version Information API | This parameter enables/disables the function Fee_GetVersionInfo() to get major, minor and patch version information. | true: Version info API enabled. false: Version info API disabled.
      integer FeeVirtualPageSize: 1..65535, set at pre-compile, default-value=8  # Virtual Page Size | Not used! FEE provides configuration of partitions with different address and write alignments due to the fact that multiple FLS modules can be referenced and their alignments may not match. FeeBlocks are always assigned to a certain FeePartition. Therefore, FeeBlocks are aligned to FeePartitionAddressAlignment of its FeePartition.
      string FeeNvmCbkIncludeFile [0..1]: set at pre-compile, origin=Vector Informatik, default-value=NvM_Cbk.h, max-length=32, min-length=1  # NvM Callback Include File | This parameter defines the name of the include file for callback functions declaration of the NvM.
      float FeeMainFunctionPeriod: 0.0001..1, set at pre-compile, origin=Vector Informatik, default-value=0.005  # Call Cycle of Fee_MainFunction | Specify fixed call cycle for Fee_MainFunction. This information affects RTE's (SchM's) settings. It is not necessary to trigger Fee faster than its lower layer (FLS) The faster you want Fee_MainFunction being triggered, the smaller this value should be and vice versa.
      enumeration FeeMainFunctionTriggering: set at pre-compile, origin=Vector Informatik, default-value=FixedCycleTime  # Main Function Triggering | The MainFunction can be scheduled in different ways, which allows adapting the runtime behavior - FixedCycleTime: All activities are executed in the MainFunction with the defined cycle time. - BackgroundTask: Activities that do not require a fixed cycle time run in the background task. The response time of such activities will depend on the current CPU load. Note If the system is overloaded, it may happen that the background task is no longer called.
        FixedCycleTime  # Task for Fixed Cycle Time
        BackgroundTask  # Task for Background Handling
      boolean FeeCorrectSingleBitFlips: set at pre-compile, origin=Vector Informatik, default-value=false  # Correct Single Bit Flips | This parameter defines if the correction of single bit flips is enabled.
      boolean FeeSafeBswChecks: set at pre-compile, origin=Vector Informatik, default-value=false  # Safe Bsw Checks | Selects if safety checks are used. These checks improve robustness as e.g. invalid parameters are checked before function is executed. This attribute has to be enabled for safety projects where this component is mapped to an ASIL partition.
      container FeeFlsApi [0..*]  # Fls Api | This container includes Flash API parameters. The parameters can be used to announce Flash API's for non AUTOSAR compliant Flash drivers.
        string FeeFlsIncludeFile: set at pre-compile, origin=Vector Informatik, default-value=Fls.h  # Fls Include File | This parameter defines the name of the header File of the Flash Driver.
        function name FeeFlsSetMode: set at pre-compile, origin=Vector Informatik, default-value=Fls_SetMode  # Fls SetMode API | This parameter defines the name of the Flash SetMode API.
        function name FeeFlsRead: set at pre-compile, origin=Vector Informatik, default-value=Fls_Read  # Fls Read API | This parameter defines the name of the Flash Read API.
        function name FeeFlsWrite: set at pre-compile, origin=Vector Informatik, default-value=Fls_Write  # Fls Write API | This parameter defines the name of the Flash Write API.
        function name FeeFlsCancel: set at pre-compile, origin=Vector Informatik, default-value=Fls_Cancel  # Fls Cancel API | This parameter defines the name of the Flash Cancel API.
        function name FeeFlsGetStatus: set at pre-compile, origin=Vector Informatik, default-value=Fls_GetStatus  # Fls GetStatus API | This parameter defines the name of the Flash GetStatus API.
        function name FeeFlsGetJobResult: set at pre-compile, origin=Vector Informatik, default-value=Fls_GetJobResult  # Fls GetJobResult API | This parameter defines the name of the Flash GetJobResult API.
        function name FeeFlsErase: set at pre-compile, origin=Vector Informatik, default-value=Fls_Erase  # Fls Erase API | This parameter defines the name of the Flash Erase API.
        function name FeeFlsCompare: set at pre-compile, origin=Vector Informatik, default-value=Fls_Compare  # Fls Compare API | This parameter defines the name of the Flash Compare API.
        function name FeeFlsBlankCheck: set at pre-compile, origin=Vector Informatik, default-value=Fls_BlankCheck  # Fls Blank Check API | Flash Blank Check API
        reference FeeFlsDeviceIndex: set at pre-compile, origin=Vector Informatik, destination=FlsGeneral  # Device Index | Reference to a Flash driver.
    container FeePublishedInformation  # Additional published parameters not covered by CommonPublishedInformation container. | Note that these parameters do not have any configuration class setting, since they are published information.
      integer FeeBlockOverhead: 0..65535, set at published-information, default-value=2  # Block Overhead | Not used. This value specifies the management overhead per logical block. | Note: If the management overhead depends on the block size or block location a formula has to be provided that allows the configurator to calculate the management overhead correctly.
      float FeeMaximumBlockingTime: 0..1, set at published-information, default-value=1  # Maximum Blocking Time | Not used. This value specifies the maximum time the FEE module's API routines shall be blocked (delayed) by internal operations. Note: Internal operations in that case means operations that are not explicitly invoked from the upper layer module but need to be handled for proper operation of this module or the underlying memory driver. | Note: Internal operations in that case means operations that are not explicitly invoked from the upper layer module but need to be handled for proper operation of this module or the underlying memory driver.
      integer FeePageOverhead: 0..0, set at published-information, default-value=0  # Not used. This value specifies the management overhead per page. Note: If the management overhead depends on the block size or block location a formula has to be provided that allows the configurator to calculate the management overhead correctly. | Note: If the management overhead depends on the block size or block location a formula has to be provided that allows the configurator to calculate the management overhead correctly.
    container FeePartitionConfiguration [1..256]  # Partition Configuration | Configuration of partition specific parameters for the Flash EEPROM Emulation module.
      integer FeePartitionStartAddress: 0..4294967295, set at pre-compile, origin=Vector Informatik, default-value=0  # Partition Start Address | This value specifies the physical start address of the partition.
      integer FeePartitionSize: 0..4294967295, set at pre-compile, origin=Vector Informatik, default-value=256  # Partition Size | This value specifies size of the partition in bytes.
      integer FeePartitionAddressAlignment: 1..65535, set at pre-compile, origin=Vector Informatik, default-value=64  # Address Alignment | Sector size of Flash device for erase jobs in bytes. Address Alignment influences the way FEE stores data entities in Flash. All single entities will start at addresses being an integral multiple of FeePartitionAddressAlignment. This alignment itself must be equal to or greater than this partition's write alignment.
      integer FeePartitionWriteAlignment: 1..65535, set at pre-compile, origin=Vector Informatik, default-value=4  # Write Alignment | Page size of Flash device for write jobs in bytes. This is the alignment of Fls_Write requests the FEE issues to the FLS. Both FLS addresses and lengths are always multiples of this value.
      integer FeePartitionReadAlignment: 1..65535, set at pre-compile, origin=Vector Informatik, default-value=1  # Read Alignment | Smallest readable unit of Flash device in byte. This is the alignment for Fls_Read requests the FEE issues to the FLS.
      boolean FeeFlsBlankCheckApi: set at pre-compile, origin=Vector Informatik, default-value=true  # Fls Blank Check API | This parameter enables/disables internal usage of Fls_BlankCheck service. If FLS provides a blank check service, this parameter should be set to true.
      reference FeePartitionDevice: set at pre-compile, origin=Vector Informatik, destination=FlsConfigSet  # Partition Device | Reference to the FLS module.
  bsw implementation Fee_Impl: programming-language=C, sw-version=2.00.01, used-code-generator=DaVinci Configurator, vendor-id=30, ar-release-version=4.00.03, behavior=Fee_30_SmallSectorBehavior, preconfigured-configuration=Fee_30_SmallSector_Pre, recommended-configuration=Fee_30_SmallSector_Rec, vendor-api-infix=SmallSector, vendor-specific-module-def=Fee
  module config Fee_30_SmallSector_Pre: definition=Fee
  module config Fee_30_SmallSector_Rec: definition=Fee
