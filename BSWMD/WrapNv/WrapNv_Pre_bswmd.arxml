AUTOSAR XML (schema 4-0-3)
package /MICROSAR
  module config WrapNv_Rec: definition=WrapNv
    WrapNvMemoryLayout
      15 x WrapNvDataBlock:
        ProgReqFlag: WrapNvDbCount=1, WrapNvDbDescription=Programming request flag
          ProgReqFlag (WrapNvDataElement): WrapNvDeLength=1, WrapNvDeDescription=Programming request flag
        ResetResponseFlag: WrapNvDbCount=1, WrapNvDbDescription=Reset response flag
          ResetResponseFlag (WrapNvDataElement): WrapNvDeLength=1, WrapNvDeDescription=Reset response flag
        ValidityFlags: WrapNvDbCount=1, WrapNvDbDescription=Logical block validity flagss
          ValidityFlags (WrapNvDataElement): WrapNvDeLength=1, WrapNvDeDescription=Logical block validity flags
        ApplValidity: WrapNvDbCount=1, WrapNvDbDescription=Application validity flag
          ApplValidity (WrapNvDataElement): WrapNvDeLength=1, WrapNvDeDescription=Application validity flag
        ApplUpdate: WrapNvDbCount=1, WrapNvDbDescription=Application update flag
          ApplUpdate (WrapNvDataElement): WrapNvDeLength=1, WrapNvDeDescription=Application update flag
        SecAccessDelayFlag: WrapNvDbCount=1, WrapNvDbDescription=Security Access Delay flag
          SecAccessDelayFlag (WrapNvDataElement): WrapNvDeLength=1, WrapNvDeDescription=Security Access Delay flag
        SecAccessInvalidCount: WrapNvDbCount=1, WrapNvDbDescription=Security Access Invalid count
          SecAccessInvalidCount (WrapNvDataElement): WrapNvDeLength=1, WrapNvDeDescription=Security Access Invalid count
        DcmDslRxTesterSourceAddr: WrapNvDbCount=1, WrapNvDbDescription=Connection for reset response
          DcmDslRxTesterSourceAddr (WrapNvDataElement): WrapNvDeLength=2, WrapNvDeDescription=Connection for reset response
        ProgrammingStatus: WrapNvDbCount=1, WrapNvDbDescription=Programming Status Informationn
          ProgrammingStatus (WrapNvDataElement): WrapNvDeLength=2, WrapNvDeDescription=Programming Status Informationn
        DiagnosticVersion: WrapNvDbCount=1, WrapNvDbDescription=Diagnostic Version of DID F110h
          DiagnosticVersion (WrapNvDataElement): WrapNvDeLength=2, WrapNvDeDescription=Diagnostic Version of DID F110h
        VehicleManufEcuSwNo: WrapNvDbCount=1, WrapNvDbDescription=DID F188 - Vehicle Manufacturer ECU Software Number
          VehicleManufEcuSwNo (WrapNvDataElement): WrapNvDeDescription=DID F188 - Vehicle Manufacturer ECU Software Number, WrapNvDeLength=11
        EbomEcuPartNumber: WrapNvDbCount=1, WrapNvDbDescription=DID F132 - EBOM ECU Part Number
          EbomEcuPartNumber (WrapNvDataElement): WrapNvDeLength=10, WrapNvDeDescription=DID F132 - EBOM ECU Part Number
        CoDePEcuPartNumber: WrapNvDbCount=1, WrapNvDbDescription=DID F187 - CoDeP ECU Part Number
          CoDePEcuPartNumber (WrapNvDataElement): WrapNvDeLength=11, WrapNvDeDescription=DID F187 - CoDeP ECU Part Number
        ExhaustRegulationTan: WrapNvDbCount=1, WrapNvDbDescription=DID F196 - Exhaust Regulation or Type Approval Number
          ExhaustRegulationTan (WrapNvDataElement): WrapNvDeDescription=DID F196 - Exhaust Regulation or Type Approval Number, WrapNvDeLength=6
        Metadata: WrapNvDbCount=2, WrapNvDbDescription=Metadata information for each logical block
          8 x WrapNvDataElement:
            Fingerprint: WrapNvDeLength=13, WrapNvDeDescription=Download fingerprint
            ProgCounter: WrapNvDeLength=2, WrapNvDeDescription=Successful reprogramming attempts
            ProgAttempts: WrapNvDeLength=2, WrapNvDeDescription=Reprogramming attempts
            CRCValue: WrapNvDeLength=1, WrapNvDeDescription=CRC total of logical block
            CRCStart: WrapNvDeLength=1, WrapNvDeDescription=Start address of CRC total
            CRCLength: WrapNvDeLength=1, WrapNvDeDescription=Length of CRC total
            SoftwareIdentification: WrapNvDeLength=13, WrapNvDeDescription=DID F181 or F182 - Application Software- or Application Data Identification
            SwEbomPartNumber: WrapNvDeLength=11, WrapNvDeDescription=DID F122 - S/W EBOM Part Number
    WrapNvGeneral: WrapNvEEPROMBaseAddress=1880104448, WrapNvFirstHandle=1, WrapNvNVMDataHandling=EXTERNAL_EEPROM_DRIVER, WrapNvUserConfigFile=(unset)
