AUTOSAR XML (schema 4-0-3)
package /MICROSAR
  bsw implementation FblHal_Impl: programming-language=C, sw-version=1.00.00, ar-release-version=4.00.03, preconfigured-configuration=FblHal_Pre, recommended-configuration=FblHal_Rec, vendor-specific-module-def=FblHal
  module definition FblHal [0..1]: category=VENDOR_SPECIFIC_MODULE_DEFINITION, variants link-time
    container FblHalGeneral
      boolean FblHalECCSafeRead: set at pre-compile, origin=Vector Informatik, default-value=false
      integer FblHalFlashCodeBufferSize: 0..4294967295, set at pre-compile, origin=Vector Informatik, default-value=1024  # Size of the buffer in the RAM to store the flash algorithm.
      string FblHalDerivativeSpecificDefines [0..*]: set at pre-compile, origin=Vector Informatik, default-value=#define DERIVATIVE_SPECIFIC_DEFINE
      reference FblHalTimerClockRef: set at pre-compile, origin=Vector Informatik, destination=McuClockReferencePoint  # The FBL needs a timebase which is generated by one of the system timers. The timer clock value that has to be configured here is the base frequency for this timer. This value is used to compute the corresponding timer compare/reload and prescaler values for timer hardware initialization. NOTE: If you multiply the frequency with a PLL, you have to multiply this value, too.
    container FblHalRh850
      reference FblHalInternalSystemClockRef: set at pre-compile, origin=Vector Informatik, destination=McuClockReferencePoint  # Enter the internal system clock - this is not the external crystal clock
  module config FblHal_Pre: definition=FblHal
  module config FblHal_Rec: definition=FblHal
