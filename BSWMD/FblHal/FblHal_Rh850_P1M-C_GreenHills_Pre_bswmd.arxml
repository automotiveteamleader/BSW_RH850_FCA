AUTOSAR XML (schema 4-0-3)
# COPYRIGHT
# Copyright (c) 2018 by Vector Informatik GmbH. All rights reserved.
# This software is copyright protected and proprietary to Vector Informatik GmbH.
# Vector Informatik GmbH grants to you only those rights as set out in the license conditions.
package /MICROSAR
  module config FblHal_Pre: definition=FblHal
    FblHalGeneral:
      FblHalDerivativeSpecificDefines = #define V_COMP_GHS
      FblHalDerivativeSpecificDefines = #define V_COMP_GHS_RH850
      FblHalDerivativeSpecificDefines = #define C_COMP_GHS_RH850_MCAN
      FblHalDerivativeSpecificDefines = #define V_CPU_RH850
      FblHalDerivativeSpecificDefines = #define C_CPUTYPE_32BIT
      FblHalDerivativeSpecificDefines = #define C_CPUTYPE_LITTLEENDIAN
      FblHalDerivativeSpecificDefines = #define V_SUPPRESS_EXTENDED_VERSION_CHECK
      FblHalDerivativeSpecificDefines = #define VGEN_ENABLE_CANFBL
      FblHalDerivativeSpecificDefines = #define V_ENABLE_CAN_ASR_ABSTRACTION
      FblHalDerivativeSpecificDefines = #define C_PROCESSOR_P1M_C
      FblHalDerivativeSpecificDefines = #define V_PROCESSOR_P1M_C
    FblHalRh850
  module config FblHal_Rec: definition=FblHal
    FblHalGeneral: FblHalFlashCodeBufferSize=13312, FblHalECCSafeRead=1
    FblHalRh850
