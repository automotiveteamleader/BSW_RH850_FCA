AUTOSAR XML (schema 4-0-3)
package /MICROSAR
  module config Fbl_Pre: definition=Fbl
    FblGeneral:
      FblAdaptiveDataTransferRcrrp = 0
      FblGatewaySupport = 0
      FblInputVerification = 0
      FblSuspendDriverOperation = 0
      FblVerificationFunction = 0
      FblUserRoutine = 0
      FblStayInBoot = 0
  module config Fbl_Rec: definition=Fbl
    FblGeneral:
      FblCommonData = 1
      FblDiagnosticBufferSize = 4095
      FblGapFilling = 0
      FblInternalMemoryCopy = 1
      FblMaximumNumberOfSegments = 10
      FblP2Server = 50
      FblP2StarServer = 5000
      FblProjectState = INTEGRATION
      FblUserConfigFile = $(DpaProjectFolder)\Config\user_config.cfg
      FblVerificationSegmentation = 256
      FblWriteSegmentation = 256
      FblWatchdogService = 1
      FblWatchdogTriggerCycle = 1
      FblUnalignedDataTransfer = 1
      FblResponseAfterReset = 0
      FblOutputVerification = 1
      FblSleepMode = 1
      FblSleepTime = 300000
      FblStartFunction = 0
      FblUserService = 1
      FblS3ServerProgrammingSession = 5000
      FblFlashDriverUsage = USE_FLASH_DRIVER_FROM_ROM
    FblFca: FblAccessDelayTime=10000
