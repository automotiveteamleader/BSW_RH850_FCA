AUTOSAR XML (schema 4-0-3)
package /MICROSAR
  module config Fbl_Pre: definition=Fbl
    FblMemoryDeviceTable
      Flash (FblMemoryDevice): FblMdErasedValue=255, FblMdSegmentSize=256
  module config Fbl_Rec: definition=Fbl
    FblFlashBlockTable
      36 x FblFlashBlock:
        FblFlashBlock_0: FblFbStartAddress=0x0, FblFbEndAddress=0x1fff, FblFbDescription=Flash Bank A Block0 (8KB)
        FblFlashBlock_1: FblFbStartAddress=0x2000, FblFbEndAddress=0x3fff, FblFbDescription=Flash Bank A Block1 (8KB)
        FblFlashBlock_2: FblFbStartAddress=0x4000, FblFbEndAddress=0x5fff, FblFbDescription=Flash Bank A Block2 (8KB)
        FblFlashBlock_3: FblFbStartAddress=0x6000, FblFbEndAddress=0x7fff, FblFbDescription=Flash Bank A Block3 (8KB)
        FblFlashBlock_4: FblFbStartAddress=0x8000, FblFbEndAddress=0x9fff, FblFbDescription=Flash Bank A Block4 (8KB)
        FblFlashBlock_5: FblFbStartAddress=0xa000, FblFbEndAddress=0xbfff, FblFbDescription=Flash Bank A Block5 (8KB)
        FblFlashBlock_6: FblFbStartAddress=0xc000, FblFbEndAddress=0xdfff, FblFbDescription=Flash Bank A Block6 (8KB)
        FblFlashBlock_7: FblFbStartAddress=0xe000, FblFbEndAddress=0xffff, FblFbDescription=Flash Bank A Block7 (8KB)
        FblFlashBlock_8: FblFbStartAddress=0x10000, FblFbEndAddress=0x17fff, FblFbDescription=Flash Bank A Block8 (32KB), FblFbMemoryDeviceRef=Flash
        FblFlashBlock_9: FblFbStartAddress=0x18000, FblFbEndAddress=0x1ffff, FblFbDescription=Flash Bank A Block9 (32KB), FblFbMemoryDeviceRef=Flash
        FblFlashBlock_10: FblFbStartAddress=0x20000, FblFbEndAddress=0x27fff, FblFbDescription=Flash Bank A Block10 (32KB), FblFbMemoryDeviceRef=Flash
        FblFlashBlock_11: FblFbStartAddress=0x28000, FblFbEndAddress=0x2ffff, FblFbDescription=Flash Bank A Block11 (32KB), FblFbMemoryDeviceRef=Flash
        FblFlashBlock_12: FblFbStartAddress=0x30000, FblFbEndAddress=0x37fff, FblFbDescription=Flash Bank A Block12 (32KB), FblFbMemoryDeviceRef=Flash
        FblFlashBlock_13: FblFbStartAddress=0x38000, FblFbEndAddress=0x3ffff, FblFbDescription=Flash Bank A Block13 (32KB), FblFbMemoryDeviceRef=Flash
        FblFlashBlock_14: FblFbStartAddress=0x40000, FblFbEndAddress=0x47fff, FblFbDescription=Flash Bank A Block14 (32KB), FblFbMemoryDeviceRef=Flash
        FblFlashBlock_15: FblFbStartAddress=0x48000, FblFbEndAddress=0x4ffff, FblFbDescription=Flash Bank A Block15 (32KB), FblFbMemoryDeviceRef=Flash
        FblFlashBlock_16: FblFbStartAddress=0x50000, FblFbEndAddress=0x5ffff, FblFbDescription=Flash Bank A Block16-17 (64KB), FblFbMemoryDeviceRef=Flash
        FblFlashBlock_17: FblFbStartAddress=0x60000, FblFbEndAddress=0x6ffff, FblFbDescription=Flash Bank A Block18-19 (64KB), FblFbMemoryDeviceRef=Flash
        FblFlashBlock_18: FblFbStartAddress=0x70000, FblFbEndAddress=0x7ffff, FblFbDescription=Flash Bank A Block20-21 (64KB), FblFbMemoryDeviceRef=Flash
        FblFlashBlock_19: FblFbStartAddress=0x80000, FblFbEndAddress=0x8ffff, FblFbDescription=Flash Bank A Block22-23 (64KB), FblFbMemoryDeviceRef=Flash
        FblFlashBlock_20: FblFbStartAddress=0x90000, FblFbEndAddress=0x9ffff, FblFbDescription=Flash Bank A Block24-25 (64KB), FblFbMemoryDeviceRef=Flash
        FblFlashBlock_21: FblFbStartAddress=0xa0000, FblFbEndAddress=0xaffff, FblFbDescription=Flash Bank A Block26-27 (64KB), FblFbMemoryDeviceRef=Flash
        FblFlashBlock_22: FblFbStartAddress=0xb0000, FblFbEndAddress=0xbffff, FblFbDescription=Flash Bank A Block28-29 (64KB), FblFbMemoryDeviceRef=Flash
        FblFlashBlock_23: FblFbStartAddress=0xc0000, FblFbEndAddress=0xcffff, FblFbDescription=Flash Bank A Block30-31 (64KB), FblFbMemoryDeviceRef=Flash
        FblFlashBlock_24: FblFbStartAddress=0xd0000, FblFbEndAddress=0xdffff, FblFbDescription=Flash Bank A Block32-33 (64KB), FblFbMemoryDeviceRef=Flash
        FblFlashBlock_25: FblFbStartAddress=0xe0000, FblFbEndAddress=0xeffff, FblFbDescription=Flash Bank A Block34-35 (64KB), FblFbMemoryDeviceRef=Flash
        FblFlashBlock_26: FblFbStartAddress=0xf0000, FblFbEndAddress=0xfffff, FblFbDescription=Flash Bank A Block36-37 (64KB), FblFbMemoryDeviceRef=Flash
        FblFlashBlock_27: FblFbStartAddress=0x100000, FblFbEndAddress=0x13ffff, FblFbDescription=Flash Bank A Block38-45 (256KB), FblFbMemoryDeviceRef=Flash
        FblFlashBlock_28: FblFbStartAddress=0x140000, FblFbEndAddress=0x17ffff, FblFbDescription=Flash Bank A Block46-53 (256KB), FblFbMemoryDeviceRef=Flash
        FblFlashBlock_29: FblFbStartAddress=0x180000, FblFbEndAddress=0x1bffff, FblFbDescription=Flash Bank A Block54-61 (256KB), FblFbMemoryDeviceRef=Flash
        FblFlashBlock_30: FblFbStartAddress=0x1c0000, FblFbEndAddress=0x1fffff, FblFbDescription=Flash Bank A Block62-69 (256KB), FblFbMemoryDeviceRef=Flash
        FblFlashBlock_63: FblFbStartAddress=0x1000000, FblFbEndAddress=0x1007fff, FblFbDescription=Extended User Area (32KB), FblFbMemoryDeviceRef=Flash
        FblFlashBlock_64: FblFbStartAddress=0xff200000, FblFbEndAddress=0xff203fff, FblFbDescription=Data Flash Area Block0-255 (16KB)
        FblFlashBlock_65: FblFbStartAddress=0xff204000, FblFbEndAddress=0xff207fff, FblFbDescription=Data Flash Area Block256-511 (16KB)
        FblFlashBlock_66: FblFbStartAddress=0xff208000, FblFbEndAddress=0xff20bfff, FblFbDescription=Data Flash Area Block512-785 (16KB)
        FblFlashBlock_67: FblFbStartAddress=0xff20c000, FblFbEndAddress=0xff20ffff, FblFbDescription=Data Flash Area Block786-1023 (16KB)
