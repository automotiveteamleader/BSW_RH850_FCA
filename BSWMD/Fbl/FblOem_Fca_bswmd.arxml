AUTOSAR XML (schema 4-0-3)
package /MICROSAR
  bsw implementation Fbl_Impl: programming-language=C, sw-version=4.00.00, used-code-generator=DaVinci Configurator, vendor-id=30, ar-release-version=4.00.03, behavior=FblBehavior, preconfigured-configuration=Fbl_Pre, recommended-configuration=Fbl_Rec, vendor-specific-module-def=Fbl
  module definition Fbl [0..1]: category=VENDOR_SPECIFIC_MODULE_DEFINITION, variants link-time  # Configuration of the Fbl (Flash Bootloader) module.
    container FblGeneral
      string FblUserConfigFile [0..1]: set at pre-compile, origin=Vector Informatik  # FBL: If a file path is specified, the file is read and its contents are put at the end of the FBL config file. DEM: Path to an external user configuration file used by the "Configurator 5" generation tool. If you want to overwrite some of the settings in the generated configuration file (Dem_Cfg.h), you can specify a path to a user defined configuration file. The user defined configuration file will be included at the end of the generated preprocessor switches. Definitions in the user defined configuration file can overwrite definitions in the generated configuration file. To specify the file name, you can use "$(var)" sequence(s) in the specified path. Each such sequence is replaced by the content of the related environment variable "var". Additionally you can use following predefined sequences: $(DpaProjectFolder) Absolute directory of the loaded *.dpa file. $(EcuProjectName) Name of the project defined in the loaded *.dpa file. $(EcucFile) Absolute directory "ECUC", defined by the loaded *.dpa file, containing files $(EcuProjectName).ecuc.arxml and $(EcuProjectName).ecuc.Initial.arxml . $(EcucFolder) Parent directory of $(EcucFile). $(SipRootPath) Absolute directory "SIP", defined by the loaded *.dpa file. $(OutputFolder) (Relative) directory "GenData", defined by the loaded *.dpa file. See setting "Root Target Folder" of Configurator 5. $(ServiceSwcFolder) Absolute directory "ServiceComponents", defined by the loaded *.dpa file. $(cwd) Current working directory when starting Configurator 5. RESTRICTIONS: Not all of the settings can be overwritten simply by triggering the preprocessor switch. Some of the options are complex and the code generator generates less or more code depending on the setting. USE SUCH A FILE ONLY AFTER DISCUSSION WITH VECTOR.
      enumeration FblProjectState: {PRODUCTION_REDUCED_CHECKS, PRODUCTION_DEFAULT, INTEGRATION}, set at pre-compile, origin=Vector Informatik, default-value=INTEGRATION  # Code that is required for integration/development is automatically removed once the production state is configured. Test FBL_PROJECT_STATE for FBL_INTEGRATION / FBL_PRODUCTION to use this for your own code. Bootloader internal checks are configured according to the current project state: ~~~ Integration ~~~ Choose this state during development/integration of your integration project. This configuration adds internal configuration and user code checks and hence helps you to find configuration errors easily. Errors found will trigger the callback ApplFblFatalError(). A user specific error handling can be added, e.g. flashing Led if no debugger is available (default: while(1){;}); ~~~ Production (default) ~~~ Choose this state when ready for production. Configuration checks are turned off. ~~~ Production (reduced checks) ~~~ Choose this state when ready for production and if you need to minimize code size. Some additional checks will also be disabled in order to reduce code size. The resulting configuration reports NRCs on runtime errors late. This will make it more difficult to analyze errors that occur on production ECUs. It is therefore recommended to configure "Production (default)" if possible.
      boolean FblStayInBoot: set at pre-compile, origin=Vector Informatik, default-value=false  # If activated the FBL waits a specified time before jumping to a valid application. If a special message is received within this time the FBL stays active. This feature is designed for development phase to avoid reflashing the FBL if the application doesn't work properly.
      integer FblMaximumNumberOfSegments: 1.., set at pre-compile, origin=Vector Informatik, default-value=1  # The download of an application can be separated in several segments depending on the linker settings. To store the addresses and lengths of these segments, the FBL uses an array. Enter the maximum number of address segments here.
      boolean FblSleepMode: set at pre-compile, origin=Vector Informatik, default-value=false  # Enable sleep mode/power down support for FBL.
      integer FblSleepTime: 0..4294967295, set at pre-compile, origin=Vector Informatik, default-value=60000  # If the sleep mode is enabled and the diagnostic layer does not receive a diagnostic request for the period of time specified with this attribute then the function fbl_ap.c::ApplFblBusSleep() is called.
      boolean FblApplicationTimerTask: set at pre-compile, origin=Vector Informatik, default-value=false  # If this option is enabled, the bootloader provides function fbl_ap.c::ApplFblTask(). You can add user specific code to this function which will be called cyclically by the bootloader. The actual call cycle is derived from GENy attribute FblTp_Iso/TP call cycle. Note: The task function won't be called during diagnostic service processing.
      integer FblHeaderAddress: 0..4294967295, set at pre-compile, origin=Vector Informatik, default-value=0  # This is the start address of the bootloader's FblHeader structure (defined in module fbl_main.c). The bootloader header can be located at an arbitrary address using the provided section #pragma instructions. CAUTION: If the application software uses the FblStart mechanism to enter the bootloader, you have to update fbl_cfg.h on change of the FBL header address!
      integer FblDiagnosticBufferSize: 0.., set at pre-compile, origin=Vector Informatik, default-value=255  # This is the size of the RAM buffer which is used to store diagnostic request/response messages. Usually, the download performance will benefit from choosing bigger buffer sizes. The maximum usable buffer size depends on the underlying transport protocol.
      integer FblP2Server: 0.., set at pre-compile, origin=Vector Informatik, default-value=50  # Specify the P2 diagnostic timeout here. The FBL will always send a response, before P2 expires.
      integer FblP2StarServer: 0.., set at pre-compile, origin=Vector Informatik, default-value=5000  # P2* Server | P2* diagnostic response pending time. The FBL will send response pending messages while processing long-lasting service requests. Use this option to configure the response pending timing.
      integer FblS3ServerExtendedSession: 0.., set at pre-compile, origin=Vector Informatik, default-value=5000  # Specifiy the S3 diagnostic timeout for the extended session here. Time for the FBL to keep the extended diagnostic session active while not receiving any diagnostic request message.
      integer FblS3ServerProgrammingSession: 0.., set at pre-compile, origin=Vector Informatik, default-value=5000  # Specify the S3 diagnostic timeout for the programming session here. Time for the FBL to keep the programming diagnostic session active while not receiving any diagnostic request message.
      boolean FblGapFilling: set at pre-compile, origin=Vector Informatik, default-value=false  # If this option is enabled, the bootloader will fill any gaps in the download file (Flashware) with the value of the Fill code attribute.
      integer FblFillCode: 0..255, set at pre-compile, origin=Vector Informatik, default-value=255  # The gaps between two download segments will be filled with the specified byte code. It's recommended to use an illegal opcode according to the used hardware platform.
      boolean FblInternalMemoryCopy: set at pre-compile, origin=Vector Informatik, default-value=false  # If enabled, the bootloader will use an internal memory copy function instead of the library memcpy() function of the compiler vendor.
      boolean FblGatewaySupport: set at pre-compile, origin=Vector Informatik, default-value=false  # This option is used for bootloaders that are connected to multiple CAN networks and contains a gateway support feature. It controls if the bootloader shall support or not the gateway feature. The gateway feature routes messages from a main network to one or more sub networks, depending on the feature of the gateway support in the bootloader.
      boolean FblPresencePattern: set at pre-compile, origin=Vector Informatik, default-value=false  # Logical blocks and/or application validation is checked using presence patterns at the end of each logical block. If this option is used, the decision if an application is available can be made without loading a memory driver (e.g. Eeprom Emulation or external Eeprom).
      boolean FblStartFunction: set at pre-compile, origin=Vector Informatik, default-value=false  # This option provides a user-friendly way to start the bootloader from within the application by using the macro CallFblStart(). PRECONDITIONS: - The FblHeader address is configured correctly (see GENy component FblDrvCan_*). - The application module which uses CallFblStart() includes fbl_def.h (fbl_cfg.h has to be provided, too). Remember to update fbl_cfg.h if the address of FblHeader changes! By disabling this option, the user can gain more influence on how the transition from application to bootloader is done. This is the procedure which has to be followed: - Set a flag in the application software - Issue a reset - Check flag in user adaptable function fbl_apnv.c::ApplFblExtProgRequest() and provide the appropriate return value.
      boolean FblCommonData: set at pre-compile, origin=Vector Informatik, default-value=false  # By enabling this option, the bootloader provides an interface to access (constant) data which is linked with the bootloader. This enables the application software to read e.g. DID values from the same memory location as the bootloader. In particular, this is useful for DIDs that report hardware specific information which doesn't change if the application software is updated. The structure of the common data is completely user specific and can be declared in file comdat.h. The actual structure definition is usually located in file fbl_ap.c. The bootloader stores the address of this structure in the FblHeader. The respective value can be retrieved by using macro GetFblCommonDataPtr(). To access the common data via GetFblCommonDataPtr(), the application software has to include the files fbl_def.h (which itself needs fbl_cfg.h) and comdat.h. For more detailed usage information, please refer to the respective technical reference.
      boolean FblResponseAfterReset: set at pre-compile, origin=Vector Informatik, default-value=false  # Send the response to a default session request or a reset request after the ECU has been reset. Before the reset, a response pending message is sent by the Bootloader. The actual response has to be sent by the application software or the Bootloader depending on a flag set in non-initialized memory.
      boolean FblUserSubfunction: set at pre-compile, origin=Vector Informatik, default-value=false  # This option can be activated if user specific subfunction parameters have to be supported which are not defined within the OEM specification. If the bootloader receives a request with a supported service identifier and an unknown subfunction parameter, the user adaptable function fbl_apdi.c::ApplDiagUserSubFunction() will be called.
      boolean FblUserService: set at pre-compile, origin=Vector Informatik, default-value=false  # This option can be activated if user specific diagnostic services have to be supported which are not defined within the OEM specification. If the bootloader receives a request with an unsupported service identifier, the user adaptable function fbl_apdi.c::ApplDiagUserService() will be called.
      boolean FblUserRoutine: set at pre-compile, origin=Vector Informatik, default-value=false  # This option can be activated if user specific diagnostic routines have to be supported which are not defined within the OEM specification. If the bootloader receives a request with an unsupported routine ID, the user adaptable function fbl_apdi.c::ApplDiagRoutineControl() will be called.
      boolean FblWatchdogService: set at pre-compile, origin=Vector Informatik, default-value=false  # If this option is enabled, the bootloader provides an API for watchdog service handling. User specific watchdog service code can be added to function fbl_apwd.c::ApplFblWDTrigger().
      integer FblWatchdogTriggerCycle: 1.., set at pre-compile, origin=Vector Informatik, default-value=1  # If the watchdog service is enabled, the bootloader will call user function fbl_apwd.c::ApplFblWDTrigger() with the specified cycle time.
      boolean FblEncryptionMode: set at pre-compile, origin=Vector Informatik, default-value=false  # Enabling this option allows for transmission of encrypted data. The data which is received by the bootloader will be decrypted by means of a dedicated decryption module.
      boolean FblCompressionMode: set at pre-compile, origin=Vector Informatik, default-value=false  # Enabling this option allows for transmission of compressed data. The data which is received by the bootloader will be decompressed by means of a dedicated compression module.
      integer FblDataProcessingBufferSize: 0..4294967295, set at pre-compile, origin=Vector Informatik, default-value=0  # Defines the maximum output buffer size available for handling of preprocessed data, e.g. decryption or decompression.
      boolean FblInputVerification: set at pre-compile, origin=Vector Informatik, default-value=false  # If enabled the signature verification will take the downloaded data instead of the data written to non-volatile memory (e.g. flash) as input. The transferred data is passed to the hash/checksum calculation before any data processing takes place. E.g. if compressed data is downloaded the signature is calculated over the compressed data and not the uncompressed contents actually written to flash.
      boolean FblProcessedVerification: set at pre-compile, origin=Vector Informatik, default-value=false
      boolean FblPipelinedVerification: set at pre-compile, origin=Vector Informatik, default-value=false
      boolean FblOutputVerification: set at pre-compile, origin=Vector Informatik, default-value=false
      integer FblVerificationSegmentation: 0..4294967295, set at pre-compile, origin=Vector Informatik, default-value=0  # Defines the maximum data length passed to the on-the-fly verification in a single processing cycle.
      boolean FblAdaptiveDataTransferRcrrp: set at pre-compile, origin=Vector Informatik, default-value=false  # Disable to force the transmission of the first RCR-RP (Response Pending) message before starting processing of the download data. If enabled the first RCR-RP will be conditionally send based on the P2 timeout. Requires that a single program operation takes less than P2! Programming time depends on "Write segmentation" and/or "Data processing buffer size" Also applies to times required by on-the-fly signature verification and data processing.
      boolean FblPipelinedProgramming: set at pre-compile, origin=Vector Informatik, default-value=false  # With this feature enabled, the FBL immediately sends a positive response after the reception of a TransferData request, so that the next data transfer can be performed while the previous data block is programmed. The same parallelization applies to the signature calculation over the transfer data in RAM and the decompression/decryption of the received data. In best case only the pure transmission time is required.
      boolean FblSuspendDriverOperation: set at pre-compile, origin=Vector Informatik, default-value=false  # Memory driver can be suspended in mid-operation by external event.
      integer FblWriteSegmentation: 0..4294967295, set at pre-compile, origin=Vector Informatik, default-value=0  # Defines the maximum data length passed to the programming routine in a single processing cycle. Used for options "Adaptive RCR-RP for TransferData service" and "Pipelined programming".
      boolean FblUnalignedDataTransfer: set at pre-compile, origin=Vector Informatik, default-value=false  # If enabled the data transferred during download using the TransferData service can be of arbitrary length. Otherwise all data transfers have to be aligned to a multiple of the largest memory write segment size.
      boolean FblVerificationFunction: set at pre-compile, origin=Vector Informatik, default-value=false  # Add support for Driver_VerifySync
      enumeration FblFlashDriverUsage: {DOWNLOAD_DRIVER, USE_FLASH_DRIVER_FROM_ROM, OPTIONAL_FLASH_DRIVER_DOWNLOAD}, set at pre-compile, origin=Vector Informatik, default-value=DOWNLOAD_DRIVER  # Configures the source of the flash driver RAM image. Download Driver: Flash Driver is downloaded to the ECU. Use Flash Driver from ROM: Flash Driver is stored in an encrypted ROM image in the bootloader’s flash memory and copied to RAM before initialization. Optional Flash Driver Download: Flash Driver can be downloaded to the ECU. If it isn’t downloaded, the flash driver from an internal image will be used. Please note: Depending on your OEM’s requirements, not all of these options may be available in the embedded bootloader implementation.
      boolean FblApplicationStateTask: set at pre-compile, origin=Vector Informatik, default-value=false  # If this option is enabled, the bootloader provides function fbl_ap.c::ApplFblStateTask(). You can add user specific code to this function which will be called as a background task by the bootloader. Note: The task function won't be called during diagnostic service processing.
    container FblFlashBlockTable
      container FblFlashBlock [0..*]
        integer FblFbStartAddress: 0..4294967295, set at pre-compile, origin=Vector Informatik, default-value=0  # 01 Start Address | Start address of the flash block.
        integer FblFbEndAddress: 0..4294967295, set at pre-compile, origin=Vector Informatik, default-value=0  # 02 End Address | End address of the flash block.
        string FblFbDescription: set at pre-compile, origin=Vector Informatik  # 05 Description | A short description of the flash block.
        reference FblFbMemoryDeviceRef [0..1]: set at pre-compile, origin=Vector Informatik, destination=FblMemoryDevice  # 03 Memory Device Ref
        reference FblFbLogicalBlockRef [0..1]: set at pre-compile, origin=Vector Informatik, destination=FblLogicalBlock  # 04 Logical Block Ref
    container FblLogicalBlockTable
      container FblLogicalBlock [0..*]
        integer FblLbBlockIndex: 0..4294967295, set at pre-compile, origin=Vector Informatik, default-value=0  # 01 Block Index
        enumeration FblLbBlockType: {CODE, DATA, BOOT}, set at pre-compile, origin=Vector Informatik, default-value=CODE  # 02 BlockType
        enumeration FblLbDisposability: {MANDATORY, OPTIONAL}, set at pre-compile, origin=Vector Informatik, default-value=MANDATORY  # 03 Disposability
        integer FblLbStartAddress: 0..4294967295, set at pre-compile, origin=Vector Informatik, default-value=0  # 04 Start Address | Start address of the logical block. This value is computed automatically.
        integer FblLbEndAddress: 0..4294967295, set at pre-compile, origin=Vector Informatik, default-value=0  # 05 End Address | End address of the logical block. This value is computed automatically.
        integer FblLbMaxReprogAttempts: 0..65535, set at pre-compile, origin=Vector Informatik, default-value=0  # 08 Max Reprog Attempts | Maximum number of reprogramming cycles
        string FblLbInputVerification: set at pre-compile, origin=Vector Informatik, default-value=SecM_VerifySignature  # 09 Input Verification | Verification function used for input verification. The interface of the provided function has to be compatible with the prototype of SecM_VerifySignature. When "Input Verification" is enabled, this function will take the downloaded data in RAM as input. The transferred data is passed to the hash/checksum calculation before any data processing takes place. E.g. if compressed data is downloaded, the signature is calculated over the compressed data and not the decompressed contents actually written to non-volatile memory (e.g. flash). In some rare use cases it might be useful to call an alternative user-specific function for a logical block. E.g. if you like to compute a checksum (security class DDD) during the TransferData requests instead of a signature. Set to "0" to disable input verification for this particular block. Caution: In this case the Bootloader will accept any signature/checksum, regardless of the previously downloaded data!
        string FblLbProcessedVerification: set at pre-compile, origin=Vector Informatik, default-value=SecM_VerifySignature  # 10 Processed Verification | Verification function used for processed verification. The interface of the provided function has to be compatible with the prototype of SecM_VerifySignature. When "Processed Verification" is enabled, this function will take the processed download data in RAM as input. The transferred data is passed to the hash/checksum calculation after performing any applicable data processing. E.g. if compressed data is downloaded, the signature is calculated over the decompressed data as it will be written to non-volatile memory (e.g. flash). In some rare use cases it might be useful to call an alternative user-specific function for a logical block. E.g. if the memory device doesn't allow a read back of the programmed data because a low-level flash programmer interface is used, this function can be used to verify a signature over the data to be programmed, instead of completely ignoring it. The output verification typically used for this task is either disabled or triggers an alternative verification, e.g. a simple checksum check. Set to "0" to disable processed verification for this particular block. Caution: In this case the Bootloader will accept any signature/checksum, regardless of the previously downloaded data!
        string FblLbPipelinedVerification: set at pre-compile, origin=Vector Informatik, default-value=SecM_VerifySignature  # 11 Pipelined Verification | Verification function used for pipelined verification. The interface of the provided function has to be compatible with the prototype of SecM_VerifySignature. When "Pipelined Verification" is enabled, this function will take the data written to non-volatile memory (e.g. flash) as input. The processing will be performed on the already written contents, while the reception of further download data is still ongoing. Reading back the memory and calculating the hash/checksum is performed in parallel to the reception. This can significantly reduce the verification time at the end of the download. In some use cases it might be useful to call an alternative user-specific function for a logical block. E.g. if the read back of the written data from a memory device takes too long, making it unsuitable for pipelined verification. By providing a dummy function or disabling the verification for this particular block only and performing an output verification instead, pipelined verification doesn't have to be disabled completely. This way other blocks can still benefit from the increased performance of pipelined verification. Set to "0" to disable pipelined verification for this particular block. Caution: In this case the Bootloader will accept any signature/checksum, regardless of the previously downloaded data!
        string FblLbOutputVerification: set at pre-compile, origin=Vector Informatik, default-value=SecM_Verification  # 12 Output Verification | Verification function used for output verification. The interface of the provided function has to be compatible with the prototype of SecM_Verification. When "Output Verification" is enabled, this function verification will take the data written to non-volatile memory (e.g. flash) as input. The processing will be performed on the written contents, after the complete data was transferred and programmed. In some use cases it might be useful to call an alternative user-specific function for a logical block. E.g. if you like to avoid read back of the written data from a slave processor in a multi-processor configuration. This function could pass the request including the necessary information to the slave controller. Calculation is then carried out on the slave controller and the result is passed back to the master controller. Set to "0" to disable output verification for this particular block. Caution: In this case the Bootloader will accept any signature/checksum, regardless of the previously downloaded data!
        string FblLbDescription: set at pre-compile, origin=Vector Informatik  # 13 Description | Short description of this Logical Block
    container FblMemoryDeviceTable
      container FblMemoryDevice [0..*]
        integer FblMdSegmentSize: 1..65535, set at pre-compile, origin=Vector Informatik, default-value=1  # 01 Segment Size | Write segment size of memory device. The write segment size is the smallest entity that can be programmed in one write access. Refer to the memory device specification for this value.
        integer FblMdErasedValue: 0..255, set at pre-compile, origin=Vector Informatik, default-value=255  # 02 Erased Value | Erased value of the memory device. The erased value is the memory content after the memory was erased. Refer to the memory device specification for this value.
    container FblFca
      integer FblAccessDelayTime: 0..4294967295, set at pre-compile, origin=Vector Informatik, default-value=600000  # After 3 (default) wrong keys, access to the ECU will be refused for this time.
      boolean FblCheckProgrammingPreconditionsService: set at pre-compile, origin=Vector Informatik, default-value=true  # Activates the Check Programming Preconditions service. If activated, the service has to be sent by the tester before entering programming session.
      boolean FblApplicationValidityFlag: set at pre-compile, origin=Vector Informatik, default-value=true  # Uses an application validity flag to store the application's validity. This flag is saved into non-volatile memory and read during startup to check if the application software should be started.
  module config Fbl_Pre: definition=Fbl
  module config Fbl_Rec: definition=Fbl
