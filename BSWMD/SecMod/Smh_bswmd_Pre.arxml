AUTOSAR XML (schema 4-0-3)
package /MICROSAR
  module config Smh_Pre: definition=Smh
    SmhCryptographicKeys
      SecM_RsaExp (SmhKey): SmhDescription=Public verification key exponent, SmhKeyValueRef=SmhKeyValue_RsaExp
      SecM_RsaMod (SmhKey): SmhDescription=Public verification key modulus, SmhKeyValueRef=SmhKeyValue_RsaMod
    SmhVerification: SmhHashAlgorithm=RIPEMD_160
  module config Smh_Rec: definition=Smh
    SmhCryptographicKeys
      SmhKeyValue_RsaExp (SmhKeyValue): SmhDescription=Verification key exponent, SmhValue=9D85
      SmhKeyValue_RsaMod (SmhKeyValue):
        SmhDescription = Verification key modulus
        SmhValue = F7242F3BB8697EE5C3ACAF800BA1C84E3C89EA373987073D971E91F83AD436F609BBBB8FBF250398860BB20C630BA124D9348BE0BA61F9436621205E0289AE238DDABD16EBB715EA85DDB988CC31D374D7C5800A74F6DA681106D0A63D50BA1FEA4FC202950F582E12E0BAF6FFE0F4C5E276A5AADAE7B8773476D09B0B883A83
    SmhCrc: SmhOptimization=SPEED
    SmhGeneral: SmhWatchdogCycleCount=1, SmhOperationMode=PRODUCTION
    SmhVerification
      SmhMonolithicVerification: SmhIncludeAddressAndLengthInSignature=1, SmhSignatureOffset=2
    SmhSeedKey: SmhKeyConstant=4294967295, SmhKeyTimeout=0
