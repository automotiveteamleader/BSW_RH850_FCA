AUTOSAR XML (schema 4-0-3)
package /MICROSAR
  bsw implementation Smh_Impl: programming-language=C, sw-version=2.09.00, used-code-generator=DaVinci Configurator, vendor-id=30, ar-release-version=4.00.03, behavior=SmhBehavior, preconfigured-configuration=Smh_Pre, recommended-configuration=Smh_Rec, vendor-specific-module-def=Smh
  module definition Smh [0..1]: category=VENDOR_SPECIFIC_MODULE_DEFINITION, variants link-time  # Configuration of the Smh (SecModHis, Security Module implementing the HIS specification) module.
    container SmhGeneral
      enumeration SmhOperationMode: set at pre-compile, origin=Vector Informatik, default-value=PRODUCTION
        DEVELOP  # SEC_DEVELOPMENT
        PRODUCTION  # SEC_PRODUCTION
      integer SmhWatchdogCycleCount: 1..4294967295, set at pre-compile, origin=Vector Informatik, default-value=1  # Controls frequency of polling function calls within loops including SEC_WATCHDOG_CYCLE_TRIGGER macro calls, e.g. from Sec_Crc.c. The called function will typically be the Bootloader Polling (Watchdog Trigger) function and by this configuration will happen every Nth call (where N == configured cycle Count).
      boolean SmhCryptographicKeysLocatedInRAM: set at pre-compile, origin=Vector Informatik, default-value=false
      enumeration SmhCryptographicWorkspaces: {INTERNAL, EXTERNAL, BOTH}, set at pre-compile, origin=Vector Informatik, default-value=INTERNAL
      enumeration SmhRSAKeySize: set at pre-compile, origin=Vector Informatik, default-value=RSA_1024
        RSA_1024  # SEC_RSA_KEY_LENGTH_1024
        RSA_1536  # SEC_RSA_KEY_LENGTH_1536
        RSA_2048  # SEC_RSA_KEY_LENGTH_2048
        RSA_3072  # SEC_RSA_KEY_LENGTH_3072
        RSA_4096  # SEC_RSA_KEY_LENGTH_4096
      string SmhUserConfigFile [0..1]: set at pre-compile, origin=Vector Informatik  # FBL: If a file path is specified, the file is read and its contents are put at the end of the FBL config file. DEM: Path to an external user configuration file used by the "Configurator 5" generation tool. If you want to overwrite some of the settings in the generated configuration file (Dem_Cfg.h), you can specify a path to a user defined configuration file. The user defined configuration file will be included at the end of the generated preprocessor switches. Definitions in the user defined configuration file can overwrite definitions in the generated configuration file. To specify the file name, you can use "$(var)" sequence(s) in the specified path. Each such sequence is replaced by the content of the related environment variable "var". Additionally you can use following predefined sequences: $(DpaProjectFolder) Absolute directory of the loaded *.dpa file. $(EcuProjectName) Name of the project defined in the loaded *.dpa file. $(EcucFile) Absolute directory "ECUC", defined by the loaded *.dpa file, containing files $(EcuProjectName).ecuc.arxml and $(EcuProjectName).ecuc.Initial.arxml . $(EcucFolder) Parent directory of $(EcucFile). $(SipRootPath) Absolute directory "SIP", defined by the loaded *.dpa file. $(OutputFolder) (Relative) directory "GenData", defined by the loaded *.dpa file. See setting "Root Target Folder" of Configurator 5. $(ServiceSwcFolder) Absolute directory "ServiceComponents", defined by the loaded *.dpa file. $(cwd) Current working directory when starting Configurator 5. RESTRICTIONS: Not all of the settings can be overwritten simply by triggering the preprocessor switch. Some of the options are complex and the code generator generates less or more code depending on the setting. USE SUCH A FILE ONLY AFTER DISCUSSION WITH VECTOR.
    container SmhCrc
      enumeration SmhCRCType: set at pre-compile, origin=Vector Informatik, default-value=CRC_32
        CRC_16_CCITT  # SEC_CRC16_CCITT
        CRC_32  # SEC_CRC32
      enumeration SmhOptimization: set at pre-compile, origin=Vector Informatik, default-value=SPEED
        SIZE  # SEC_CRC_SIZE_OPTIMIZED
        SPEED  # SEC_CRC_SPEED_OPTIMIZED
    container SmhEncryption
      boolean SmhDecryption: set at pre-compile, origin=Vector Informatik, default-value=false
      boolean SmhEncryption: set at pre-compile, origin=Vector Informatik, default-value=false
      enumeration SmhEncryptionAlgorithm: set at pre-compile, origin=Vector Informatik, default-value=AES_256
        AES_128  # SEC_AES128
        AES_192  # SEC_AES192
        AES_256  # SEC_AES256
      enumeration SmhCryptographicEncryptionKeys: {INTERNAL, EXTERNAL, BOTH}, set at pre-compile, origin=Vector Informatik, default-value=INTERNAL
      string SmhDefaultCryptographicEncryptionKeyPrefix: set at pre-compile, origin=Vector Informatik, default-value=SecM_AES128key
      reference SmhDefaultCryptographicEncryptionKey [0..1]: set at pre-compile, origin=Vector Informatik, destination=SmhKey
    container SmhSeedKey
      integer SmhKeyConstant: 0..4294967295, set at pre-compile, origin=Vector Informatik, default-value=0
      integer SmhKeyTimeout: 0..65535, set at pre-compile, origin=Vector Informatik, default-value=100
      integer SmhCallCycle: 0..65535, set at pre-compile, origin=Vector Informatik, default-value=10
      enumeration SmhAlgorithm: {BASIC, HMAC_SHA_1, RSA}, set at pre-compile, origin=Vector Informatik, default-value=BASIC
      enumeration SmhCryptographicSeedKeyKeys: {INTERNAL, EXTERNAL, BOTH}, set at pre-compile, origin=Vector Informatik, default-value=INTERNAL
      string SmhDefaultCryptographicSeedKeyKeyPrefix: set at pre-compile, origin=Vector Informatik, default-value=SecSeedKeyRsa
      reference SmhDefaultCryptographicSeedKeyKey [0..1]: set at pre-compile, origin=Vector Informatik, destination=SmhKey
    container SmhVerification
      enumeration SmhChecksumTypeClassDDD: set at pre-compile, origin=Vector Informatik, default-value=CRC
        CRC  # SEC_CHECKSUM_TYPE_CRC
        HASH  # SEC_CHECKSUM_TYPE_HASH
      enumeration SmhHashAlgorithm: set at pre-compile, origin=Vector Informatik, default-value=SHA_1
        RIPEMD_160  # SEC_RIPEMD160
        SHA_1  # SEC_SHA1
        SHA_256  # SEC_SHA256
        SHA_512  # SEC_SHA512
      boolean SmhDiscreteHashCalculation: set at pre-compile, origin=Vector Informatik, default-value=false
      enumeration SmhSignatureScheme: set at pre-compile, origin=Vector Informatik, default-value=RSA_PKCS_1_V15
        RSA_PKCS_1_V15  # SEC_SIGNATURE_SCHEME_RSA_V15
        RSA_PSS  # SEC_SIGNATURE_SCHEME_RSA_PSS
        ED25519  # SEC_SIGNATURE_SCHEME_ECDSA_CURVE25519
      boolean SmhSecurityClassDDD: set at pre-compile, origin=Vector Informatik, default-value=false
      boolean SmhSecurityClassC: set at pre-compile, origin=Vector Informatik, default-value=false
      boolean SmhSecurityClassCCC: set at pre-compile, origin=Vector Informatik, default-value=false
      boolean SmhSecurityClassVendor: set at pre-compile, origin=Vector Informatik, default-value=false
      integer SmhSizeOfVendorChecksum: 0..65535, set at pre-compile, origin=Vector Informatik, default-value=1
      enumeration SmhCryptographicVerificationKeys: {INTERNAL, EXTERNAL, BOTH}, set at pre-compile, origin=Vector Informatik, default-value=INTERNAL
      string SmhDefaultCryptographicKeyClassCPrefix: set at pre-compile, origin=Vector Informatik, default-value=kSecM_SecretKeyClassC  # Default Cryptographic Key Class C Prefix
      string SmhDefaultCryptographicKeyClassCCCPrefix: set at pre-compile, origin=Vector Informatik, default-value=SecM_Rsa
      reference SmhDefaultCryptographicKeyClassC [0..1]: set at pre-compile, origin=Vector Informatik, destination=SmhKey
      reference SmhDefaultCryptographicKeyClassCCC [0..1]: set at pre-compile, origin=Vector Informatik, destination=SmhKey
      container SmhMonolithicVerification
        enumeration SmhSecurityClass: set at pre-compile, origin=Vector Informatik, default-value=CLASS_CCC
          CLASS_DDD  # SEC_CLASS_DDD
          CLASS_C  # SEC_CLASS_C
          CLASS_CCC  # SEC_CLASS_CCC
          VENDOR  # SEC_CLASS_VENDOR
        enumeration SmhMemoryAccessMode: set at pre-compile, origin=Vector Informatik, default-value=ADDRESS
          ADDRESS  # SEC_ADDRESS
          FILE  # SEC_FILE
        integer SmhReadBufferSize: 0..4294967295, set at pre-compile, origin=Vector Informatik, default-value=64
        boolean SmhIncludeAddressAndLengthInSignature: set at pre-compile, origin=Vector Informatik, default-value=false
        boolean SmhCRCTotal: set at pre-compile, origin=Vector Informatik, default-value=false
        boolean SmhCRCWritten: set at pre-compile, origin=Vector Informatik, default-value=false
        boolean SmhVendorChecksum: set at pre-compile, origin=Vector Informatik, default-value=false
        integer SmhSignatureOffset: 0..4294967295, set at pre-compile, origin=Vector Informatik, default-value=0
        integer SmhCRCOffset: 0..4294967295, set at pre-compile, origin=Vector Informatik, default-value=0
        boolean SmhAssertReadCount: set at pre-compile, origin=Vector Informatik, default-value=false
        boolean SmhCheckAddressRangeOverflow: set at pre-compile, origin=Vector Informatik, default-value=false
        boolean SmhExportVerificationWrapper: set at pre-compile, origin=Vector Informatik, default-value=false
        integer SmhOperationCountOfWrapper: 0..4294967295, set at pre-compile, origin=Vector Informatik, default-value=4
      container SmhStreamVerification
        enumeration SmhSecurityClass: set at pre-compile, origin=Vector Informatik, default-value=CLASS_CCC
          CLASS_DDD  # SEC_CLASS_DDD
          CLASS_C  # SEC_CLASS_C
          CLASS_CCC  # SEC_CLASS_CCC
          VENDOR  # SEC_CLASS_VENDOR
        boolean SmhUpdateLengthOfHashedData: set at pre-compile, origin=Vector Informatik, default-value=false
    container SmhCryptographicKeys
      container SmhKey [0..*]
        string SmhDescription: set at pre-compile, origin=Vector Informatik
        reference SmhKeyValueRef [1..*]: set at pre-compile, origin=Vector Informatik, destination=SmhKeyValue
      container SmhKeyValue [0..*]
        string SmhSuffix: set at pre-compile, origin=Vector Informatik
        string SmhValue: set at pre-compile, origin=Vector Informatik
        string SmhDescription: set at pre-compile, origin=Vector Informatik
  module config Smh_Pre: definition=Smh
  module config Smh_Rec: definition=Smh
