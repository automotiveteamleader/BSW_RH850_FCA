AUTOSAR XML (schema 4-0-3)
package /MICROSARFBL
  bsw implementation Dcm_Impl: programming-language=C, sw-version=8.03.00, used-code-generator=DaVinci Configurator, vendor-id=30, ar-release-version=4.00.03, behavior=DcmBehavior, preconfigured-configuration=Dcm_Pre, recommended-configuration=Dcm_Rec, vendor-specific-module-def=Dcm
  module definition Dcm [0..1]: category=VENDOR_SPECIFIC_MODULE_DEFINITION, api-service-prefix=FblCw, refined-module-def=Dcm, variants pre-compile/post-build-loadable/post-build-selectable  # Configuration of the Dcm (Diagnostic Communications Manager) module.
    container DcmConfigSet  # This container contains the configuration parameters and sub containers of the Dcm module supporting multiple configuration sets.
      container DcmDsl  # These parameters apply to a Diagnostic Session Layer. There may be a parameter set (DSL Configuration) per protocol.
        container DcmDslBuffer  # This container contains the configuration (parameters) for the diagnostic buffer.
          integer DcmDslBufferSize: 8..4294967294, set at pre-compile, default-value=50  # Specifies the size of a diagnostic buffer (in Bytes). Effect: ------------------------------------ Determines the longest request and in some cases - response the Dcm will be able to receive, resp. transmit. Constraints: ------------------------------------ It depends on the communication bus system how much buffer shall be reserved. For example on CAN a buffer of more than 4095 will not bring any advantage since the CanTp can transfer only up to 4095 bytes. Dependencies: ------------------------------------ In case of Paged Buffer usage (refer to DcmPageBufferCfg), the buffer size shall be chosen such that at least the longest snapshot record/extended data record of the Dem plus some additional bytes (i.e. in case of CAN -> 6 additional bytes) will fit it. Runtime effects: ------------------------------------ none Code ROM usage effects: ------------------------------------ none Const data ROM usage effects: ------------------------------------ none Global RAM usage effects: ------------------------------------ The greater the buffer the more RAM will be required. Stack RAM usage effects: ------------------------------------ none
        container DcmDslDiagResp  # This container contains the configuration (parameters) for the ResponsePending handling
          boolean DcmDslDiagRespOnSecondDeclinedRequest: set at pre-compile, origin=AUTOSAR_ECUC V1.0.0, default-value=false  # Defines the reaction upon a second request (ClientB) that can not be processed (e.g. due to priority assessment). Effect: ------------------------------------ If enabled, the Dcm will reject any nested diagnostic request by NRC 0x21 (BusyRepeatRequest). Constraints: ------------------------------------ For optimization reasons not all Dcm managed connection will support this feature by default. It is configurable how many parallel (nested) request to be handled at a time to save RAM and run time resources. Dependencies: ------------------------------------ Refer to DcmDslDiagRespMaxNumOfDeclinedRequests. Runtime effects: ------------------------------------ If enabled the Dcm diagnostic request reception functionality will have slightly increased run time usage. Code ROM usage effects: ------------------------------------ If enabled the Dcm will have slightly increased code ROM usage. Const data ROM usage effects: ------------------------------------ none Global RAM usage effects: ------------------------------------ If enabled the Dcm will have slightly increased RAM usage. Stack RAM usage effects: ------------------------------------ If enabled the Dcm will have insignificantly increased stack usage within the Rx ISRs.
          integer DcmDslDiagRespMaxNumOfDeclinedRequests: 1..255, set at pre-compile, origin=Vector Informatik, default-value=3  # Defines the maximum number of reactions upon a second request (ClientB) that can not be processed (e.g. due to priority assessment). Effect: ------------------------------------ The Dcm will calculate the required amount of resources upon the specified by this option resource for parallel client processing. Constraints: ------------------------------------ If the amount of configured requests exceeds the total number of Dcm connections, during the code generation the resource usage optimization will be disabled and only as many as available diagnostic connection objects will be allocated. This will also shorten the run time usage (see below). Dependencies: ------------------------------------ Has any effect only if DcmDslDiagRespOnSecondDeclinedRequest is enabled. Runtime effects: ------------------------------------ The more clients to be handled the longer the run time for looking up for free resources. If the number of declined requests matches the total number of Dcm connection, no look up will be necessary, and the run time will be minimal. Code ROM usage effects: ------------------------------------ If the number of declined requests matches the total number of Dcm connection, no look up will be necessary, and the code ROM will be minimal. Const data ROM usage effects: ------------------------------------ none Global RAM usage effects: ------------------------------------ The more clients to be handled the more RAM will be required for handling them. Stack RAM usage effects: ------------------------------------ If the number of declined requests matches the total number of Dcm connection, no look up will be necessary, and the stack usage will be minimal.
        container DcmDslProtocol  # This container contains the configuration (parameters) for the protocol configuration (for each protocol) The following parameters needs to be configured per protocol.
          container DcmDslProtocolRow  # Definition of a single Row of configuration for the protocol configuration (for each protocol)
            enumeration DcmDslProtocolID: {DCM_OBD_ON_CAN, DCM_OBD_ON_FLEXRAY, DCM_OBD_ON_IP, DCM_PERIODICTRANS_ON_IP, DCM_PERIODIC_ON_CAN, DCM_PERIODIC_ON_FLEXRAY, DCM_ROE_ON_CAN, DCM_ROE_ON_FLEXRAY, DCM_ROE_ON_IP, DCM_SUPPLIER_1, DCM_SUPPLIER_10, DCM_SUPPLIER_11, DCM_SUPPLIER_12, DCM_SUPPLIER_13, DCM_SUPPLIER_14, DCM_SUPPLIER_15, DCM_SUPPLIER_2, DCM_SUPPLIER_3, DCM_SUPPLIER_4, DCM_SUPPLIER_5, DCM_SUPPLIER_6, DCM_SUPPLIER_7, DCM_SUPPLIER_8, DCM_SUPPLIER_9, DCM_UDS_ON_CAN, DCM_UDS_ON_FLEXRAY, DCM_UDS_ON_IP}, set at post-build in variant post-build-loadable+post-build-selectable / pre-compile in variant pre-compile, symbolic-name-value=true, default-value=DCM_UDS_ON_CAN  # Specifies the diagnostic protocol type the Dcm shall manage. Effect: ------------------------------------ On a multi protocol configuration Dcm will be able to distinguish among different protocols and notify the application for activation/deactivation of a concrete protocol, specified by this parameter. Constraints: ------------------------------------ none Dependencies: ------------------------------------ Has any effect only if multi protocol configuration is used. Runtime effects: ------------------------------------ none Code ROM usage effects: ------------------------------------ none Const data ROM usage effects: ------------------------------------ none Global RAM usage effects: ------------------------------------ none Stack RAM usage effects: ------------------------------------ none
            choice container DcmDslConnection [1..254]: post-build-changeable=true  # This container contains links between Diagnostic Protocol (=DcmDslProtocolRow) and the according Rx or Tx channel.
              container DcmDslMainConnection  # This container contains configuration for Diagnostic Main Connection
                integer DcmDslProtocolRxTesterSourceAddr: 0..65535, set at post-build in variant post-build-loadable+post-build-selectable / pre-compile in variant pre-compile  # Specifies a unique identifier of a diagnostic client connection. Effect: ------------------------------------ The Dcm is able to identify different clients or the same client on multiple channels using this identifier. Constraints: ------------------------------------ For each DcmDslConnection there shall be a unique value assigned to this parameter. Dependencies: ------------------------------------ none Runtime effects: ------------------------------------ none Code ROM usage effects: ------------------------------------ none Const data ROM usage effects: ------------------------------------ none Global RAM usage effects: ------------------------------------ none Stack RAM usage effects: ------------------------------------ none
                integer DcmDslPayloadLimit: 0..4294967295, set at pre-compile, origin=Vector Informatik, default-value=4095
                container DcmDslProtocolRx [1..*]: post-build-changeable=true  # This container describes a single Dcm logical receive PDU. Effect: ------------------------------------ For each defined DcmDslProtocolRx, the Dcm will be able to receive a diagnostic request. Constraints: ------------------------------------ none Dependencies: ------------------------------------ none Runtime effects: ------------------------------------ none Code ROM usage effects: ------------------------------------ none Const data ROM usage effects: ------------------------------------ The Dcm configuration ROM usage scales straight proportionally with the number of Dcm receive PDUs. Global RAM usage effects: ------------------------------------ none Stack RAM usage effects: ------------------------------------ none
                  enumeration DcmDslProtocolRxAddrType: {DCM_FUNCTIONAL_TYPE, DCM_PHYSICAL_TYPE}, set at post-build in variant post-build-loadable+post-build-selectable / pre-compile in variant pre-compile  # Specifies the request addressing type on a concrete receive Dcm PduId. Effect: ------------------------------------ Depending on the request type specified here, the Dcm will be able to react correctly according to the ISO14229-1. Constraints: ------------------------------------ none Dependencies: ------------------------------------ none Runtime effects: ------------------------------------ none Code ROM usage effects: ------------------------------------ none Const data ROM usage effects: ------------------------------------ none Global RAM usage effects: ------------------------------------ none Stack RAM usage effects: ------------------------------------ none
                  integer DcmDslProtocolRxPduId: 0..65535, set at pre-compile, symbolic-name-value=true, default-value=0  # Specifies the logical handle value of a concrete Dcm receive PDU. NOTE: This value is generated automatically by the Configurator 5 tool. Effect: ------------------------------------ Using this value Dcm is able to distinguish the different transport layer connections. Constraints: ------------------------------------ none Dependencies: ------------------------------------ none Runtime effects: ------------------------------------ none Code ROM usage effects: ------------------------------------ none Const data ROM usage effects: ------------------------------------ none Global RAM usage effects: ------------------------------------ none Stack RAM usage effects: ------------------------------------ none
                  reference DcmDslProtocolRxPduRef: set at post-build in variant post-build-loadable+post-build-selectable / pre-compile in variant pre-compile, destination=Pdu  # Links a logical Dcm receive PduId with a concrete Dcm receive PDU. Effect: ------------------------------------ This setting connects the Dcm to the outside world. Constraints: ------------------------------------ Only receive PDUs for the ECU diagnostics shall be assigned here. The same receive PDU shall not be used again in other Dcm connections. Dependencies: ------------------------------------ none Runtime effects: ------------------------------------ none Code ROM usage effects: ------------------------------------ none Const data ROM usage effects: ------------------------------------ none Global RAM usage effects: ------------------------------------ none Stack RAM usage effects: ------------------------------------ none
                  symbolic name reference DcmDslProtocolRxComMChannelRef: set at post-build in variant post-build-loadable+post-build-selectable / pre-compile in variant pre-compile, destination=ComMChannel  # Dsl Protocol Rx ComM Channel Ref | Links a specific ComMChannel with a Dcm logical receive PduId. Effect: ------------------------------------ With this parameter the Dcm will be able to keep the communication on the specified ComMChannel awake as required by AR 4 DCM SWS. Constraints: ------------------------------------ The ComMChannel shall be exactly the one that corresponds to the communication channel on which the PDU linked in DcmDslProtocolRxPduRef is to be received. Dependencies: ------------------------------------ Refer to: /Dcm/DcmConfigSet/DcmDsl/DcmDslProtocol/DcmDslProtocolRow/DcmDslConnection/DcmDslMainConnection/DcmDslProtocolRx/DcmDslProtocolRxPduRef Runtime effects: ------------------------------------ none Code ROM usage effects: ------------------------------------ none Const data ROM usage effects: ------------------------------------ none Global RAM usage effects: ------------------------------------ none Stack RAM usage effects: ------------------------------------ none
                container DcmDslProtocolTx  # This container describes a single Dcm logical transmit PDU. Effect: ------------------------------------ If DcmDslProtocolTx is defined, the Dcm will be able to respond to a diagnostic request on the associated main-connection. Constraints: ------------------------------------ none Dependencies: ------------------------------------ none Runtime effects: ------------------------------------ none Code ROM usage effects: ------------------------------------ none Const data ROM usage effects: ------------------------------------ The Dcm configuration ROM usage scales straight proportionally with the number of Dcm transmit PDUs. Global RAM usage effects: ------------------------------------ none Stack RAM usage effects: ------------------------------------ none
                  integer DcmDslTxConfirmationPduId: 0..65535, set at pre-compile, symbolic-name-value=true, default-value=0  # Specifies the logical handle value of a concrete Dcm transmit PDU. NOTE: This value is generated automatically by the Configurator 5 tool. Effect: ------------------------------------ Using this value Dcm is able to distinguish the different transport layer connections at response confirmation time. Constraints: ------------------------------------ none Dependencies: ------------------------------------ none Runtime effects: ------------------------------------ none Code ROM usage effects: ------------------------------------ none Const data ROM usage effects: ------------------------------------ none Global RAM usage effects: ------------------------------------ none Stack RAM usage effects: ------------------------------------ none
                  reference DcmDslProtocolTxPduRef: set at post-build in variant post-build-loadable+post-build-selectable / pre-compile in variant pre-compile, destination=Pdu  # Links a logical Dcm transmit PDU with a concrete Dcm transmit PDU, that will be used for diagnostic response transmission. Effect: ------------------------------------ This setting connects the Dcm to the outside world. Constraints: ------------------------------------ Only transmit PDUs for the ECU diagnostics shall be assigned here. The same transmit PDU shall not be used again in other Dcm connections. Dependencies: ------------------------------------ none Runtime effects: ------------------------------------ none Code ROM usage effects: ------------------------------------ none Const data ROM usage effects: ------------------------------------ none Global RAM usage effects: ------------------------------------ none Stack RAM usage effects: ------------------------------------ none
      container DcmDsp  # These parameters apply to Diagnostic Service Processing. There will always be one set of these parameters per DCM.
        container DcmDspSession  # This container includes all diagnostic sessions the Dcm shall support. Effect: ------------------------------------ For each diagnostic session to be supported by Dcm a DcmDspSessionRow sub-container shall be defined. Constraints: ------------------------------------ For each session level, there shall always be a corresponding sub-services for service 0x10. Dependencies: ------------------------------------ Refer to "Dcm/DcmConfigSet/DcmDsd/DcmDsdServiceTable/DcmDsdService/DcmDsdSubService/DcmDsdSubServiceId". Runtime effects: ------------------------------------ none Code ROM usage effects: ------------------------------------ none Const data ROM usage effects: ------------------------------------ The Dcm configuration data ROM usage scales straight proportionally to the number of sessions defined. Global RAM usage effects: ------------------------------------ none Stack RAM usage effects: ------------------------------------ none
          container DcmDspSessionRow [1..31]  # Definition of a single Row of session control configuration (per session control)
            integer DcmDspSessionLevel: 0..255, set at pre-compile, symbolic-name-value=true, default-value=0  # Specifies the value of the corresponding diagnostic session. Effect: ------------------------------------ This value will be used when the Dcm_GetSesCtrlType API is called from the application to report the currently active session. Constraints: ------------------------------------ For each session level, there shall always be a corresponding sub-services for service 0x10. Dependencies: ------------------------------------ Refer to "Dcm/DcmConfigSet/DcmDsd/DcmDsdServiceTable/DcmDsdService/DcmDsdSubService/DcmDsdSubServiceId". Runtime effects: ------------------------------------ none Code ROM usage effects: ------------------------------------ none Const data ROM usage effects: ------------------------------------ none Global RAM usage effects: ------------------------------------ none Stack RAM usage effects: ------------------------------------ none
            float DcmDspSessionP2ServerMax: 0..1000, set at pre-compile, default-value=0.05  # Dsp Session P2ServerMax | Determines the diagnostic session specific P2 time in seconds. Effect: ------------------------------------ This parameter will be reported by Dcm within the positive response to the corresponding session activation request. The really monitored time by Dcm is specified from the currently active protocol. Constraints: ------------------------------------ none Dependencies: ------------------------------------ For the real monitored time adjustment refer to "/Dcm/DcmConfigSet/DcmDsl/DcmDslProtocol/DcmDslProtocolRow/DcmTimStrP2ServerAdjust". Runtime effects: ------------------------------------ none Code ROM usage effects: ------------------------------------ none Const data ROM usage effects: ------------------------------------ none Global RAM usage effects: ------------------------------------ none Stack RAM usage effects: ------------------------------------ none
            float DcmDspSessionP2StarServerMax: 0..100000, set at pre-compile, default-value=5  # Dsp Session P2StarServerMax | Determines the diagnostic session specific P2* time in seconds. Effect: ------------------------------------ This parameter will be reported by Dcm within the positive response to the corresponding session activation request. The really monitored time by Dcm is specified from the currently active protocol. Constraints: ------------------------------------ none Dependencies: ------------------------------------ For the real monitored time adjustment refer to "/Dcm/DcmConfigSet/DcmDsl/DcmDslProtocol/DcmDslProtocolRow/DcmTimStrP2StarServerAdjust". Runtime effects: ------------------------------------ none Code ROM usage effects: ------------------------------------ none Const data ROM usage effects: ------------------------------------ none Global RAM usage effects: ------------------------------------ none Stack RAM usage effects: ------------------------------------ none
      container DcmGeneral  # This container contains the configuration (parameters) for Component wide parameters
        float DcmTaskTime: 0..100, set at pre-compile, default-value=0.01  # Allow to configure the time for the periodic cyclic task in seconds. Effect: ----------------------------------------- This value is used to set up the Dcm Service-Description and BSW scheduler. All diagnostic timers managed by Dcm use this setting as a base time for the internal time constants' calculation. Constraints: ----------------------------------------- The specified time shall be a multiple of the time values defined in all diagnostic timing settings in the Dcm configuration. Dependencies: ----------------------------------------- All diagnostic timing parameters. Runtime effects: ----------------------------------------- Too low values will increase the Dcm responsiveness, but will increase the CPU load. Too high values of this parameter will lead to rear Dcm task activation (lower CPU load), but the Dcm internal timers' accuracy will not be optimal. Code ROM usage effects: ------------------------------------ none Const data ROM usage effects: ----------------------------------------- none Global RAM usage effects: ----------------------------------------- none Stack RAM usage effects: ----------------------------------------- none
        string DcmUserConfigFile [0..1]: set at pre-compile, origin=Vector Informatik  # Path to an external user configuration file used by the Configurator 5 generation tool. Effect: ----------------------------------------- If you want to overwrite some of the settings in the generated configuration file (Dcm_Cfg.h), you can specify a path to a user defined configuration file. The user defined configuration file will be included at the end of the generated preprocessor switches. Definitions in the user defined configuration file can overwrite definitions in the generated configuration file. The path shall be a valid path to the user configuration file. For simplified and project specific user configuration files references, the following Configurator 5 environment variables can be used: $(DpaProjectFolder) Absolute directory of the loaded *.dpa file. $(EcuProjectName) Name of the project defined in the loaded *.dpa file. $(EcucFile) Absolute directory "ECUC", defined by the loaded *.dpa file, containing files $(EcuProjectName).ecuc.arxml and $(EcuProjectName).ecuc.Initial.arxml . $(EcucFolder) Parent directory of $(EcucFile). $(SipRootPath) Absolute directory "SIP", defined by the loaded *.dpa file. $(OutputFolder) (Relative) directory "GenData", defined by the loaded *.dpa file. See setting "Root Target Folder" of Configurator 5. $(ServiceSwcFolder) Absolute directory "ServiceComponents", defined by the loaded *.dpa file. Constraints: ----------------------------------------- Not all of the settings can be overwritten simply by triggering the preprocessor switch. Some of the options are complex and the code generator generates less or more code depending on the setting. USE SUCH A FILE ONLY AFTER DISCUSSION WITH VECTOR. Dependencies: ----------------------------------------- none Runtime effects: ----------------------------------------- none Code ROM usage effects: ------------------------------------ none Const data ROM usage effects: ----------------------------------------- none Global RAM usage effects: ----------------------------------------- none Stack RAM usage effects: ----------------------------------------- none
        boolean DcmQueuedRequest: set at pre-compile, origin=Vector Informatik, default-value=false
        boolean DcmKeySlotMode: set at pre-compile, origin=Vector Informatik, default-value=false  # Enable switching from key slot to all slot mode.
        boolean DcmBaudrateSwitch: set at pre-compile, origin=Vector Informatik, default-value=true  # This parameter switches the APIs FblCwCheckBaudrate and FblCwSwitchBaudrate ON or OFF. true: APIs are enabled. false: APIs are disabled.
        integer DcmNwStatusRxBufferSize: set at pre-compile, origin=Vector Informatik, default-value=32  # Buffer size for the network status reception buffer.
        integer DcmCanHardwareLoopTimeout: set at pre-compile, origin=Vector Informatik, default-value=100  # Timeout value for CAN hardware loops (in cycles, typically 1 ms)
        integer DcmTaskCycle: set at pre-compile, origin=Vector Informatik, default-value=5  # Cycle count of CanTp, FrSM, EthSM and ComM tasks. Other tasks are either called every timer cycle (Ethernet) or polled (CAN)
        boolean DcmVersionInfoApi: set at pre-compile, default-value=false  # Preprocessor switch to enable or disable the output Version info of the functionality.
        boolean DcmDevErrorDetect: set at pre-compile, default-value=false  # Switches the Default Error Tracer (Det) detection and notification ON or OFF. | * true: enabled (ON). * false: disabled (OFF).
        boolean DcmRespondAllRequest: set at pre-compile, default-value=true  # If set to FALSE the Dcm will not respond to diagnostic request that contains a service ID which is in the range from 0x40 to 0x7F or in the range from 0xC0 to 0xFF (Response IDs).
        foreign reference DcmBswInitializationFilter [1..*]: set at pre-compile, origin=Vector Informatik, destination-type=ECUC-MODULE-DEF  # FblCw initializes all BSW modules configured in /MICROSAR/EcuC/EcucGeneral/BswInitialization. Use this filter to filter the module from the list.
      container DcmGeneration  # Contains the generation configuration parameters of the module.
        boolean DcmReduceConstantData2Define: set at pre-compile, origin=Vector Informatik, default-value=true  # Reduce Constant Data To a Define | This parameter activates/deactivates the capability to generate CONFIG-CLASS PRE-COMPILE ROM arrays as constant define. FALSE: ROM arrays are generated as data even if all values are identical. TRUE: ROM arrays are generated as constant define if all values are identical.
        integer DcmReduceNumericalDataByOffsetThreshold: 0.., set at pre-compile, origin=Vector Informatik, default-value=2  # This parameter activates/deactivates the capability to compress numerical CONFIG-CLASS PRE-COMPILE ROM data by using a constant offset. 0: The optimization is not performed. >0: This is the threshold to activate the data optimization. Code: the code size is increased due to the usage of the constant offset operation in the data access. RAM: no change expected. ROM: the ROM size is minimized. Runtime: the runtime is increased due to the usage of the constant offset operation in the data access.
        boolean DcmShortSymbols: set at pre-compile, origin=Vector Informatik, default-value=false  # This parameter activates/deactivates the capability to generate shortened symbol names. FALSE: symbol names are generated in a human readable style based on the MIP, tags and variant names. TRUE: symbol names are generated based on the MIP and a CRC32.
        boolean DcmInterfacesForDeactivatedData: set at pre-compile, origin=Vector Informatik, default-value=false  # This parameter activates/deactivates the capability to generate bsw data interfaces for deactivated data elements. This is an advantage for the BSW developer to reduce the time to market with a development environment using auto completition and to investigate potential interfaces. FALSE: data interfaces are not generated if the data elementis deactivated. TRUE: data interfaces are generated as e.g. emty macros.
        boolean DcmReferringKeysInComments: set at pre-compile, origin=Vector Informatik, default-value=false  # This parameter activates/deactivates the capability to generate referring keys in comments. This is an advantage for the developer to investigate indirections, but this feature reduces the overall readability of the generated data. FALSE: referring keys are not generated in comments. TRUE: referring keys are generated in comments.
  module config Dcm_Pre: definition=Dcm
    DcmConfigSet
      DcmGeneral: DcmRespondAllRequest=1, DcmVersionInfoApi=0, DcmBswInitializationFilter=Dcm, DcmBswInitializationFilter=Fee
  module config Dcm_Rec: definition=Dcm
