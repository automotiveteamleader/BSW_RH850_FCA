AUTOSAR XML (schema 4-0-3)
package /MICROSARFBL
  module config Dcm_Pre: definition=Dcm
    DcmConfigSet
      DcmGeneral: DcmRespondAllRequest=1, DcmVersionInfoApi=0, DcmQueuedRequest=0, DcmBaudrateSwitch=0, DcmKeySlotMode=0, DcmNwStatusRxBufferSize=0
      DcmGeneration:
        DcmInterfacesForDeactivatedData = 0
        DcmReduceConstantData2Define = 0
        DcmReduceNumericalDataByOffsetThreshold = 2
        DcmReferringKeysInComments = 0
        DcmShortSymbols = 0
  module config Dcm_Rec: definition=Dcm
    DcmConfigSet
      DcmGeneral: DcmTaskCycle=5, DcmTaskTime=5, DcmDevErrorDetect=0
      DcmDsl
        DcmDslBuffer: DcmDslBufferSize=8
        DcmDslDiagResp: DcmDslDiagRespMaxNumOfDeclinedRequests=3, DcmDslDiagRespOnSecondDeclinedRequest=0
      DcmDsp
        DcmDspSession
          DcmDspSessionRow: DcmDspSessionLevel=0, DcmDspSessionP2ServerMax=50, DcmDspSessionP2StarServerMax=5000
